## drivers/net/wireless/rockchip_wlan/rkwifi/bcmdhd/Kconfig
```kconfig
#
# Copyright (C) 2023, Broadcom.
#
#      Unless you and Broadcom execute a separate written software license
# agreement governing use of this software, this software is licensed to you
# under the terms of the GNU General Public License version 2 (the "GPL"),
# available at http://www.broadcom.com/licenses/GPLv2.php, with the
# following added to such license:
#
#      As a special exception, the copyright holders of this software give you
# permission to link this software with independent modules, and to copy and
# distribute the resulting executable under terms of your choice, provided that
# you also meet, for each linked independent module, the terms and conditions of
# the license of that module.  An independent module is a module which is not
# derived from this software.  The special exception does not apply to any
# modifications of the software.
#
#
# <<Broadcom-WL-IPTag/Open:>>
#

config BCMDHD
	tristate "Broadcom FullMAC wireless cards support"
	default m
	help
	  This module adds support for wireless adapters based on
	  Broadcom FullMAC chipset.

config BCMDHD_FW_PATH
	depends on BCMDHD
	string "Firmware path"
	default "/system/etc/firmware/fw_bcmdhd.bin"
	help
	  Path to the firmware file.

config BCMDHD_NVRAM_PATH
	depends on BCMDHD
	string "NVRAM path"
	default "/system/etc/firmware/nvram.txt"
	help
	  Path to the calibration file.

config BCMDHD_WEXT
	bool "Enable WEXT support"
	depends on BCMDHD && CFG80211 = n
	select WIRELESS_EXT
	select WEXT_PRIV
	help
	  Enables WEXT support

choice
	prompt "Enable Chip Interface"
	depends on BCMDHD
	help
		Enable Chip Interface.
config BCMDHD_SDIO
		bool "SDIO bus interface support"
		depends on BCMDHD && MMC
config BCMDHD_PCIE
		bool "PCIe bus interface support"
		depends on BCMDHD && PCI
config BCMDHD_USB
		bool "USB bus interface support"
		depends on BCMDHD && USB
endchoice

choice
	depends on BCMDHD && BCMDHD_SDIO
	prompt "Interrupt type"
	help
		Interrupt type
config BCMDHD_OOB
	depends on BCMDHD && BCMDHD_SDIO
	bool "Out-of-Band Interrupt"
	help
		Interrupt from WL_HOST_WAKE.
config BCMDHD_SDIO_IRQ
	depends on BCMDHD && BCMDHD_SDIO
	bool "In-Band Interrupt"
	help
	  Interrupt from SDIO DAT[1]
endchoice
```

## drivers/net/wireless/rockchip_wlan/rtl8821cs/Kconfig
```kconfig
config RTL8821CS
	tristate "Realtek 8821CS SDIO WiFi"
	help
	  Help message of RTL8821CS
```

## drivers/net/wireless/rockchip_wlan/rtl8852be/Kconfig
```kconfig
config RTL8852BE
	tristate "Realtek 8852B PCIE WiFi"
	depends on PCI
	help
	  Help message of RTL8852BE
```

## drivers/net/wireless/rockchip_wlan/rtl8852bu/Kconfig
```kconfig
config RTL8852BU
	tristate "Realtek 8852B USB WiFi"
	depends on USB
	help
	  Help message of RTL8852BU
```

## drivers/soc/rockchip/aoa_middleware/Kconfig
```kconfig
# SPDX-License-Identifier: GPL-2.0-or-later

config ROCKCHIP_AOA_MIDDLEWARE
	tristate "Rockchip AOA Middleware Driver"
	help
	  Enable this configuration option to enable notify (AOA/DMA) events
	  on driver for user applications.
```

## drivers/video/rockchip/dvbm/Kconfig
```kconfig
# SPDX-License-Identifier: (GPL-2.0+ OR MIT)

menuconfig ROCKCHIP_DVBM
	tristate "RK Direct Video Buffer Manager driver"
	depends on ARCH_ROCKCHIP
	help
	  rockchip dvbm module.
```

## drivers/video/rockchip/mpp_osal/Kconfig
```kconfig
# SPDX-License-Identifier: (GPL-2.0+ OR MIT)

config ROCKCHIP_MPP_OSAL
	bool "mpp osal"
	help
	  rockchip mpp osal adapt for kmpp
```

## drivers/video/rockchip/rga3/Kconfig
```kconfig
# SPDX-License-Identifier: GPL-2.0
menuconfig ROCKCHIP_MULTI_RGA
	tristate "MULTI_RGA"
	depends on ARCH_ROCKCHIP
	help
	  multi_rga module.

if ROCKCHIP_MULTI_RGA

config ROCKCHIP_RGA_ASYNC
	bool "Enable async mode"
	depends on SYNC_FILE
	default y
	help
	  Asynchronous calls will be supported.

config ROCKCHIP_RGA_PROC_FS
	bool "Enable RGA procfs"
	select ROCKCHIP_RGA_DEBUGGER
	depends on PROC_FS
	help
	  Enable procfs to debug multi RGA driver.

config ROCKCHIP_RGA_DEBUG_FS
	bool "Enable RGA debugfs"
	select ROCKCHIP_RGA_DEBUGGER
	depends on DEBUG_FS
	default y
	help
	  Enable debugfs to debug multi RGA driver.

config ROCKCHIP_RGA_DEBUGGER
	bool
	help
	  Enabling the debugger of multi RGA, you can use procfs and debugfs for debugging.

config ROCKCHIP_RGA_GENPOOL
	bool "Use genpool to manage cmd_buf"
	default n
	help
	  Use genpool to manage cmd_buf on each scheduler, default use dmapool.

	  When using genpool to manage cmd_buf, the total cmd_buf count is
	  ROCKCHIP_RGA_CMD_BUF_COUNT. which represents the maximum number of
	  jobs that can be allocated. If the number of active jobs exceeds
	  this number, new jobs cannot be allocated.

	  Therefore, this config should be used with caution, and using the default
	  dmapool will not cause jobs cannot be allocated.

config ROCKCHIP_RGA_CMD_BUF_COUNT
	int "Number of pre-allocated command buffers for RGA"
	depends on ROCKCHIP_RGA_GENPOOL
	range 4 256
	default 32
	help
	  This option configures the number of command buffers (cmd_buf) that are
	  pre-allocated by the RGA driver during initialization.

endif
```

## sound/soc/codecs/it6621/Kconfig
```kconfig
# SPDX-License-Identifier: GPL-2.0-or-later

config SND_SOC_IT6621
	tristate "IT6621 driver for HDMI2.1 enhanced audio return channel (eARC)"
	depends on (I2C)
	help
	  Say yes here to build support for ITE IT6621 eARC.

	  To compile this driver as a module, choose M here: the module
	  will be called it6621.
```
