## drivers/input/touchscreen/hxchipset/Kconfig
```kconfig
#SPDX-License-Identifier: GPL-2.0
#
# Himax Touchscreen driver configuration
#
config TOUCHSCREEN_HIMAX_CHIPSET
        tristate "HIAMX touchscreens support"

if TOUCHSCREEN_HIMAX_CHIPSET

config TOUCHSCREEN_HIMAX_COMMON
        tristate "HIMAX chipset i2c touchscreen"
		depends on TOUCHSCREEN_HIMAX_CHIPSET
		help
		This enables support for HIMAX CHIPSET over I2C based touchscreens.

choice
	prompt "HIMAX touch IC types"
	depends on TOUCHSCREEN_HIMAX_COMMON
	default TOUCHSCREEN_HIMAX_INCELL

config TOUCHSCREEN_HIMAX_INCELL
        bool "HIMAX chipset in-cell function"
		depends on TOUCHSCREEN_HIMAX_COMMON
		help
		This enables support for HIMAX CHIPSET of in-cell function.

endchoice
# ***************** In-cell Start *****************
config TOUCHSCREEN_HIMAX_IC_HX83193
        tristate "HIMAX chipset HX83193 function"
		depends on TOUCHSCREEN_HIMAX_INCELL
		help
		This enables support for HIMAX CHIPSET of HX83193.

config TOUCHSCREEN_HIMAX_IC_HX83192
        tristate "HIMAX chipset HX83192 function"
		depends on TOUCHSCREEN_HIMAX_INCELL
		help
		This enables support for HIMAX CHIPSET of HX83192.

config TOUCHSCREEN_HIMAX_IC_HX83191
        tristate "HIMAX chipset HX83191 function"
		depends on TOUCHSCREEN_HIMAX_INCELL
		help
		This enables support for HIMAX CHIPSET of HX83191.

# ***************** In-cell End *******************

config TOUCHSCREEN_HIMAX_DEBUG
        bool "HIMAX debug function"
		depends on TOUCHSCREEN_HIMAX_INCELL
		help
		This enables support for HIMAX debug function.
config TOUCHSCREEN_HIMAX_INSPECT
        bool "HIMAX inspect function"
		depends on TOUCHSCREEN_HIMAX_INCELL
		help
		This enables support for HIMAX debug function.

config TOUCHSCREEN_HIMAX_EMBEDDED_FIRMWARE
	bool "HIMAX embedded firmware function"
		depends on TOUCHSCREEN_HIMAX_INCELL
		help
		This enables built-in FW inside kernel as binary array

endif
```

## drivers/input/touchscreen/parade/Kconfig
```kconfig
# SPDX-License-Identifier: GPL-2.0-only
#
#  Touchscreen driver configuration
#
config TOUCHSCREEN_PARADE
	tristate "Parade TrueTouch Gen5 Touchscreen Driver"
	help
	  Core driver for Parade TrueTouch(tm) Standard Product
	  Geneartion5 touchscreen controllers.

	  Say Y here if you have a Parade Gen5 touchscreen.

	  If unsure, say N.

	  To compile this driver as a module, choose M here: the
	  module will be called pt.

config TOUCHSCREEN_PARADE_DEVICETREE_SUPPORT
	bool "Enable Device Tree support"
	depends on TOUCHSCREEN_PARADE && OF
	help
	  Say Y here to enable support for device tree.

	  If unsure, say N.

config TOUCHSCREEN_PARADE_DEBUG
	bool "Enable debug output"
	depends on TOUCHSCREEN_PARADE
	help
	  Say Y here to enable debug output for Parade TrueTouch(tm)
	  Standard Product Generation5 drivers set.

	  If unsure, say N.

config TOUCHSCREEN_PARADE_VDEBUG
	bool "Enable verbose debug output"
	depends on TOUCHSCREEN_PARADE_DEBUG
	help
	  Say Y here to enable verbose debug output for Parade TrueTouch(tm)
	  Standard Product Generation5 drivers set.

	  If unsure, say N.

config TOUCHSCREEN_PARADE_I2C
	tristate "Parade TrueTouch Gen5 I2C"
	depends on TOUCHSCREEN_PARADE
	select I2C
	help
	  Say Y here to enable I2C bus interface to Parade TrueTouch(tm)
	  Standard Product Generation5 touchscreen controller.

	  If unsure, say Y.

	  To compile this driver as a module, choose M here: the
	  module will be called pt_i2c.

config TOUCHSCREEN_PARADE_SPI
	tristate "Parade TrueTouch Gen5 SPI"
	depends on TOUCHSCREEN_PARADE
	select SPI
	help
	  Say Y here to enable SPI bus interface to Parade TrueTouch(tm)
	  Standard Product Generation5 touchscreen controller.

	  If unsure, say N.

	  To compile this driver as a module, choose M here: the
	  module will be called pt_spi.

choice
	prompt "Parade TrueTouch Gen5 MultiTouch Protocol"
	depends on TOUCHSCREEN_PARADE
	default TOUCHSCREEN_PARADE_MT_B
	help
	  This option controls which MultiTouch protocol will be used to
	  report the touch events.

config TOUCHSCREEN_PARADE_MT_A
	bool "Protocol A"
	help
	  Select to enable MultiTouch touch reporting using protocol A
	  on Parade TrueTouch(tm) Standard Product Generation4 touchscreen
	  controller.

config TOUCHSCREEN_PARADE_MT_B
	bool "Protocol B"
	help
	  Select to enable MultiTouch touch reporting using protocol B
	  on Parade TrueTouch(tm) Standard Product Generation4 touchscreen
	  controller.

endchoice

config TOUCHSCREEN_PARADE_BUTTON
	bool "Parade TrueTouch Gen5 MultiTouch CapSense Button"
	depends on TOUCHSCREEN_PARADE
	help
	  Say Y here to enable CapSense reporting on Parade TrueTouch(tm)
	  Standard Product Generation5 touchscreen controller.

	  If unsure, say N.

config TOUCHSCREEN_PARADE_PROXIMITY
	bool "Parade TrueTouch Gen5 Proximity"
	depends on TOUCHSCREEN_PARADE
	help
	  Say Y here to enable proximity reporting on Parade TrueTouch(tm)
	  Standard Product Generation5 touchscreen controller.

	  If unsure, say N.

config TOUCHSCREEN_PARADE_DEVICE_ACCESS
	tristate "Parade TrueTouch Gen5 MultiTouch Device Access"
	depends on TOUCHSCREEN_PARADE
	help
	  Say Y here to enable Parade TrueTouch(tm) Standard Product
	  Generation5 touchscreen controller device access module.

	  This modules adds an interface to access touchscreen
	  controller using driver sysfs nodes.

	  If unsure, say N.

	  To compile this driver as a module, choose M here: the
	  module will be called pt_device_access.

config TOUCHSCREEN_PARADE_LOADER
	tristate "Parade TrueTouch Gen5 MultiTouch Loader"
	depends on TOUCHSCREEN_PARADE
	help
	  Say Y here to enable Parade TrueTouch(tm) Standard Product
	  Generation5 touchscreen controller FW Loader module.

	  This module enables support for Firmware upgrade.

	  If unsure, say Y.

	  To compile this driver as a module, choose M here: the
	  module will be called pt_loader.

config TOUCHSCREEN_PARADE_PLATFORM_FW_UPGRADE
	bool "FW upgrade from header file"
	depends on TOUCHSCREEN_PARADE_LOADER
	help
	  Say Y here to include Parade TrueTouch(tm) Standard Product
	  Generation5 device Firmware into driver.

	  Need proper header file for this.

	  If unsure, say N.

config TOUCHSCREEN_PARADE_BINARY_FW_UPGRADE
	bool "FW upgrade from binary file"
	depends on TOUCHSCREEN_PARADE_LOADER
	help
	  Say Y here to include Parade TrueTouch(tm) Standard Product
	  Generation5 device Firmware into kernel as binary blob.

	  This should be enabled for manual FW upgrade support.

	  If unsure, say Y.

config TOUCHSCREEN_PARADE_PLATFORM_TTCONFIG_UPGRADE
	bool "TT Configuration upgrade from header file"
	depends on TOUCHSCREEN_PARADE_LOADER
	help
	  Say Y here to include Parade TrueTouch(tm) Standard Product
	  Generation5 device TrueTouch Configuration into kernel itself.

	  Need proper header file for this.

	  If unsure, say N.

config TOUCHSCREEN_PARADE_MANUAL_TTCONFIG_UPGRADE
	bool "TT Configuration upgrade via SysFs"
	depends on TOUCHSCREEN_PARADE_LOADER
	help
	  Say Y here to provide a SysFs interface to upgrade TrueTouch
	  Configuration with a binary configuration file.

	  Need proper binary version of config file for this
	  feature.

	  If unsure, say Y.

config TOUCHSCREEN_PARADE_DEBUG_MDL
	tristate "Parade TrueTouch Gen5 MultiTouch Debug Module"
	depends on TOUCHSCREEN_PARADE
	help
	  Say Y here to enable Parade TrueTouch(tm) Standard Product
	  Generation5 Debug module.

	  This module adds support for verbose printing touch
	  information.

	  If unsure, say N.

	  To compile this driver as a module, choose M here: the
	  module will be called pt_debug.
```

## drivers/media/i2c/maxim/Kconfig
```kconfig
# SPDX-License-Identifier: GPL-2.0-only
#
# Maxim GMSL Serdes devices
#
config VIDEO_MAXIM_SERDES
	tristate "Maxim GMSL Serdes Support"
	depends on I2C && VIDEO_DEV
	depends on MEDIA_CAMERA_SUPPORT
	select MEDIA_CONTROLLER
	select VIDEO_V4L2_SUBDEV_API
	select V4L2_FWNODE
	help
	  This driver supports the Maxim GMSL Serdes.

	  To compile this driver as a module, choose M here: the
	  module will be called maxim.

source "drivers/media/i2c/maxim/local/Kconfig"
source "drivers/media/i2c/maxim/remote/Kconfig"
```

## drivers/media/i2c/maxim/local/Kconfig
```kconfig
# SPDX-License-Identifier: GPL-2.0-only
#
# Maxim GMSL deserializer devices
#
menu "Maxim Deserializer devices support"
	visible if VIDEO_MAXIM_SERDES

source "drivers/media/i2c/maxim/local/maxim2c/Kconfig"
source "drivers/media/i2c/maxim/local/maxim4c/Kconfig"

endmenu
```

## drivers/media/i2c/maxim/local/maxim2c/Kconfig
```kconfig
# SPDX-License-Identifier: GPL-2.0-only
#
# Maxim Dual GMSL deserializer devices
#
config VIDEO_MAXIM_DES_MAXIM2C
	tristate "Maxim Dual GMSL deserializer support"
	depends on VIDEO_MAXIM_SERDES
	help
	  This driver supports the Maxim Dual GMSL2/GMSL1 deserializer.

	  To compile this driver as a module, choose M here: the
	  module will be called maxim2c.
```

## drivers/media/i2c/maxim/local/maxim4c/Kconfig
```kconfig
# SPDX-License-Identifier: GPL-2.0-only
#
# Maxim Quad GMSL deserializer devices
#
config VIDEO_MAXIM_DES_MAXIM4C
	tristate "Maxim Quad GMSL deserializer support"
	depends on VIDEO_MAXIM_SERDES
	help
	  This driver supports the Maxim Quad GMSL2/GMSL1 deserializer.

	  To compile this driver as a module, choose M here: the
	  module will be called maxim4c.
```

## drivers/media/i2c/maxim/remote/Kconfig
```kconfig
# SPDX-License-Identifier: GPL-2.0-only
#
# Maxim GMSL serializer devices
#

menu "Maxim GMSL Remote Serializer devices support"
	visible if VIDEO_MAXIM_SERDES

config VIDEO_MAXIM_SER_MAX9295
	tristate "Maxim GMSL2 serializer max9295 support"
	depends on VIDEO_MAXIM_SERDES
	help
	  This driver supports the Maxim GMSL2 max9295 serializer.

	  To compile this driver as a module, choose M here: the
	  module will be called max9295.

config VIDEO_MAXIM_SER_MAX96715
	tristate "Maxim GMSL1 Serializer max96715 support"
	depends on VIDEO_MAXIM_SERDES
	help
	  This driver supports the Maxim GMSL1 max96715 serializer.

	  To compile this driver as a module, choose M here: the
	  module will be called max96715.

config VIDEO_MAXIM_SER_MAX96717
	tristate "Maxim GMSL2 Serializer max96717 support"
	depends on VIDEO_MAXIM_SERDES
	help
	  This driver supports the Maxim GMSL2 max96717 serializer.

	  To compile this driver as a module, choose M here: the
	  module will be called max96717.

endmenu

menu "Maxim GMSL Remote Sensor devices support"
	visible if VIDEO_MAXIM_SERDES

config VIDEO_MAXIM_CAM_DUMMY
	tristate "Maxim Remote Sensor dummy support"
	depends on VIDEO_MAXIM_SERDES
	help
	  This driver supports the remote Sensor dummy.

	  To compile this driver as a module, choose M here: the
	  module will be called dummy.

config VIDEO_MAXIM_CAM_SC320AT
	tristate "Maxim Remote Sensor sc320at support"
	depends on VIDEO_MAXIM_SERDES
	help
	  This driver supports the remote Sensor sc320at.

	  To compile this driver as a module, choose M here: the
	  module will be called sc320at.

config VIDEO_MAXIM_CAM_OX01F10
	tristate "Maxim Remote Sensor ox01f10 support"
	depends on VIDEO_MAXIM_SERDES
	help
	  This driver supports the remote sensor ox01f10.

	  To compile this driver as a module, choose M here: the
	  module will be called ox01f10.

config VIDEO_MAXIM_CAM_OV231X
	tristate "Maxim Remote Sensor ov2311/ov2312 support"
	depends on VIDEO_MAXIM_SERDES
	help
	  This driver supports the remote sensor ov231x.

	  To compile this driver as a module, choose M here: the
	  module will be called ov231x.

config VIDEO_MAXIM_CAM_OX03J10
	tristate "Maxim Remote Sensor ox03j10 support"
	depends on VIDEO_MAXIM_SERDES
	help
	  This driver supports the remote sensor ox03j10.

	  To compile this driver as a module, choose M here: the
	  module will be called ox03j10.

config VIDEO_MAXIM_CAM_OS04A10
	tristate "Maxim Remote Sensor os04a10 support"
	depends on VIDEO_MAXIM_SERDES
	help
	  This driver supports the remote sensor os04a10.

	  To compile this driver as a module, choose M here: the
	  module will be called os04a10.

endmenu
```

## drivers/media/i2c/rk628/Kconfig
```kconfig
# SPDX-License-Identifier: GPL-2.0-only
config VIDEO_RK628
	tristate
	select CEC_CORE
	help
	  Support for the Rockchip RK628 HDMI to MIPI CSI-2/BT1120 bridge.

	  To compile this driver as a module, choose M here: the
	  module will be called video-rk628.

config VIDEO_RK628_CSI
	tristate "Rockchip RK628_CSI decoder"
	depends on VIDEO_DEV && I2C
	select HDMI
	select V4L2_FWNODE
	select VIDEO_V4L2_SUBDEV_API
	select VIDEO_RK628
	select VIDEO_ROCKCHIP_HDMIRX_CLASS
	help
	  Support for the Rockchip RK628 HDMI to MIPI CSI-2 bridge.

	  To compile this driver as a module, choose M here: the
	  module will be called rk628-csi.

config VIDEO_RK628_BT1120
	tristate "Rockchip RK628_BT1120 decoder"
	depends on VIDEO_DEV && I2C
	select HDMI
	select V4L2_FWNODE
	select VIDEO_V4L2_SUBDEV_API
	select VIDEO_RK628
	help
	  Support for the Rockchip RK628 HDMI to BT1120 bridge.

	  To compile this driver as a module, choose M here: the
	  module will be called rk628-bt1120.
```

## drivers/media/platform/rockchip/Kconfig
```kconfig
# SPDX-License-Identifier: GPL-2.0-only

comment "Rockchip media platform drivers"

source "drivers/media/platform/rockchip/cif/Kconfig"
source "drivers/media/platform/rockchip/flexbus_cif/Kconfig"
source "drivers/media/platform/rockchip/isp1/Kconfig"
source "drivers/media/platform/rockchip/isp/Kconfig"
source "drivers/media/platform/rockchip/ispp/Kconfig"
source "drivers/media/platform/rockchip/hdmirx/Kconfig"
source "drivers/media/platform/rockchip/rga/Kconfig"
source "drivers/media/platform/rockchip/rkisp1/Kconfig"
source "drivers/media/platform/rockchip/vpss/Kconfig"
```

## drivers/media/platform/rockchip/aiisp/Kconfig
```kconfig
# SPDX-License-Identifier: GPL-2.0
config VIDEO_ROCKCHIP_AIISP
	tristate "Rockchip AIISP driver"
	depends on V4L_PLATFORM_DRIVERS
	depends on VIDEO_DEV
	depends on ARCH_ROCKCHIP || COMPILE_TEST
	select VIDEOBUF2_CMA_SG
	select V4L2_FWNODE
	default n
	help
	  Support for AIISP on the rockchip SoC.
```

## drivers/media/platform/rockchip/avsp/Kconfig
```kconfig
# SPDX-License-Identifier: GPL-2.0
config VIDEO_ROCKCHIP_AVSP
	tristate "Rockchip Any View Stitching Processor driver"
	depends on ARCH_ROCKCHIP || COMPILE_TEST
	default n
	help
	  Support for AVSP on the rockchip SoC.

	  If you are using a Rockchip SoC with an integrated AVSP module
	  and require AVSP, say Y or M here.
```

## drivers/media/platform/rockchip/fec/Kconfig
```kconfig
# SPDX-License-Identifier: GPL-2.0
config VIDEO_ROCKCHIP_FEC
	tristate "Rockchip Fisheye Correction Sub System driver"
	depends on V4L_PLATFORM_DRIVERS
	depends on VIDEO_DEV
	depends on ARCH_ROCKCHIP || COMPILE_TEST
	select VIDEO_V4L2_SUBDEV_API
	select VIDEOBUF2_CMA_SG
	select VIDEOBUF2_VMALLOC
	default n
	help
	  Support for FEC on the rockchip SoC.

	  If you are using a Rockchip SoC with an integrated FEC module
	  and require FEC, say Y or M here.
```

## drivers/media/platform/rockchip/flexbus_cif/Kconfig
```kconfig
# SPDX-License-Identifier: GPL-2.0
# Copyright (C) 2024 Rockchip Electronics Co., Ltd.

config ROCKCHIP_FLEXBUS_CIF
	tristate "Rockchip Flexbus CIF Camera Interface driver"
	depends on V4L_PLATFORM_DRIVERS
	depends on VIDEO_DEV
	depends on ARCH_ROCKCHIP || COMPILE_TEST
	depends on MEDIA_CAMERA_SUPPORT
	select MFD_ROCKCHIP_FLEXBUS
	select VIDEO_V4L2_SUBDEV_API
	select VIDEOBUF2_CMA_SG
	select VIDEOBUF2_VMALLOC
	select V4L2_FWNODE
	default n
	help
	  Support for flexbus cif on the rockchip SoCs

choice
	prompt "rockchip flexbuf-cif device dummy buffer choice"
	depends on ROCKCHIP_FLEXBUS_CIF
	default ROCKCHIP_FLEXBUS_CIF_USE_DUMMY_BUF
	help
	  choice to use dummy buffer or not

config ROCKCHIP_FLEXBUS_CIF_USE_DUMMY_BUF
	bool "flexbuf-cif use dummy buffer"
	help
	  select to use dummy buffer

config ROCKCHIP_FLEXBUS_CIF_USE_NONE_DUMMY_BUF
	bool "flexbuf-cif not use dummy buffer"
	help
	  select not to use dummy buffer

endchoice
```
