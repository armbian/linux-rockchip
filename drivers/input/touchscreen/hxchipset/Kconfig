## drivers/media/platform/rockchip/isp/Kconfig
```kconfig
# SPDX-License-Identifier: GPL-2.0
config VIDEO_ROCKCHIP_ISP
	tristate "Rockchip Image Signal Processing Unit driver"
	depends on V4L_PLATFORM_DRIVERS
	depends on VIDEO_DEV
	depends on ARCH_ROCKCHIP || COMPILE_TEST
	select VIDEO_V4L2_SUBDEV_API
	select VIDEOBUF2_CMA_SG
	select VIDEOBUF2_VMALLOC
	select V4L2_FWNODE
	select PHY_ROCKCHIP_MIPI_RX
	default n
	help
	  Support for ISP on the rockchip SoC.

if VIDEO_ROCKCHIP_ISP

config VIDEO_ROCKCHIP_ISP_VERSION_V1X
	bool "isp1 for rk1808 rk3288 rk3326 rk3368 rk3399"
	depends on CPU_RK1808 || CPU_RK3288 || CPU_PX30 || CPU_RK3368 || CPU_RK3399
	default y

config VIDEO_ROCKCHIP_ISP_VERSION_V20
	bool "isp20 for rv1126 and rv1109"
	depends on CPU_RV1126
	default y

config VIDEO_ROCKCHIP_ISP_VERSION_V21
	bool "isp21 for rk3566 and rk3568"
	depends on CPU_RK3568
	default y

config VIDEO_ROCKCHIP_ISP_VERSION_V30
	bool "isp30 for rk3588"
	depends on CPU_RK3588
	default y

config VIDEO_ROCKCHIP_ISP_VERSION_V32
	bool "isp32 for rv1106 rk3562"
	depends on CPU_RV1106 || CPU_RK3562
	default y

config VIDEO_ROCKCHIP_ISP_VERSION_V33
	bool "isp33 for rv1103b"
	depends on CPU_RV1103B
	default y

config VIDEO_ROCKCHIP_ISP_VERSION_V33_DBG
	bool "isp33 params debug for rv1103b"
	depends on VIDEO_ROCKCHIP_ISP_VERSION_V33
	default n

config VIDEO_ROCKCHIP_ISP_VERSION_V35
	bool "isp35 for rv1126b"
	depends on CPU_RV1126B
	default y

config VIDEO_ROCKCHIP_ISP_VERSION_V35_DBG
	bool "isp35 params debug for rv1126b"
	depends on VIDEO_ROCKCHIP_ISP_VERSION_V35
	default n

config VIDEO_ROCKCHIP_ISP_VERSION_V39
	bool "isp39 for rk3576"
	depends on CPU_RK3576
	default y

config VIDEO_ROCKCHIP_ISP_VERSION_V39_DBG
	bool "isp39 params debug for rk3576"
	depends on VIDEO_ROCKCHIP_ISP_VERSION_V39
	default n

config VIDEO_ROCKCHIP_THUNDER_BOOT_ISP
	bool "Rockchip Image Signal Processing Thunderboot helper"
	depends on ROCKCHIP_THUNDER_BOOT
	help
	  Say y if enable thunderboot helper for isp.

endif
```

## drivers/media/platform/rockchip/isp1/Kconfig
```kconfig
# SPDX-License-Identifier: GPL-2.0
config VIDEO_ROCKCHIP_RKISP1
	tristate "Rockchip Image Signal Processing V1 Unit driver"
	depends on V4L_PLATFORM_DRIVERS
	depends on VIDEO_DEV
	depends on ARCH_ROCKCHIP || COMPILE_TEST
	depends on CPU_RK1808 || CPU_RK3288 || CPU_PX30 || CPU_RK3368 || CPU_RK3399
	select VIDEO_V4L2_SUBDEV_API
	select VIDEOBUF2_DMA_CONTIG
	select VIDEOBUF2_VMALLOC
	select V4L2_FWNODE
	select PHY_ROCKCHIP_MIPI_RX
	default n
	help
	  Support for ISP1 on the rockchip SoC.
```

## drivers/media/platform/rockchip/ispp/Kconfig
```kconfig
# SPDX-License-Identifier: GPL-2.0
config VIDEO_ROCKCHIP_ISPP
	tristate "Rockchip Image Signal Post-Processing Unit driver"
	depends on V4L_PLATFORM_DRIVERS
	depends on VIDEO_DEV
	depends on ARCH_ROCKCHIP || COMPILE_TEST
	select VIDEO_V4L2_SUBDEV_API
	select VIDEOBUF2_CMA_SG
	select VIDEOBUF2_VMALLOC
	default n
	help
	  Support for ISPP on the rockchip SoC.

config VIDEO_ROCKCHIP_ISPP_FEC
	bool "Rockchip Image Signal FEC Processing helper"
	depends on VIDEO_ROCKCHIP_ISPP
	default n
	help
	  Say y if enable fec independent.

if VIDEO_ROCKCHIP_ISPP

config VIDEO_ROCKCHIP_ISPP_VERSION_V10
	bool "ispp10 for rv1126 and rv1109"
	depends on CPU_RV1126
	default y

config VIDEO_ROCKCHIP_ISPP_VERSION_V20
	bool "ispp20 for rk3588"
	depends on CPU_RK3588
	default y

endif
```

## drivers/memory/rockchip/Kconfig
```kconfig
# SPDX-License-Identifier: GPL-2.0
#
# Rockchip DSMC(Double Data Rate Serial Memory Controller) support
#

config ROCKCHIP_DSMC
	tristate "Rockchip DSMC(Double Data Rate Serial Memory Controller) driver"
	depends on ARCH_ROCKCHIP
	help
	  For enable the Rockchip DSMC driver.

config ROCKCHIP_DSMC_SLAVE
	tristate "Rockchip Double Data Rate Serial Memory Controller(DSMC) slave driver"
	depends on ARCH_ROCKCHIP
	help
	  For enable the Rockchip DSMC SLAVE driver.
```

## drivers/mfd/rkx110_x120/Kconfig
```kconfig
# SPDX-License-Identifier: (GPL-2.0+ OR MIT)

config MFD_RKX110_X120
	tristate "Rockchip RKx110 RKx120 SerDes MFD Driver"
	depends on I2C
	depends on OF
	select MFD_CORE
	help
	  if you say yes here you get support for the RKx110 RKx120 from Rockchip.

config PWM_RKX120
	tristate "Rockchip RKx120 SerDes PWM Driver"
	depends on OF
	depends on PWM
	depends on MFD_RKX110_X120
	help
	  PWM framework driver for RKx120.

config ROCKCHIP_SERDES_DRM_PANEL
	tristate "Generic RK Serdes panel driver"
	depends on OF
	depends on BACKLIGHT_CLASS_DEVICE
	depends on MFD_RKX110_X120
	select VIDEOMODE_HELPERS
	help
	  This driver supports rk serdes panels.
```

## drivers/misc/rockchip/Kconfig
```kconfig
# SPDX-License-Identifier: GPL-2.0
#
# Misc strange devices for rockchip

config PCIE_FUNC_RKEP
	tristate "Rockchip PCIe EP function driver"
	depends on PCI
	depends on ARCH_ROCKCHIP
	select PCIE_DW_DMATEST
	help
           Enable this configuration option to enable the host side function
	   driver for Rockchip's EP demo function driver.
```

## drivers/misc/vehicle/Kconfig
```kconfig
# SPDX-License-Identifier: GPL-2.0-only
#
# vehicle configuration
#

menu "misc vehicle setting"

config VEHICLE_CORE
	tristate "ROCKCHIP VEHICLE core support"
	help
	  If you say yes here you get support for the RK
	  vehicle core module.

config VEHICLE_DUMMY
	tristate "RK VEHICLE DUMMY support"
	select EXTCON
	depends on VEHICLE_CORE
	help
	  If you say yes here you get support for the RK dummy MCU
	  which simulate the vehicle signal.

config VEHICLE_ADC
	tristate "VEHICLE ADC support"
	depends on VEHICLE_CORE
	help
	  If you say yes here you get support for the vehicle with adc
	  which simulate the vehicle signal.

config VEHICLE_GPIO
	tristate "VEHICLE GPIO support"
	depends on VEHICLE_CORE
	help
	  If you say yes here you get support for the vehicle with gpio
	  which simulate the vehicle signal.

config VEHICLE_SPI
	tristate "VEHICLE SPI support"
	depends on VEHICLE_CORE
	help
	  If you say yes here you get support for the vehicle with spi bus
          which simulate the vehicle signal.

config VEHICLE_SPI_PROTOCOL
	tristate "VEHICLE SPI_PROTOCOL support"
	depends on VEHICLE_SPI
	help
	  If you say yes here, you can get support for vehicle spi protocol.

config VEHICLE_GPIO_MCU_EXPANDER
        tristate "VEHICLE MCU GPIO EXPANDER support"
        help
          If you say yes here you get support for the mcu gpio expander.

config VEHICLE_DRIVER_OREO
	bool "RK vehicle driver for android oreo"
	help
	  If you say yes here, you can get support for vehicle protocol
	  in android o, otherwise it support android p.

endmenu
```

## drivers/mtd/nand/spi/Kconfig.spinandlist
```kconfig
# SPDX-License-Identifier: GPL-2.0-only

if MTD_SPI_NAND

config MTD_SPI_NAND_DEVICE_AUTOSELECT
	bool "Autoselect SPI Nand flash"
	default y
	help
	  By default, auto-selects all SPI Nand flash chips.

menu "SPI Nand flash"
	visible if !MTD_SPI_NAND_DEVICE_AUTOSELECT

config MTD_SPI_NAND_ATO
	bool "ATO SPI flash support"
	default y if MTD_SPI_NAND_DEVICE_AUTOSELECT
	help
	  Add support for various ATO SPI Nand flash chips

config MTD_SPI_NAND_BIWIN
	bool "BIWIN SPI flash support"
	default y if MTD_SPI_NAND_DEVICE_AUTOSELECT
	help
	  Add support for various BIWIN SPI Nand flash chips

config MTD_SPI_NAND_DOSILICON
	bool "DOSILICON SPI flash support"
	default y if MTD_SPI_NAND_DEVICE_AUTOSELECT
	help
	  Add support for various DOSILICON SPI Nand flash chips

config MTD_SPI_NAND_ESMT
	bool "ESMT SPI flash support"
	default y if MTD_SPI_NAND_DEVICE_AUTOSELECT
	select SPI_NAND_MICRON
	help
	  Add support for various ESMT SPI Nand flash chips

config MTD_SPI_NAND_ETRON
	bool "ETRON SPI flash support"
	default y if MTD_SPI_NAND_DEVICE_AUTOSELECT
	help
	  Add support for various ETRON SPI Nand flash chips

config MTD_SPI_NAND_FMSH
	bool "FMSH SPI flash support"
	default y if MTD_SPI_NAND_DEVICE_AUTOSELECT
	help
	  Add support for various FMSH SPI Nand flash chips

config MTD_SPI_NAND_FORESEE
	bool "FORESEE SPI flash support"
	default y if MTD_SPI_NAND_DEVICE_AUTOSELECT
	help
	  Add support for various FORESEE SPI Nand flash chips

config MTD_SPI_NAND_GIGADEVICE
	bool "GIGADEVICE SPI flash support"
	default y if MTD_SPI_NAND_DEVICE_AUTOSELECT
	help
	  Add support for various GIGADEVICE SPI Nand flash chips

config MTD_SPI_NAND_GSTO
	bool "GSTO SPI flash support"
	default y if MTD_SPI_NAND_DEVICE_AUTOSELECT
	help
	  Add support for various GSTO SPI Nand flash chips

config MTD_SPI_NAND_HIKSEMI
	bool "HIKSEMI SPI flash support"
	default y if MTD_SPI_NAND_DEVICE_AUTOSELECT
	help
	  Add support for various HIKSEMI SPI Nand flash chips

config MTD_SPI_NAND_HYF
	bool "HYF SPI flash support"
	default y if MTD_SPI_NAND_DEVICE_AUTOSELECT
	help
	  Add support for various HYF SPI Nand flash chips

config MTD_SPI_NAND_ISSI
	bool "ISSI SPI flash support"
	default y if MTD_SPI_NAND_DEVICE_AUTOSELECT
	help
	  Add support for various ISSI SPI Nand flash chips

config MTD_SPI_NAND_JSC
	bool "JSC SPI flash support"
	default y if MTD_SPI_NAND_DEVICE_AUTOSELECT
	help
	  Add support for various JSC SPI Nand flash chips

config MTD_SPI_NAND_MACRONIX
	bool "MACRONIX SPI flash support"
	default y if MTD_SPI_NAND_DEVICE_AUTOSELECT
	help
	  Add support for various MACRONIX SPI Nand flash chips

config MTD_SPI_NAND_MICRON
	bool "MICRON SPI flash support"
	default y if MTD_SPI_NAND_DEVICE_AUTOSELECT
	help
	  Add support for various MICRON SPI Nand flash chips

config MTD_SPI_NAND_PARAGON
	bool "PARAGON SPI flash support"
	default y if MTD_SPI_NAND_DEVICE_AUTOSELECT
	help
	  Add support for various PARAGON SPI Nand flash chips

config MTD_SPI_NAND_SILICONGO
	bool "SILICONGO SPI flash support"
	default y if MTD_SPI_NAND_DEVICE_AUTOSELECT
	help
	  Add support for various SILICONGO SPI Nand flash chips

config MTD_SPI_NAND_SKYHIGH
	bool "SKYHIGH SPI flash support"
	default y if MTD_SPI_NAND_DEVICE_AUTOSELECT
	help
	  Add support for various SKYHIGH SPI Nand flash chips

config MTD_SPI_NAND_TOSHIBA
	bool "TOSHIBA SPI flash support"
	default y if MTD_SPI_NAND_DEVICE_AUTOSELECT
	help
	  Add support for various TOSHIBA SPI Nand flash chips

config MTD_SPI_NAND_UNIM
	bool "UNIM SPI flash support"
	default y if MTD_SPI_NAND_DEVICE_AUTOSELECT
	help
	  Add support for various UNIM SPI Nand flash chips

config MTD_SPI_NAND_WINBOND
	bool "WINBOND SPI flash support"
	default y if MTD_SPI_NAND_DEVICE_AUTOSELECT
	help
	  Add support for various WINBOND SPI Nand flash chips

config MTD_SPI_NAND_XINCUN
	bool "XINCUN SPI flash support"
	default y if MTD_SPI_NAND_DEVICE_AUTOSELECT
	help
	  Add support for various XINCUN SPI Nand flash chips

config MTD_SPI_NAND_XTX
	bool "XTX SPI flash support"
	default y if MTD_SPI_NAND_DEVICE_AUTOSELECT
	select MTD_SPI_NAND_MICRON
	help
	  Add support for various XTX SPI Nand flash chips

config MTD_SPI_NAND_ZBIT
	bool "ZBIT SPI flash support"
	default y if MTD_SPI_NAND_DEVICE_AUTOSELECT
	help
	  Add support for various ZBIT SPI Nand flash chips

endmenu

endif
```

## drivers/mtd/spi-nor/Kconfig.spinorlist
```kconfig
# SPDX-License-Identifier: GPL-2.0-only

if MTD_SPI_NOR

config MTD_SPI_NOR_DEVICE_AUTOSELECT
	bool "Autoselect SPI Nor flash"
	default y
	help
	  By default, auto-selects all SPI Nor flash chips.

menu "SPI Nor flash"
	visible if !MTD_SPI_NOR_DEVICE_AUTOSELECT

config MTD_SPI_NOR_ATMEL
	bool "Atmel SPI flash support"
	default y if MTD_SPI_NOR_DEVICE_AUTOSELECT
	help
	  Add support for various Atmel SPI flash chips (AT45xxx and AT25xxx)

config MTD_SPI_NOR_BOYA
	bool "BOYA SPI flash support"
	default y if MTD_SPI_NOR_DEVICE_AUTOSELECT
	help
	  Add support for various BOYA SPI flash chips (BY25xxx)

config MTD_SPI_NOR_CATALYST
	bool "CATALYST SPI flash support"
	default y if MTD_SPI_NOR_DEVICE_AUTOSELECT
	help
	  Add support for various CATALYST SPI flash chips (cat25xxx)

config MTD_SPI_NOR_DOSILICON
	bool "DOSILICON SPI flash support"
	default y if MTD_SPI_NOR_DEVICE_AUTOSELECT
	help
	  Add support for various DOSILICON SPI flash chips (FM25xxx)

config MTD_SPI_NOR_EON
	bool "EON SPI flash support"
	default y if MTD_SPI_NOR_DEVICE_AUTOSELECT
	help
	  Add support for various EON SPI flash chips (EN25xxx)

config MTD_SPI_NOR_ESMT
	bool "ESMT SPI flash support"
	default y if MTD_SPI_NOR_DEVICE_AUTOSELECT
	help
	  Add support for various ESMT SPI flash chips (F25xxx and EN25)

config MTD_SPI_NOR_EVERSPIN
	bool "EVERSPIN SPI flash support"
	default y if MTD_SPI_NOR_DEVICE_AUTOSELECT
	help
	  Add support for various EVERSPIN SPI flash chips (mrxxx)

config MTD_SPI_NOR_FMSH
	bool "FMSH SPI flash support"
	default y if MTD_SPI_NOR_DEVICE_AUTOSELECT
	help
	  Add support for various FMSH SPI flash chips (FM25xxx)

config MTD_SPI_NOR_FUJITSU
	bool "FUJITSU SPI flash support"
	default y if MTD_SPI_NOR_DEVICE_AUTOSELECT
	help
	  Add support for various FUJITSU SPI flash chips (MB85xxx)

config MTD_SPI_NOR_GIGADEVICE
	bool "GigaDevice SPI flash support"
	default y if MTD_SPI_NOR_DEVICE_AUTOSELECT
	help
	  Add support for various GigaDevice SPI flash chips (GD25xxx)

config MTD_SPI_NOR_INTEL
	bool "INTEL SPI flash support"
	default y if MTD_SPI_NOR_DEVICE_AUTOSELECT
	help
	  Add support for various INTEL SPI flash chips

config MTD_SPI_NOR_ISSI
	bool "ISSI SPI flash support"
	default y if MTD_SPI_NOR_DEVICE_AUTOSELECT
	help
	  Add support for various ISSI SPI flash chips (ISxxx)

config MTD_SPI_NOR_MACRONIX
	bool "Macronix SPI flash support"
	default y if MTD_SPI_NOR_DEVICE_AUTOSELECT
	help
	  Add support for various Macronix SPI flash chips (MX25Lxxx)

config MTD_SPI_NOR_NORMEM
	bool "NORMEM SPI flash support"
	default y if MTD_SPI_NOR_DEVICE_AUTOSELECT
	help
	  Add support for various NORMEM SPI flash chips (NM25xxx)

config MTD_SPI_NOR_PUYA
	bool "PUYA SPI flash support"
	default y if MTD_SPI_NOR_DEVICE_AUTOSELECT
	help
	  Add support for various PUYA SPI flash chips (PY25xxx)

config MTD_SPI_NOR_SPANSION
	bool "Spansion SPI flash support"
	default y if MTD_SPI_NOR_DEVICE_AUTOSELECT
	help
	  Add support for various Spansion SPI flash chips (S25FLxxx)

config MTD_SPI_NOR_STMICRO
	bool "STMicro SPI flash support"
	default y if MTD_SPI_NOR_DEVICE_AUTOSELECT
	help
	  Add support for various STMicro SPI flash chips (M25Pxxx and N25Qxxx)

config MTD_SPI_NOR_SST
	bool "SST SPI flash support"
	default y if MTD_SPI_NOR_DEVICE_AUTOSELECT
	help
	  Add support for various SST SPI flash chips (SST25xxx)

config MTD_SPI_NOR_WINBOND
	bool "Winbond SPI flash support"
	default y if MTD_SPI_NOR_DEVICE_AUTOSELECT
	help
	  Add support for various WINBOND SPI flash chips (W25xxx)

config MTD_SPI_NOR_XILINX
	bool "XILINX SPI flash support"
	default y if MTD_SPI_NOR_DEVICE_AUTOSELECT
	help
	  Add support for various XILINX SPI flash chips (3Sxxx)

config MTD_SPI_NOR_XMC
	bool "XMC SPI flash support"
	default y if MTD_SPI_NOR_DEVICE_AUTOSELECT
	help
	  Add support for various XMC SPI flash chips (XM25xxx)

config MTD_SPI_NOR_XTX
	bool "XTX SPI flash support"
	default y if MTD_SPI_NOR_DEVICE_AUTOSELECT
	help
	  Add support for various XTX SPI flash chips (XT25xxx)

config MTD_SPI_NOR_ZBIT
	bool "ZBIT SPI flash support"
	default y if MTD_SPI_NOR_DEVICE_AUTOSELECT
	help
	  Add support for various ZBIT SPI flash chips (XT25xxx)

endmenu

endif # MTD_SPI_NOR
```

## drivers/net/ethernet/motorcomm/Kconfig
```kconfig
# SPDX-License-Identifier: GPL-2.0-only
config NET_VENDOR_MOTORCOMM
	bool "Motorcomm devices"
	default y
	help
	  If you have a network (Ethernet) device belonging to this class, say Y.

	  Note that the answer to this question doesn't directly affect the
	  kernel: saying N will just cause the configurator to skip all
	  the questions about motorcomm devices. If you say Y, you will be asked
	  for your specific device in the following questions.

if NET_VENDOR_MOTORCOMM

config FUXI
	tristate "motorcomm fuxi Ethernet support"

endif #NET_VENDOR_MOTORCOMM
```
