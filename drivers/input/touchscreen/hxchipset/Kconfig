## drivers/net/lte/Kconfig
```kconfig
#
# LTE network device configuration
#

menuconfig LTE
	bool "Rockchip LTE support"
	help
	Enable LTE drivers for Rockchip platform.

if LTE
config LTE_RM310
	bool "LTE rm310 support"
	default n

config LTE_EM05
	bool "LTE em05 support"
	default n

endif
```

## drivers/net/wireless/aic8800_sdio/Kconfig
```kconfig
config AIC_WLAN_SUPPORT
	bool "AIC wireless Support"
	default n
	help
	  This is support for aic wireless chip.

config AIC_FW_PATH
	depends on AIC_WLAN_SUPPORT
	string "Firmware & config file path"
	default "/lib/firmware/aic8800/SDIO/aic8800D80/"
	help
	  Path to the firmware & config file.

if AIC_WLAN_SUPPORT
source "drivers/net/wireless/aic8800_sdio/aic8800_fdrv/Kconfig"
source "drivers/net/wireless/aic8800_sdio/aic8800_btlpm/Kconfig"
endif
```
