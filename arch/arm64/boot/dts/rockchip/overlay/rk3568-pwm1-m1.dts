/dts-v1/;
/plugin/;

/ {
	metadata {
		title = "Enable PWM1-M1";
		compatible = "radxa,rock-3a", "radxa,rock-3b", "radxa,cm3-io", "radxa,cm3-rpi-cm4-io", "radxa,cm3s-io", "radxa,radxa-cm3-sodimm-io", "radxa,e23";
		category = "misc";
		exclusive = "GPIO0_B5";
		description = "Enable PWM1-M1.
On Radxa ROCK 3A <= v1.2 this pin 28
On Radxa ROCK 3A >= v1.3 this is pin 7.
On Radxa ROCK 3B this is pin 7.
On Radxa CM3 IO this is pin 5.
On Radxa CM3 RPI CM4 this is on pin 5.
On Radxa CM3S IO this is pin 13.
On Radxa E23 this is pin 28.";
	};
};

&pwm1 {
	status = "okay";
	pinctrl-names = "active";
	pinctrl-0 = <&pwm1m1_pins>;
};
