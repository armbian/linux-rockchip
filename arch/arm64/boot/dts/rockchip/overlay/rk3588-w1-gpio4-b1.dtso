/dts-v1/;
/plugin/;

#include <dt-bindings/gpio/gpio.h>
#include <dt-bindings/pinctrl/rockchip.h>

/ {
	metadata {
		title = "Enable 1-Wire on GPIO4_B1";
		compatible = "radxa,rock-5a";
		category = "misc";
		exclusive = "GPIO4_B1";
		description = "Enable 1-Wire on GPIO4_B1.\nOn Radxa ROCK 5A this is pin 40.";
	};

	fragment@0 {
		target-path = "/";

		__overlay__ {
			w1: onewire@0 {
				compatible = "w1-gpio";
				gpios = <&gpio4 RK_PB1 GPIO_ACTIVE_HIGH>;
				status = "okay";
			};
		};
	};
};
