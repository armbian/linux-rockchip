/dts-v1/;
/plugin/;

/ {
	metadata {
		title = "Enable PWM1-M2";
		compatible = "radxa,rock-5a";
		category = "misc";
		exclusive = "GPIO1_A3";
		description = "Enable PWM1-M2.\nOn Radxa ROCK 5A this is pin 24.";
	};

	fragment@0 {
		target = <&pwm1>;

		__overlay__ {
			status = "okay";
			pinctrl-0 = <&pwm1m2_pins>;
		};
	};
};
