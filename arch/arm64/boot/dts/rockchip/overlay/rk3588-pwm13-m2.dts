/dts-v1/;
/plugin/;

/ {
	metadata {
		title = "Enable PWM13-M2";
		compatible = "radxa,rock-5b";
		category = "misc";
		exclusive = "GPIO1_B7";
		description = "Enable PWM13-M2.\nOn Radxa ROCK 5B this is pin 31.";
	};

	fragment@0 {
		target = <&pwm13>;

		__overlay__ {
			status = "okay";
			pinctrl-0 = <&pwm13m2_pins>;
		};
	};
};
