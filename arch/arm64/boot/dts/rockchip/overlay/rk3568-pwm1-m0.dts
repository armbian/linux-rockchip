/dts-v1/;
/plugin/;

/ {
	metadata {
		title = "Enable PWM1-M0";
		compatible = "radxa,rock-3a", "radxa,rock-3b";
		category = "misc";
		exclusive = "GPIO0_C0";
		description = "Enable PWM1-M0.
On Radxa ROCK 3A <= v1.2 this is pin 15.
On Radxa ROCK 3A >= v1.3 this is pin 15.
On Radxa ROCK 3B this is pin 15.";
	};
};

&pwm1 {
	status = "okay";
	pinctrl-names = "active";
	pinctrl-0 = <&pwm1m0_pins>;
};
