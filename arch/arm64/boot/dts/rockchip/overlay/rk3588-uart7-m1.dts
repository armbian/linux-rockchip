/dts-v1/;
/plugin/;

/ {
	metadata {
		title = "Enable UART7-M1";
		compatible = "radxa,rock-5b";
		category = "misc";
		exclusive = "GPIO3_C1", "GPIO3_C0"; 
		description = "Enable UART7-M1.\nOn Radxa ROCK 5B this is RX pin 11 and TX pin 15.";
	};

	fragment@0 {
		target = <&uart7>;

		__overlay__ {
			status = "okay";
			pinctrl-0 = <&uart7m1_xfer>;
		};
	};
};
