/dts-v1/;
/plugin/;

/ {
	fragment@0 {
		target = <&sata2>;

		__overlay__ {
			status = "okay";
		};
	};

	fragment@1 {
		target = <&pcie2x1l1>;

		__overlay__ {
			status = "disabled";
		};
	};
};

