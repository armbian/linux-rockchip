#include "rock-5a-okdo-5mp-camera.dts"

/ {
	metadata {
		title ="Enable OKDO 5MP Camera on the Camera connector";
		compatible = "radxa,rock-5d";
		description = "Enable OKDO 5MP Camera on the Camera connector.
The Camera connector is located on the bottom of the board.
This is not the top MIPI-RX* connectors.
";
	};
};
