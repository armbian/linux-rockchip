/dts-v1/;
/plugin/;

/ {
	metadata {
		title = "Enable I2C8-M2";
		compatible = "radxa,rock-5a";
		category = "misc";
		exclusive = "GPIO1_D6", "GPIO1_D7";
		description = "Enable I2C8-M2.\nOn Radxa ROCK 5A this is SDA pin 3 and SCL pin 5.";
	};

	fragment@0 {
		target = <&i2c8>;

		__overlay__ {
			status = "okay";
			pinctrl-0 = <&i2c8m2_xfer>;
		};
	};
};
