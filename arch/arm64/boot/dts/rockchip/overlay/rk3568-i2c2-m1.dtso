/dts-v1/;
/plugin/;

/ {
	metadata {
		title = "Enable I2C2-M1";
		compatible = "radxa,cm3-io", "radxa,cm3-rpi-cm4-io", "radxa,cm3s-io", "radxa,radxa-cm3-sodimm-io";
		category = "misc";
		exclusive = "GPIO4_B4", "GPIO4_B5", "i2c2_pinctrl-0";
		description = "Enable I2C2-M1.
On Radxa CM3 IO this is SDA pin 27 and SCL pin 28.
On Radxa CM3 RPI CM4 IO this is SDA pin 27 and SCL pin 28.
On Radxa CM3S IO this is SDA pin 27 and SCL pin 28.";
	};
};

&i2c2 {
	status = "okay";
	pinctrl-names = "default";
	pinctrl-0 = <&i2c2m1_xfer>;
};
