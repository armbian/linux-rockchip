/dts-v1/;
/plugin/;

/ {
	metadata {
		title = "Enable UART7-M2";
		compatible = "radxa,rock-5a", "radxa,rock-5b";
		category = "misc";
		exclusive= "GPIO1_B5", "GPIO1_B4";
		description = "Enable UART7-M2.\nOn Radxa ROCK 5A this is TX pin 22 and RX pin 33.\nOn Radxa ROCK 5B this is TX pin 26 and this RX pin 24.";
	};

	fragment@0 {
		target = <&uart7>;

		__overlay__ {
			status = "okay";
			pinctrl-0 = <&uart7m2_xfer>;
		};
	};
};
