/dts-v1/;
/plugin/;

#include <dt-bindings/clock/rk3568-cru.h>

/ {
	metadata {
		title = "Enable CAN1-M0";
		compatible = "radxa,rock-3a", "radxa,rock-3b", "radxa,e25";
		category = "misc";
		exclusive = "GPIO1_A0", "GPIO1_A1";
		description = "Enable CAN1-M0.
On Radxa ROCK 3A <= v1.2 this is RX pin 3 & TX pin 5.
On Radxa ROCK 3A >= v1.3 this is RX pin 3 & TX pin 5.
On Radxa ROCK 3B this is RX pin 3 & TX pin 5.
On Radxa E25 this is RX pin 3 & TX pin 5";
	};
};

&can1 {
	status = "okay";
	compatible = "rockchip,can-1.0";
	assigned-clocks = <&cru CLK_CAN1>;
	assigned-clock-rates = <200000000>;
	pinctrl-names = "default";
	pinctrl-0 = <&can1m0_pins>;
};
