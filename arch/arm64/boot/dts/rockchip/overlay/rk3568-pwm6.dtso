/dts-v1/;
/plugin/;

/ {
	metadata {
		title = "Enable PWM6";
		compatible = "radxa,cm3-io", "radxa,cm3-rpi-cm4-io", "radxa,cm3s-io", "radxa,radxa-cm3-sodimm-io", "radxa,e23";
		category = "misc";
		exclusive = "GPIO0_C5";
		description = "Enable PWM6.
On Radxa CM3 IO this is on pin 31.
On Radxa CM3 RPI CM4 this is on pin 31.
On Radxa CM3S IO this is on pin 22.
On Radxa E23 this is pin 7.";
	};
};

&pwm6 {
	status = "okay";
	pinctrl-names = "active";
	pinctrl-0 = <&pwm6_pins>;
};
