/dts-v1/;
/plugin/;

/ {
	metadata {
		title = "Enable spidev on SPI0-M2 over CS1";
		compatible = "radxa,rock-5a", "radxa,rock-5b";
		category = "misc";
		exclusive = "GPIO1_B2", "GPIO1_B1", "GPIO1_B3", "GPIO1_B5";
		description = "Enable spidev on SPI0-M2 over CS1.";
	};

	fragment@0 {
		target = <&spi0>;

		__overlay__ {
			status = "okay";
			#address-cells = <1>;
			#size-cells = <0>;
			pinctrl-names = "default";
			pinctrl-0 = <&spi0m2_cs1 &spi0m2_pins>;
			max-freq = <50000000>;

			spidev@1 {
				compatible = "rockchip,spidev";
				status = "okay";
				reg = <1>;
				spi-max-frequency = <50000000>;
			};
		};
	};
};
