// SPDX-License-Identifier: (GPL-2.0+ OR MIT)

/dts-v1/;
/plugin/;
#include <dt-bindings/pinctrl/rockchip.h>
#include <dt-bindings/gpio/gpio.h>

/ {
	fragment@0 {
		target = <&pwm2_8ch_3>;

		__overlay__ {
			status = "okay";
			pinctrl-names = "active";
			pinctrl-0 = <&pwm2m1_ch3>;
		};
	};

	fragment@1 {
		target = <&i2c6>;

		__overlay__ {
			status = "disabled";
		};
	};
};
