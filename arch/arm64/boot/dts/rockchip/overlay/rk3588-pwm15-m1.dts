/dts-v1/;
/plugin/;

/ {
	metadata {
		title = "Enable PWM15-M1";
		compatible = "radxa,rock-5a", "radxa,rock-5b";
		category = "misc";
		exclusive = "GPIO4_B3";
		description = "Enable PWM15-M1.\nOn Radxa ROCK 5A this is pin 11.\nOn Radxa ROCK 5B this is pin 3.";
	};

	fragment@0 {
		target = <&pwm15>;

		__overlay__ {
			status = "okay";
			pinctrl-0 = <&pwm15m1_pins>;
		};
	};
};
