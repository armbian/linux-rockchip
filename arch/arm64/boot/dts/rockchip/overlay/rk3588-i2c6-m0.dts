/dts-v1/;
/plugin/;

/ {
	metadata {
		title = "Enable I2C6-M0";
		compatible = "radxa,rock-5a";
		category = "misc";
		exclusive = "GPIO0_C7", "GPIO0_D0";
		description = "Enable I2C6-M0.\nOn Radxa ROCK 5A this is SDA pin 27 and SCL pin 28.";
	};

	fragment@0 {
		target = <&i2c6>;

		__overlay__ {
			status = "okay";
			pinctrl-0 = <&i2c6m0_xfer>;
		};
	};
};
