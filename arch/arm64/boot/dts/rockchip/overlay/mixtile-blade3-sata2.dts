/dts-v1/;
/plugin/;

/ {
	metadata {
		title = "mini-PCIe socket as SATA";
		compatible = "mixtile,blade3";
		category = "misc";
		exclusive = "combphy2_psu";
		description = "Enable SATA2 on the mini-PCIe socket.\nWhen SATA2 is enabled, PCIe cannot be enabled on the same port.";
	};

	fragment@0 {
		target = <&pcie2x1l1>;

		__overlay__ {
			status = "disabled";
		};
	};

	fragment@1 {
		target = <&sata2>;

		__overlay__ {
			status = "okay";
		};
	};
};
