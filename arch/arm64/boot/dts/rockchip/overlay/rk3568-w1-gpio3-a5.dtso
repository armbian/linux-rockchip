/dts-v1/;
/plugin/;

#include <dt-bindings/gpio/gpio.h>
#include <dt-bindings/pinctrl/rockchip.h>

/ {
	metadata {
		title = "Enable 1-Wire on GPIO3_A5";
		compatible = "radxa,rock-3a", "radxa,rock-3b", "radxa,rock-3c";
		category = "misc";
		exclusive = "GPIO3_A5";
		description = "Enable 1-Wire on GPIO3_A5.
On Radxa ROCK 3A this is pin 40.
On Radxa ROCK 3B this is pin 40.
On Radxa ROCK 3C this is pin 40.";
	};
};

&{/} {
	w1: onewire {
		compatible = "w1-gpio";
		gpios = <&gpio3 RK_PA5 GPIO_ACTIVE_HIGH>;
		status = "okay";
	};
};
