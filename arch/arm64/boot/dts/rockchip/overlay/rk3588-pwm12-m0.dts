/dts-v1/;
/plugin/;

/ {
	metadata {
		title = "Enable PWM12-M0";
		compatible = "radxa,rock-5b";
		category = "misc";
		exclusive = "GPIO3_B5";
		description = "Enable PWM12-M0.\nOn Radxa ROCK 5B this is pin 12.";
	};

	fragment@0 {
		target = <&pwm12>;

		__overlay__ {
			status = "okay";
			pinctrl-0 = <&pwm12m0_pins>;
		};
	};
};
