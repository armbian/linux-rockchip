/dts-v1/;
/plugin/;

/ {
	metadata {
		title = "Enable UART8-M0";
		compatible = "radxa,rock-5a";
		category = "misc";
		exclusive= "GPIO4_B0", "GPIO4_B1";
		description = "Enable UART8-M0.\nOn Radxa ROCK 5A this is TX pin 32 and RX pin 40.";
	};

	fragment@0 {
		target = <&uart8>;

		__overlay__ {
			status = "okay";
			pinctrl-0 = <&uart8m0_xfer>;
		};
	};
};
