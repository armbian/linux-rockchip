/dts-v1/;
/plugin/;

/ {
	metadata {
		title = "Set OTG port to Host mode";
		compatible = "rockchip,rk3588";
		category = "misc";
		exclusive = "usbdrd_dwc3-dr_mode";
		description = "Set OTG port to Host mode.\nUse this when you want to connect USB devices.";
	};

	fragment@0 {
		target = <&usbdrd_dwc3_0>;

		__overlay__ {
			status = "okay";
			dr_mode = "host";
		};
	};
};
