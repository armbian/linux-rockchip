/dts-v1/;
/plugin/;

/ {
	metadata {
		title = "Enable UART3-M1";
		compatible = "radxa,e25";
		category = "misc";
		exclusive = "GPIO3_B7", "GPIO3_C0", "UART3";
		description = "Enable UART3-M1.
On Radxa ROCK 3A <= v1.2 this RX pin 37 & TX pin 7.
On Radxa E25 this RX pin 26 & TX pin 7.";
	};
};

&uart3 {
	status = "okay";
	pinctrl-names = "default";
	pinctrl-0 = <&uart3m1_xfer>;
};
