/dts-v1/;
/plugin/;

/ {
	metadata {
		title = "Enable I2C3-M1";
		compatible = "radxa,rock-5b";
		category = "misc";
		exclusive = "GPIO3_B7", "GPIO3_C0";
		description = "Enable I2C3-M1.\nOn Radxa ROCK 5B this is SDA pin 15 and this is SCL pin 13.";
	};

	fragment@0 {
		target = <&i2c3>;

		__overlay__ {
			status = "okay";
			pinctrl-0 = <&i2c3m1_xfer>;
		};
	};
};
