// ROCK 3C USB OTG
/dts-v1/;
/plugin/;

/ {
	metadata {
		title = "Set OTG port to be controlled by hardware switch";
		compatible = "radxa,rock-3a", "radxa,rock-3b", "radxa,e25";
		category = "misc";
		exclusive = "usbdrd_dwc3-dr_mode";
		description = "Set OTG port to be controlled by hardware switch.";
	};
};

&usbdrd_dwc3 {
	status = "okay";
	dr_mode = "otg";
};
