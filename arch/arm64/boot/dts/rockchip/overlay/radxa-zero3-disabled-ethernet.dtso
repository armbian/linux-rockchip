/dts-v1/;
/plugin/;

#include <dt-bindings/gpio/gpio.h>
#include <dt-bindings/pinctrl/rockchip.h>


/ {
	metadata {
		title = "Disabled Zero 3W Ethernet";
		compatible = "radxa,zero3";
		category = "misc";
		description = "Disabled Zero 3W Ethernet.";
	};

	fragment@0 {
		target = <&mdio1>;

		__overlay__ {
			status = "disabled";
		};
	};

	fragment@1 {
		target = <&gmac1>;

		__overlay__ {
			status = "disabled";
		};
	};
};
