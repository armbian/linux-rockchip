/dts-v1/;
/plugin/;

/ {
	metadata {
		title = "Enable I2C1-M0";
		compatible = "radxa,rock-5a", "radxa,rock-5b";
		category = "misc";
		exclusive = "GPIO0_B5", "GPIO0_B6";
		description = "Enable I2C1-M0.\nOn Radxa ROCK 5A this is SDA pin 10 and SCL pin 8.\nOn Radxa ROCK 5B this is SDA pin 10 and SCL pin 8.";
	};

	fragment@0 {
		target = <&fiq_debugger>;

		__overlay__ {
			status = "disabled";
		};
	};

	fragment@1 {
		target = <&i2c1>;

		__overlay__ {
			status = "okay";
			pinctrl-0 = <&i2c1m0_xfer>;
		};
	};
};
