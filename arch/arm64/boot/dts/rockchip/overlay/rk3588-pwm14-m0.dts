/dts-v1/;
/plugin/;

/ {
	metadata {
		title = "Enable PWM14-M0";
		compatible = "radxa,rock-5b";
		category = "misc";
		exclusive = "GPIO3_C2";
		description = "Enable PWM14-M0.\nOn Radxa ROCK 5B this is pin 32";
	};

	fragment@0 {
		target = <&pwm14>;

		__overlay__ {
			status = "okay";
			pinctrl-0 = <&pwm14m0_pins>;
		};
	};
};
