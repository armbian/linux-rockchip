/dts-v1/;
/plugin/;

/ {
	metadata {
		title = "Enable spidev on SPI0-M2 over CS0";
		compatible = "radxa,rock-5a", "radxa,rock-5b";
		category = "misc";
		exclusive = "GPIO1_B3", "GPIO1_B2", "GPIO1_B1", "GPIO1_B4";
		description = "Enable spidev on SPI0-M2 over CS0.";
	};

	fragment@0 {
		target = <&spi0>;

		__overlay__ {
			status = "okay";
			#address-cells = <1>;
			#size-cells = <0>;
			pinctrl-names = "default";
			pinctrl-0 = <&spi0m2_cs0 &spi0m2_pins>;
			max-freq = <50000000>;

			spidev@0 {
				compatible = "rockchip,spidev";
				status = "okay";
				reg = <0>;
				spi-max-frequency = <50000000>;
			};
		};
	};
};
