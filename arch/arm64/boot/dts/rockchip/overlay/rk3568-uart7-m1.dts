/dts-v1/;
/plugin/;

/ {
	metadata {
		title = "Enable UART7-M1";
		compatible = "radxa,rock-3a", "radxa,rock-3b";
		category = "misc";
		exclusive = "GPIO3_C4", "GPIO3_C5";
		description = "Enable UART7-M1.
On Radxa ROCK 3A <= v1.2 this is TX pin 11 & RX pin 13.
On Radxa ROCK 3A >= v1.3 this is TX pin 11 & RX pin 13.
On Radxa ROCK 3B this is TX pin 11 & RX pin 13.";
	};
};

&uart7 {
	status = "okay";
	pinctrl-names = "default";
	pinctrl-0 = <&uart7m1_xfer>;
};
