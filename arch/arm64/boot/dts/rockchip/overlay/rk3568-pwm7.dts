/dts-v1/;
/plugin/;

/ {
	metadata {
		title = "Enable PWM7";
		compatible = "radxa,cm3-io", "radxa,cm3-rpi-cm4-io", "radxa,cm3s-io", "radxa,radxa-cm3-sodimm-io", "radxa,e23", "radxa,e25";
		category = "misc";
		exclusive = "GPIO0_C6";
		description = "Enable PWM7.
On Radxa CM3 IO this is on pin 33.
On Radxa CM3 RPI CM4 this is pin 33.
On Radxa CM3S IO this is on pin 18.
On Radxa E23 this is on pin 15.
On Radxa E25 this is on pin 18.";
	};
};

&pwm7 {
	status = "okay";
	pinctrl-names = "active";
	pinctrl-0 = <&pwm7_pins>;
};
