/dts-v1/;
/plugin/;

/ {
	metadata {
		title = "Enable spidev on SPI1-M1 over CS0";
		compatible = "radxa,cm3s-io", "radxa,radxa-cm3-sodimm-io", "radxa,e25";
		category = "misc";
		exclusive = "GPIO3_B7", "GPIO3_C0", "GPIO3_C1", "GPIO3_C3", "GPIO3_A1", "GPIO3_C2";
		description = "Enable spidev on SPI1-M1 over CS0.";
	};
};

&spi1 {
	status = "okay";
	#address-cells = <1>;
	#size-cells = <0>;
	pinctrl-names = "default", "high_speed";
	pinctrl-0 = <&spi1m1_cs0 &spi1m1_pins>;
	pinctrl-1 = <&spi1m1_cs0 &spi1m1_pins_hs>;
	max-freq = <50000000>;

	spidev@0 {
		compatible = "rockchip,spidev";
		status = "okay";
		reg = <0>;
		spi-max-frequency = <50000000>;
	};
};
