/dts-v1/;
/plugin/;

/ {
	metadata {
		title = "Enable spidev on SPI0-M1 over CS0";
		compatible = "radxa,rock-5a";
		category = "misc";
		exclusive = "GPIO4_A2", "GPIO4_A1", "GPIO4_A0", "GPIO4_B2";
		description = "Enable spidev on SPI0-M1 over CS0.";
	};

	fragment@0 {
		target = <&spi0>;

		__overlay__ {
			status = "okay";
			#address-cells = <1>;
			#size-cells = <0>;
			pinctrl-names = "default";
			pinctrl-0 = <&spi0m1_cs0 &spi0m1_pins>;
			max-freq = <50000000>;

			spidev@0 {
				compatible = "rockchip,spidev";
				status = "okay";
				reg = <0>;
				spi-max-frequency = <50000000>;
			};
		};
	};
};
