/dts-v1/;
/plugin/;

/ {
	metadata {
		title = "Enable PWM3";
		compatible = "radxa,cm3-io", "radxa,cm3-rpi-cm4-io";
		category = "misc";
		exclusive = "GPIO0_C2";
		description = "Enable PWM3.
On Radxa CM3 IO this is pin 37.
On Radxa CM3 RPI CM4 this is on pin 37.";
	};
};

&pwm3 {
	status = "okay";
	pinctrl-names = "active";
	pinctrl-0 = <&pwm3_pins>;
};
