/dts-v1/;
/plugin/;

/ {
	metadata {
		title = "Enable FIQ Debugger on UART7-M1";
		compatible = "radxa,rock-3b", "radxa,e25";
		category = "misc";
		description = "Enable FIQ Debugger on UART7-M1.
On Radxa ROCK 3B this is TX pin 11 and RX pin 13.
On Radxa E25 this is TX pin 11 and RX pin 13.";
	};
};

&fiq_debugger {
	status = "okay";
	rockchip,serial-id = <7>;
	pinctrl-names = "default";
	pinctrl-0 = <&uart7m1_xfer>;
};

&uart7 {
	status = "disabled";
};
