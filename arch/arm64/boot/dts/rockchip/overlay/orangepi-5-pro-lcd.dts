/dts-v1/;
/plugin/;

/ {
	fragment@0 {
		target = <&dsi1>;
		__overlay__ {
			status = "okay";
		};
	};

	fragment@1 {
		target = <&dsi1_panel>;
		__overlay__ {
			status = "okay";
		};
	};

	fragment@2 {
		target = <&dsi1_in_vp3>;
		__overlay__ {
			status = "okay";
		};
	};
};
