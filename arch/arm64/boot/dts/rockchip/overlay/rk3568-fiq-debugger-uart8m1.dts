/dts-v1/;
/plugin/;

/ {
	metadata {
		title = "Enable FIQ Debugger on UART8-M1";
		compatible = "unknown";
		category = "misc";
		description = "Enable FIQ Debugger on UART8-M1.
On Radxa ROCK 3B this is TX pin 29 & RX pin 31.";
	};
};

&fiq_debugger {
	status = "okay";
	rockchip,serial-id = <8>;
	pinctrl-names = "default";
	pinctrl-0 = <&uart8m1_xfer>;
};

&uart8 {
	status = "disabled";
};
