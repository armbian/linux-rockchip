// SPDX-License-Identifier: (GPL-2.0+ OR MIT)
/*
 * Copyright (c) 2026 Rockchip Electronics Co., Ltd.
 */

#include "rv1126b-evb1-v11-fastboot-emmc.dts"
#include "rv1126b-evb1-v12.dtsi"

/ {
	model = "Rockchip RV1126B EVB1 V12 Arm64 Fastboot Board";
	compatible = "rockchip,rv1126b-evb1-v12-fastboot", "rockchip,rv1126b";
};

&ramdisk_r {
	reg = <0x48c40000 (60 * 0x00100000)>;
};

&ramdisk_c {
	reg = <0x4c840000 (30 * 0x00100000)>;
};
