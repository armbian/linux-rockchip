// SPDX-License-Identifier: (GPL-2.0+ OR MIT)
/*
 * Copyright (c) 2023 Rockchip Electronics Co., Ltd.
 *
 */

/dts-v1/;
#include "rk3568-toybrick-sd0.dtsi"
#include "rk3568-linux.dtsi"
//#include "rk3568-toybrick-sd0-mipi-tx0.dtsi"
/delete-node/ &board_id;
/ {
	model = "Rockchip RK3568 Toybrick SD0 Board";
	compatible = "rockchip,rk3568-toybrick-sd0-linux","rockchip,rk3568";
};

&uart1 {
	status = "okay";
	pinctrl-names = "default";
	pinctrl-0 = <&uart1m0_xfer &uart1m0_ctsn &uart1m0_rtsn &uart1_pin>;
	uart-has-rtscts;

	bluetooth {
		compatible = "brcm,bcm4345c5";
		clocks = <&rk809 1>;
		clock-names = "txco";

		device-wakeup-gpios = <&gpio2 RK_PC1 GPIO_ACTIVE_HIGH>;
		host-wakeup-gpios = <&gpio2 RK_PC0 GPIO_ACTIVE_HIGH>;
		shutdown-gpios = <&gpio2 RK_PB7 GPIO_ACTIVE_HIGH>;
		max-speed = <1500000>;
	};
};

/delete-node/ &wireless_bluetooth;
