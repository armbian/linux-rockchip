// SPDX-License-Identifier: (GPL-2.0+ OR MIT)
/*
 * Copyright (c) 2021 Rockchip Electronics Co., Ltd.
 *
 */

/dts-v1/;

#include "rk3588s-9tripod-x3588s.dtsi"
#include "rk3588s-9tripod-x3588s-android.dtsi"
//#include "rk3588s-9tripod-x3588s-ov13855-dcphy0.dtsi"
//#include "rk3588s-9tripod-x3588s-ov13855-dcphy1.dtsi"
#include "rk3588s-9tripod-x3588s-imx415-dphy0.dtsi"

/ {
	model = "Indiedroid Nova";
	compatible = "9tripod,rk3588s-9tripod-x3588s", "rockchip,rk3588";
};
