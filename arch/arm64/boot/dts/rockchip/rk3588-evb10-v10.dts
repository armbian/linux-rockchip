// SPDX-License-Identifier: (GPL-2.0+ OR MIT)
/*
 * Copyright (c) 2025 Rockchip Electronics Co., Ltd.
 *
 */

/dts-v1/;

#include "rk3588-evb10.dtsi"
#include "rk3588-evb10-v10-imx415.dtsi"
#include "rk3588-android.dtsi"

/ {
	model = "Rockchip RK3588 EVB10 V10 Board";
	compatible = "rockchip,rk3588-evb10-v10", "rockchip,rk3588";
};
