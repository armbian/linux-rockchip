// SPDX-License-Identifier: (GPL-2.0+ OR MIT)
/*
 * Copyright (c) 2024 Rockchip Electronics Co., Ltd.
 *
 */

/dts-v1/;

#include "rk3576.dtsi"
#include "rk3576-evb2.dtsi"
#include "rk3576-evb2-rk628-bt1120-to-hdmi.dtsi"
#include "rk3576-evb2-rk628-hdmi2csi.dtsi"
#include "rk3576-linux.dtsi"

/ {
	model = "Rockchip RK3576 EVB2 V10 Linux Board";
	compatible = "rockchip,rk3576-evb2-v10", "rockchip,rk3576";
};
