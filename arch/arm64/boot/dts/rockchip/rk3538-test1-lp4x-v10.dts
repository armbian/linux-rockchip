// SPDX-License-Identifier: (GPL-2.0+ OR MIT)
/*
 * Copyright (c) 2025 Rockchip Electronics Co., Ltd.
 *
 */

#include "rk3538-test1-lp4x-v10.dtsi"
#include "rk3538-android.dtsi"

/ {
	model = "Rockchip RK3538 TEST1 LPDDR4X V10 Board";
	compatible = "rockchip,rk3538-test1-lp4x-v10", "rockchip,rk3538";
};
