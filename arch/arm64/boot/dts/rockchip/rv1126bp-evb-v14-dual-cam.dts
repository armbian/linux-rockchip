// SPDX-License-Identifier: (GPL-2.0+ OR MIT)
/*
 * Copyright (c) 2025 Rockchip Electronics Co., Ltd.
 */

/dts-v1/;
#include "rv1126bp.dtsi"
#include "rv1126bp-evb.dtsi"
#include "rv1126bp-evb-v14.dtsi"
#include "rv1126bp-evb-v14-dual-cam.dtsi"

/ {
	model = "Rockchip RV1126B-P EVB V14 Dual Camera Board";
	compatible = "rockchip,rv1126bp-evb-v14-dual-cam", "rockchip,rv1126b";
};
