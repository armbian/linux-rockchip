// SPDX-License-Identifier: (GPL-2.0+ OR MIT)
/*
 * Copyright (c) 2025 Rockchip Electronics Co., Ltd.
 *
 */

&sdhci {
	bus-width = <8>;
	no-sdio;
	no-sd;
	non-removable;
	max-frequency = <200000000>;
	mmc-hs400-1_8v;
	mmc-hs400-enhanced-strobe;
	full-pwr-cycle-in-suspend;
	pinctrl-0 = <&emmc_bus8_pins &emmc_cmd_pins &emmc_clk_pins &emmc_rstnout_pins &emmc_strb_pins>;
	pinctrl-names = "default";
	status = "okay";
};

&ufs {
	reset-gpios = <&gpio4 RK_PC0 GPIO_ACTIVE_HIGH>;
	status = "okay";
};
