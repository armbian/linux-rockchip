// SPDX-License-Identifier: (GPL-2.0+ OR MIT)
/*
 * Copyright (c) 2025 Rockchip Electronics Co., Ltd.
 */

#include "rv1126b-evb1-v10-spi-nor.dts"
#include "rv1126b-evb1-v11.dtsi"

/ {
	model = "Rockchip RV1126B EVB1 V11 Board";
	compatible = "rockchip,rv1126b-evb1-v11-spi-nor", "rockchip,rv1126b";

};

&fspi0 {
	status = "okay";

	flash@0 {
		compatible = "jedec,spi-nor";
		reg = <0>;
		spi-max-frequency = <75000000>;
		spi-rx-bus-width = <4>;
		spi-tx-bus-width = <1>;
	};
};
