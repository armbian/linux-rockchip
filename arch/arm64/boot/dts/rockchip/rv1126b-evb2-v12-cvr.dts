// SPDX-License-Identifier: (GPL-2.0+ OR MIT)
/*
 * Copyright (c) 2025 Rockchip Electronics Co., Ltd.
 */

/dts-v1/;
#include "rv1126b-evb2-v12.dts"

&dsi {
	status = "okay";
};

&dsi_in_vop {
	status = "okay";
};

&gmac {
	status = "okay";
};

&uart2 {
	status = "disabled";
};
