// SPDX-License-Identifier: (GPL-2.0+ OR MIT)
/*
 * Copyright (c) 2021 Rockchip Electronics Co., Ltd.
 *
 */

/dts-v1/;

#include "rk3588-evb3-lp5.dtsi"
#include "rk3588-linux.dtsi"
#include "rk3588-evb3-imx415.dtsi"

/ {
	model = "Rockchip RK3588 EVB3 LP5 V10 Board";
	compatible = "rockchip,rk3588-evb3-lp5-v10", "rockchip,rk3588";
};

&uart8 {
	status = "okay";
	pinctrl-names = "default";
	pinctrl-0 = <&uart8m1_xfer &uart8m1_ctsn &uart8m1_rtsn>;
	uart-has-rtscts;

	bluetooth {
		compatible = "brcm,bcm4345c5";
		clocks = <&hym8563>;
		clock-names = "txco";

		device-wakeup-gpios = <&gpio3 RK_PA1 GPIO_ACTIVE_HIGH>;
		host-wakeup-gpios = <&gpio3 RK_PA0 GPIO_ACTIVE_HIGH>;
		shutdown-gpios = <&gpio3 RK_PB1 GPIO_ACTIVE_HIGH>;
		max-speed = <1500000>;
	};
};

/delete-node/ &wireless_bluetooth;
