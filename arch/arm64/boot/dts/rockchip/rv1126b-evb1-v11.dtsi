// SPDX-License-Identifier: (GPL-2.0+ OR MIT)
/*
 * Copyright (c) 2025 Rockchip Electronics Co., Ltd.
 */

#include "rv1126b-evb1-v10.dtsi"

/ {
	model = "Rockchip RV1126B EVB1 V11 Board";
	compatible = "rockchip,rv1126b-evb1-v11", "rockchip,rv1126b";
};

&typec5v_pwren {
	rockchip,pins = <0 RK_PC5 RK_FUNC_GPIO &pcfg_pull_none>;
};

&vbus5v0_typec {
	gpio = <&gpio0 RK_PC5 GPIO_ACTIVE_HIGH>;
};
