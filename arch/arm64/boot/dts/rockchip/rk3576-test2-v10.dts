// SPDX-License-Identifier: (GPL-2.0+ OR MIT)
/*
 * Copyright (c) 2024 Rockchip Electronics Co., Ltd.
 *
 */

/dts-v1/;

#include "rk3576.dtsi"
#include "rk3576-test2.dtsi"
#include "rk3576-android.dtsi"
#include "rk3576-test2-cam-dcphy0.dtsi"

/ {
	model = "Rockchip RK3576 TEST2 V10 Board";
	compatible = "rockchip,rk3576-test2-v10", "rockchip,rk3576";
};
