// SPDX-License-Identifier: (GPL-2.0+ OR MIT)
/*
 * Copyright (c) 2024 Rockchip Electronics Co., Ltd.
 *
 */

&vcca_1v8_s0 {
	regulator-state-mem {
		regulator-on-in-suspend;
	};
};

&rk806 {
	pinctrl-1 = <&rk806_dvs1_slp>;
};

&rockchip_suspend {
	status = "okay";
	rockchip,sleep-debug-en = <1>;
	rockchip,virtual-poweroff = <1>;
	rockchip,virtual-poweroff-irqs = <132>;

	rockchip,sleep-mode-config = <
		(0
		| RKPM_SLP_ARMOFF_LOGOFF
		)
	>;
	rockchip,wakeup-config = <
		(0
		| RKPM_GPIO_WKUP_EN
		| RKPM_PWM_WKUP_EN
		)
	>;
	rockchip,sleep-io-ret-config = <
		(0
		| RKPM_VCCIO3_RET_EN
		)
	>;

	rockchip,regulator-on-before-mem = <&vdd_npu_s0>;
};
