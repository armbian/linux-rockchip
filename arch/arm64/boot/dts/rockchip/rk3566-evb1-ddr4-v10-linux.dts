// SPDX-License-Identifier: (GPL-2.0+ OR MIT)
/*
 * Copyright (c) 2020 Rockchip Electronics Co., Ltd.
 *
 */

#include "rk3566-evb1-ddr4-v10.dtsi"
#include "rk3568-linux.dtsi"

/ {
	model = "Rockchip RK3566 EVB1 DDR4 V10 Linux Board";
	compatible = "rockchip,rk3566-evb1-ddr4-v10-linux", "rockchip,rk3566";
};

&uart1 {
	status = "okay";
	pinctrl-names = "default";
	pinctrl-0 = <&uart1m1_xfer &uart1m1_ctsn &uart1m1_rtsn>;
	uart-has-rtscts;

	bluetooth {
		compatible = "brcm,bcm4345c5";

		device-wakeup-gpios = <&gpio4 RK_PA6 GPIO_ACTIVE_HIGH>;
		host-wakeup-gpios = <&gpio4 RK_PB1 GPIO_ACTIVE_HIGH>;
		shutdown-gpios = <&gpio4 RK_PA5 GPIO_ACTIVE_HIGH>;
		max-speed = <1500000>;
	};
};

/delete-node/ &wireless_bluetooth;
