// SPDX-License-Identifier: (GPL-2.0+ OR MIT)
/*
 * Copyright (c) 2025 Rockchip Electronics Co., Ltd.
 *
 */

#include "rk3539-iotest-lpddr3-v10.dtsi"
#include "rk3538-android.dtsi"

/ {
	model = "Rockchip RK3539 IOTEST LPDDR3 V10 Board";
	compatible = "rockchip,rk3539-iotest-lpddr3-v10", "rockchip,rk3539";
};
