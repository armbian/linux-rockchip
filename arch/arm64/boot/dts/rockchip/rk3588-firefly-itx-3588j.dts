// SPDX-License-Identifier: (GPL-2.0+ OR MIT)
/*
* Copyright (c) 2021 Rockchip Electronics Co., Ltd.
*
*/

/dts-v1/;

#include <dt-bindings/usb/pd.h>
#include "rk3588.dtsi"
#include "rk3588s.dtsi"
#include "rk3588-rk806-single.dtsi"
#include <dt-bindings/gpio/gpio.h>
#include <dt-bindings/pwm/pwm.h>
#include <dt-bindings/pinctrl/rockchip.h>
#include <dt-bindings/input/rk-input.h>
#include <dt-bindings/display/drm_mipi_dsi.h>
#include <dt-bindings/display/rockchip_vop.h>
#include <dt-bindings/sensor-dev.h>
#include "rk3588-linux.dtsi"


/ {
	model = "Firefly ITX-3588J HDMI(Linux)";
	compatible = "rockchip,rk3588-firefly-itx-3588j", "rockchip,rk3588";
	
	/delete-node/ chosen;
	
	adc_keys: adc-keys {
		status = "okay";
		compatible = "adc-keys";
		io-channels = <&saradc 1>;
		io-channel-names = "buttons";
		keyup-threshold-microvolt = <1800000>;
		poll-interval = <100>;
		
		recovery-key{
			label = "F12";
			linux,code = <KEY_F12>;
			press-threshold-microvolt = <10000>;
		};
	};
	
	bt_sco: bt-sco {
		status = "okay";
		compatible = "delta,dfbmcs320";
		#sound-dai-cells = <1>;
	};
	
	bt_sound: bt-sound {
		status = "okay";
		compatible = "simple-audio-card";
		simple-audio-card,format = "dsp_a";
		simple-audio-card,bitclock-inversion = <0>;
		simple-audio-card,mclk-fs = <256>;
		simple-audio-card,name = "rockchip,bt";
		simple-audio-card,cpu {
			sound-dai = <&i2s1_8ch>;
		};
		simple-audio-card,codec {
			sound-dai = <&bt_sco 1>;
		};
	};
	
	dp0_sound: dp0-sound {
		status = "okay";
		compatible = "rockchip,hdmi";
		rockchip,card-name= "rockchip-dp0";
		rockchip,mclk-fs = <512>;
		rockchip,cpu = <&spdif_tx2>;
		rockchip,codec = <&dp0 1>;
		rockchip,jack-det;
	};
	
	es8388_sound: es8388-sound {
		status = "okay";
		compatible = "firefly,multicodecs-card";
		firefly,not-use-dapm;
		rockchip,card-name = "rockchip-es8388";
		hp-det-gpio = <&gpio1 RK_PC4 GPIO_ACTIVE_LOW>;
		io-channels = <&saradc 3>;
		io-channel-names = "adc-detect";
		spk-con-gpio = <&gpio3 RK_PB2 GPIO_ACTIVE_HIGH>;
		hp-con-gpio = <&gpio4 RK_PB0 GPIO_ACTIVE_HIGH>;
		linein-type = <0>;
		rockchip,format = "i2s";
		rockchip,mclk-fs = <384>;
		rockchip,cpu = <&i2s0_8ch>;
		rockchip,codec = <&es8388>;
		rockchip,audio-routing =
		"Headphone", "LOUT1",
		"Headphone", "ROUT1",
		"Speaker", "LOUT2",
		"Speaker", "ROUT2",
		"Headphone", "Headphone Power",
		"Headphone", "Headphone Power",
		"Speaker", "Speaker Power",
		"Speaker", "Speaker Power",
		"LINPUT2", "Main Mic",
		"RINPUT2", "Main Mic",
		"LINPUT1", "Headset Mic",
		"RINPUT1", "Headset Mic";
		pinctrl-names = "default";
		pinctrl-0 = <&hp_det>;
	};
	
	hdmi0_sound: hdmi0-sound {
		status = "okay";
		compatible = "rockchip,hdmi";
		rockchip,mclk-fs = <128>;
		rockchip,card-name = "rockchip-hdmi0";
		rockchip,cpu = <&i2s5_8ch>;
		rockchip,codec = <&hdmi0>;
		rockchip,jack-det;
	};
	
	spdif_tx1_dc: spdif-tx1-dc {
		status = "disabled";
		compatible = "linux,spdif-dit";
		#sound-dai-cells = <0>;
	};
	
	spdif_tx1_sound: spdif-tx1-sound {
		status = "disabled";
		compatible = "simple-audio-card";
		simple-audio-card,mclk-fs = <128>;
		simple-audio-card,name = "rockchip,spdif-tx1";
		simple-audio-card,cpu {
			sound-dai = <&spdif_tx1>;
		};
		simple-audio-card,codec {
			sound-dai = <&spdif_tx1_dc>;
		};
	};
	
	test-power {
		status = "okay";
	};
	
	fan: pwm-fan {
		compatible = "pwm-fan";
		#cooling-cells = <2>;
		cooling-levels = <60 100 140 160 185 220 255>;
		fan-supply = <&vcc12v_dcin>;
		pwms = <&pwm15 0 50000 1>;
	};
	
	firefly_leds: leds {
		compatible = "gpio-leds";
		status = "okay";
		pinctrl-names = "default";
		pinctrl-0 =<&leds_gpio>;
		power_led: power {
			label = ":power";//green led
			linux,default-trigger = "ir-power-click";
			default-state = "on";
			gpios = <&gpio1 RK_PB3 GPIO_ACTIVE_HIGH>;
		};
		
		user_led: user {
			label = ":user";//yellow led
			linux,default-trigger = "ir-user-click";
			default-state = "off";
			gpios = <&pca9555 PCA_IO0_3 GPIO_ACTIVE_HIGH>;
		};
	};
	
	vcc_hub3_reset: vcc-hub3-reset-regulator {
		compatible = "regulator-fixed";
		regulator-name = "vcc_hub3_reset";
		regulator-always-on;
		enable-active-high;
		status = "okay";
		gpio = <&pca9555 PCA_IO0_6 GPIO_ACTIVE_HIGH>;//PCA_IO 06
	};
	
	vbus5v0_typec_pwr_en: vbus5v0-typec-pwr-en-regulator {
		compatible = "regulator-fixed";
		regulator-name = "vbus5v0_typec_pwr_en";
		enable-active-high;
		status = "okay";
		gpio = <&pca9555 PCA_IO1_4 GPIO_ACTIVE_HIGH>;//PCA_IO 14
	};
	
	vcc_hub_reset: vcc-hub-reset-regulator {
		compatible = "regulator-fixed";
		regulator-name = "vcc_hub_reset";
		regulator-boot-on;
		regulator-always-on;
		enable-active-high;
		status = "okay";
		gpio = <&pca9555 PCA_IO0_4 GPIO_ACTIVE_HIGH>;//PCA_IO 04
	};
	
	vcc12v_dcin: vcc12v-dcin {
		compatible = "regulator-fixed";
		regulator-name = "vcc12v_dcin";
		regulator-always-on;
		regulator-boot-on;
		regulator-min-microvolt = <12000000>;
		regulator-max-microvolt = <12000000>;
	};
	
	vcc5v0_host3: vcc5v0-host3 {
		compatible = "regulator-fixed";
		regulator-name = "vcc5v0_host3";
		regulator-boot-on;
		regulator-always-on;
		regulator-min-microvolt = <5000000>;
		regulator-max-microvolt = <5000000>;
		enable-active-high;
		gpio = <&pca9555 PCA_IO0_7 GPIO_ACTIVE_HIGH>;//PCA_IO 07
		vin-supply = <&vcc5v0_usb>;
		status = "okay";
	};
	
	vcc5v0_host: vcc5v0-host {
		compatible = "regulator-fixed";
		regulator-name = "vcc5v0_host";
		regulator-boot-on;
		regulator-always-on;
		regulator-min-microvolt = <5000000>;
		regulator-max-microvolt = <5000000>;
		enable-active-high;
		gpio = <&pca9555 PCA_IO0_5 GPIO_ACTIVE_HIGH>;
		vin-supply = <&vcc5v0_usb>;
		status = "okay";
	};
	
	vcc5v0_sys: vcc5v0-sys {
		compatible = "regulator-fixed";
		regulator-name = "vcc5v0_sys";
		regulator-always-on;
		regulator-boot-on;
		regulator-min-microvolt = <5000000>;
		regulator-max-microvolt = <5000000>;
		vin-supply = <&vcc12v_dcin>;
	};
	
	vcc5v0_usbdcin: vcc5v0-usbdcin {
		compatible = "regulator-fixed";
		regulator-name = "vcc5v0_usbdcin";
		regulator-always-on;
		regulator-boot-on;
		regulator-min-microvolt = <5000000>;
		regulator-max-microvolt = <5000000>;
		vin-supply = <&vcc12v_dcin>;
	};
	
	vcc5v0_usb: vcc5v0-usb {
		compatible = "regulator-fixed";
		regulator-name = "vcc5v0_usb";
		regulator-always-on;
		regulator-boot-on;
		regulator-min-microvolt = <5000000>;
		regulator-max-microvolt = <5000000>;
		vin-supply = <&vcc12v_dcin>;
	};
	
	vcc_1v1_nldo_s3: vcc-1v1-nldo-s3 {
		compatible = "regulator-fixed";
		regulator-name = "vcc_1v1_nldo_s3";
		regulator-always-on;
		regulator-boot-on;
		regulator-min-microvolt = <1100000>;
		regulator-max-microvolt = <1100000>;
		vin-supply = <&vcc5v0_sys>;
	};
	
	vcc_sata_pwr_en: vcc-sata-pwr-en-regulator {
		compatible = "regulator-fixed";
		regulator-name = "vcc_sata_pwr_en";
		regulator-boot-on;
		regulator-always-on;
		enable-active-high;
		status = "okay";
		gpio = <&pca9555 PCA_IO1_2 GPIO_ACTIVE_HIGH>;//PCA_IO 12
	};
	
	vcc_fan_pwr_en: vcc-fan-pwr-en-regulator {
		compatible = "regulator-fixed";
		regulator-name = "vcc_fan_pwr_en";
		regulator-boot-on;
		regulator-always-on;
		enable-active-high;
		status = "okay";
		gpio = <&pca9555 PCA_IO1_3 GPIO_ACTIVE_HIGH>;//PCA_IO 13
	};
	
	vcc_sdcard_pwr_en: vcc-sdcard-pwr-en-regulator {
		compatible = "regulator-fixed";
		regulator-name = "vcc_sdcard_pwr_en";
		regulator-boot-on;
		regulator-always-on;
		enable-active-high;
		gpio = <&pca9555 PCA_IO1_5 GPIO_ACTIVE_HIGH>;//PCA_IO 15
		status = "okay";
	};
	
	vcc3v3_pcie30: vcc3v3-pcie30 {
		compatible = "regulator-fixed";
		regulator-name = "vcc3v3_pcie30";
		regulator-min-microvolt = <3300000>;
		regulator-max-microvolt = <3300000>;
		enable-active-high;
		gpios = <&gpio2 RK_PC5 GPIO_ACTIVE_HIGH>;
		startup-delay-us = <5000>;
		vin-supply = <&vcc12v_dcin>;
		status = "okay";
	};
	
	pcie30_avdd1v8: pcie30-avdd1v8 {
		compatible = "regulator-fixed";
		regulator-name = "pcie30_avdd1v8";
		regulator-boot-on;
		regulator-always-on;
		regulator-min-microvolt = <1800000>;
		regulator-max-microvolt = <1800000>;
		vin-supply = <&avcc_1v8_s0>;
	};
	
	pcie30_avdd0v75: pcie30-avdd0v75 {
		compatible = "regulator-fixed";
		regulator-name = "pcie30_avdd0v75";
		regulator-boot-on;
		regulator-always-on;
		regulator-min-microvolt = <750000>;
		regulator-max-microvolt = <750000>;
		vin-supply = <&avdd_0v75_s0>;
	};
	
	hdmi1_sound: hdmi1-sound {
		status = "okay";
		compatible = "rockchip,hdmi";
		rockchip,mclk-fs = <128>;
		rockchip,card-name = "rockchip-hdmi1";
		rockchip,cpu = <&i2s6_8ch>;
		rockchip,codec = <&hdmi1>;
		rockchip,jack-det;
	};
	
	dp1_sound: dp1-sound {
		status = "disabled";
		compatible = "rockchip,hdmi";
		rockchip,card-name= "rockchip,dp1";
		rockchip,mclk-fs = <512>;
		rockchip,cpu = <&spdif_tx5>;
		rockchip,codec = <&dp1 1>;
		rockchip,jack-det;
	};
	
	wireless_bluetooth: wireless-bluetooth {
		compatible = "bluetooth-platdata";
		clocks = <&hym8563>;
		clock-names = "ext_clock";
		uart_rts_gpios = <&gpio1 RK_PA2 GPIO_ACTIVE_LOW>;
		pinctrl-names = "default", "rts_gpio";
		pinctrl-0 = <&uart6m1_rtsn>,  <&bt_reset_gpio>, <&bt_wake_gpio>, <&bt_irq_gpio>;
		pinctrl-1 = <&uart6_gpios>;
		BT,power_gpio    = <&gpio0 RK_PC6 GPIO_ACTIVE_HIGH>;
		BT,wake_gpio     = <&gpio0 RK_PC5 GPIO_ACTIVE_HIGH>;
		BT,wake_host_irq = <&gpio0 RK_PA0 GPIO_ACTIVE_HIGH>;
		status = "okay";
	};
	
	wireless_wlan: wireless-wlan {
		compatible = "wlan-platdata";
		wifi_chip_type = "ap6275p";
		pinctrl-names = "default";
		pinctrl-0 = <&wifi_poweren_gpio>;
		/delete-property/ WIFI,host_wake_irq;
		WIFI,poweren_gpio = <&gpio0 RK_PC4 GPIO_ACTIVE_HIGH>;
		status = "okay";
	};
	
	/* If hdmirx node is disabled, delete the reserved-memory node here. */
	reserved-memory {
		#address-cells = <2>;
		#size-cells = <2>;
		ranges;
		
		/* Reserve 256MB memory for hdmirx-controller@fdee0000 */
		cma {
			compatible = "shared-dma-pool";
			reusable;
			reg = <0x0 (256 * 0x100000) 0x0 (256 * 0x100000)>;
			linux,cma-default;
		};
	};
	
	hdmiin_sound: hdmiin-sound {
		compatible = "rockchip,hdmi";
		status = "okay";
		rockchip,mclk-fs = <128>;
		rockchip,format = "i2s";
		rockchip,bitclock-master = <&hdmirx_ctrler>;
		rockchip,frame-master = <&hdmirx_ctrler>;
		rockchip,card-name = "rockchip,hdmiin";
		rockchip,cpu = <&i2s7_8ch>;
		rockchip,codec = <&hdmirx_ctrler 0>;
		rockchip,jack-det;
	};
};

&av1d {
	status = "okay";
};

&av1d_mmu {
	status = "okay";
};

&can1 {
	status = "okay";
	assigned-clocks = <&cru CLK_CAN1>;
	assigned-clock-rates = <200000000>;
	pinctrl-names = "default";
	pinctrl-0 = <&can1m1_pins>;
};

/* sata pm */
&combphy0_ps {
	status = "okay";
};

&combphy1_ps {
	status = "okay";
};

&combphy2_psu {
	status = "okay";// USB3.1/SATA/PCIe Combo PHY
};

&cpu_l0 {
	cpu-supply = <&vdd_cpu_lit_s0>;
	mem-supply = <&vdd_cpu_lit_mem_s0>;
};

&cpu_b0 {
	cpu-supply = <&vdd_cpu_big0_s0>;
	mem-supply = <&vdd_cpu_big0_mem_s0>;
};

&cpu_b2 {
	cpu-supply = <&vdd_cpu_big1_s0>;
	mem-supply = <&vdd_cpu_big1_mem_s0>;
};

&display_subsystem {
	clocks = <&hdptxphy_hdmi_clk0>, <&hdptxphy_hdmi_clk1>;
	clock-names = "hdmi0_phy_pll", "hdmi1_phy_pll";
};

&dp0 {
	status = "okay";
};

&dp0_in_vp2 {
	status = "okay";
};

/* display port1 to vga */
&dp1_in_vp2 {
	status = "okay";
};

&dp1 {
	pinctrl-names = "default";
	pinctrl-0 = <&dp1_hpd>;
	hpd-gpios = <&gpio1 RK_PA4 GPIO_ACTIVE_HIGH>;
	status = "okay";
};

&route_dp1{
	status = "disabled";
	connect = <&vp2_out_dp1>;
};

&gmac0 {
	/* Use rgmii-rxid mode to disable rx delay inside Soc */
	phy-mode = "rgmii-rxid";
	clock_in_out = "output";
	snps,reset-gpio = <&gpio3 RK_PC7 GPIO_ACTIVE_LOW>;
	snps,reset-active-low;
	/* Reset time is 20ms, 100ms for rtl8211f */
	snps,reset-delays-us = <0 20000 100000>;
	
	pinctrl-names = "default";
	pinctrl-0 = <&gmac0_miim
	&gmac0_tx_bus2
	&gmac0_rx_bus2
	&gmac0_rgmii_clk
	&gmac0_rgmii_bus>;
	
	tx_delay = <0x45>;
	//rx_delay = <0x4a>;
	
	phy-handle = <&rgmii_phy0>;
	status = "okay";
};

&gmac0_tx_bus2{
	rockchip,pins =
	/* gmac0_txd0 */
	<2 RK_PB6 1 &pcfg_pull_up_drv_level_6>,
	/* gmac0_txd1 */
	<2 RK_PB7 1 &pcfg_pull_up_drv_level_6>,
	/* gmac0_txen */
	<2 RK_PC0 1 &pcfg_pull_none>;
};

&gmac0_rgmii_bus{
	rockchip,pins =
	/* gmac0_rxd2 */
	<2 RK_PA6 1 &pcfg_pull_none>,
	/* gmac0_rxd3 */
	<2 RK_PA7 1 &pcfg_pull_none>,
	/* gmac0_txd2 */
	<2 RK_PB1 1 &pcfg_pull_up_drv_level_6>,
	/* gmac0_txd3 */
	<2 RK_PB2 1 &pcfg_pull_up_drv_level_6>;
};

&gmac1 {
	/* Use rgmii-rxid mode to disable rx delay inside Soc */
	phy-mode = "rgmii-rxid";
	clock_in_out = "output";
	
	snps,reset-gpio = <&gpio3 RK_PB7 GPIO_ACTIVE_LOW>;
	snps,reset-active-low;
	/* Reset time is 20ms, 100ms for rtl8211f */
	snps,reset-delays-us = <0 20000 100000>;
	
	pinctrl-names = "default";
	pinctrl-0 = <&gmac1_miim
	&gmac1_tx_bus2
	&gmac1_rx_bus2
	&gmac1_rgmii_clk
	&gmac1_rgmii_bus>;
	
	tx_delay = <0x42>;
	//rx_delay = <0x4f>;
	
	phy-handle = <&rgmii_phy1>;
	status = "okay";
};

&gmac1_tx_bus2{
	rockchip,pins =
	/* gmac1_txd0 */
	<3 RK_PB3 1 &pcfg_pull_up_drv_level_6>,
	/* gmac1_txd1 */
	<3 RK_PB4 1 &pcfg_pull_up_drv_level_6>,
	/* gmac1_txen */
	<3 RK_PB5 1 &pcfg_pull_none>;
};

&gmac1_rgmii_bus{
	rockchip,pins =
	/* gmac1_rxd2 */
	<3 RK_PA2 1 &pcfg_pull_none>,
	/* gmac1_rxd3 */
	<3 RK_PA3 1 &pcfg_pull_none>,
	/* gmac1_txd2 */
	<3 RK_PA0 1 &pcfg_pull_up_drv_level_6>,
	/* gmac1_txd3 */
	<3 RK_PA1 1 &pcfg_pull_up_drv_level_6>;
};

&gpu {
	mali-supply = <&vdd_gpu_s0>;
	mem-supply = <&vdd_gpu_mem_s0>;
	status = "okay";
};

&hdmi0 {
	enable-gpios = <&gpio4 RK_PA0 GPIO_ACTIVE_HIGH>;
	status = "okay";
};

&hdmi0_in_vp0 {
	status = "okay";
};

&hdptxphy_hdmi0 {
	status = "okay";
};

&route_hdmi0{
	status = "okay";
};

&hdmi1 {
	enable-gpios = <&gpio4 RK_PB2 GPIO_ACTIVE_HIGH>;
	status = "okay";
};

&hdmi1_in_vp1 {
	status = "okay";
};

&hdptxphy_hdmi1 {
	status = "okay";
};

&hdptxphy_hdmi_clk0 {
	status = "okay";
};

&hdptxphy_hdmi_clk1 {
	status = "okay";
};

&route_hdmi1{
	status = "okay";
	connect = <&vp1_out_hdmi1>;
};

&hdmirx_ctrler {
	status = "okay";
	#sound-dai-cells = <1>;
	//memory-region = <&hdmirx>;
	pinctrl-names = "default";
	pinctrl-0 = <&hdmim1_rx &hdmirx_det>;
	/* Effective level used to trigger HPD: 0-low, 1-high */
	hpd-trigger-level = <1>;
	hdmirx-det-gpios = <&gpio1 RK_PD5 GPIO_ACTIVE_LOW>;
};

&i2c0 {
	status = "okay";
	pinctrl-0 = <&i2c0m2_xfer>;
	
	vdd_cpu_big0_s0: vdd_cpu_big0_mem_s0: rk8602@42 {
		compatible = "rockchip,rk8602";
		reg = <0x42>;
		vin-supply = <&vcc5v0_sys>;
		regulator-compatible = "rk860x-reg";
		regulator-name = "vdd_cpu_big0_s0";
		regulator-min-microvolt = <550000>;
		regulator-max-microvolt = <1050000>;
		regulator-ramp-delay = <2300>;
		rockchip,suspend-voltage-selector = <1>;
		regulator-boot-on;
		regulator-always-on;
		regulator-state-mem {
			regulator-off-in-suspend;
		};
	};
	
	vdd_cpu_big1_s0: vdd_cpu_big1_mem_s0: rk8603@43 {
		compatible = "rockchip,rk8603";
		reg = <0x43>;
		vin-supply = <&vcc5v0_sys>;
		regulator-compatible = "rk860x-reg";
		regulator-name = "vdd_cpu_big1_s0";
		regulator-min-microvolt = <550000>;
		regulator-max-microvolt = <1050000>;
		regulator-ramp-delay = <2300>;
		rockchip,suspend-voltage-selector = <1>;
		regulator-boot-on;
		regulator-always-on;
		regulator-state-mem {
			regulator-off-in-suspend;
		};
	};
};

&i2c1 {
	status = "okay";
	pinctrl-0 = <&i2c1m2_xfer>;
	
	vdd_npu_s0: vdd_npu_mem_s0: rk8602@42 {
		compatible = "rockchip,rk8602";
		reg = <0x42>;
		vin-supply = <&vcc5v0_sys>;
		regulator-compatible = "rk860x-reg";
		regulator-name = "vdd_npu_s0";
		regulator-min-microvolt = <550000>;
		regulator-max-microvolt = <950000>;
		regulator-ramp-delay = <2300>;
		rockchip,suspend-voltage-selector = <1>;
		regulator-boot-on;
		regulator-always-on;
		regulator-state-mem {
			regulator-off-in-suspend;
		};
	};
};

&i2c3 {
	status = "okay";
	es8388: es8388@11 {
		status = "okay";
		#sound-dai-cells = <0>;
		compatible = "everest,es8388", "everest,es8323";
		reg = <0x11>;
		clocks = <&mclkout_i2s0>;
		clock-names = "mclk";
		assigned-clocks = <&mclkout_i2s0>;
		assigned-clock-rates = <12288000>;
		pinctrl-names = "default";
		pinctrl-0 = <&i2s0_mclk>;
	};
};

&i2c6 {
	status = "okay";
	clock-frequency = <400000>;// For others Display Port Screen
	pinctrl-names = "default";
	pinctrl-0 = <&i2c6m0_xfer>;
	
	pca9555: gpio@21 {
		compatible = "nxp,pca9555";
		reg = <0x21>;
		gpio-controller;
		#gpio-cells = <2>;
		gpio-group-num = <200>;
		status = "okay";
	};
	
	hym8563: hym8563@51 {
		compatible = "haoyu,hym8563";
		reg = <0x51>;
		#clock-cells = <0>;
		clock-frequency = <32768>;
		clock-output-names = "hym8563";
		pinctrl-names = "default";
		pinctrl-0 = <&hym8563_int>;
		interrupt-parent = <&gpio0>;
		interrupts = <RK_PB0 IRQ_TYPE_LEVEL_LOW>;
		wakeup-source;
		status = "okay";
	};
	
	usbc0: fusb302@22 {
		compatible = "fcs,fusb302";
		reg = <0x22>;
		interrupt-parent = <&gpio0>;
		interrupts = <RK_PD3 IRQ_TYPE_LEVEL_LOW>;
		pinctrl-names = "default";
		pinctrl-0 = <&usbc0_int>;
		vbus-supply = <&vbus5v0_typec_pwr_en>;
		status = "okay";
		
		ports {
			#address-cells = <1>;
			#size-cells = <0>;
			
			port@0 {
				reg = <0>;
				usbc0_role_sw: endpoint@0 {
					remote-endpoint = <&dwc3_0_role_switch>;
				};
			};
		};
		
		usb_con: connector {
			compatible = "usb-c-connector";
			label = "USB-C";
			data-role = "dual";
			power-role = "dual";
			try-power-role = "sink";
			op-sink-microwatt = <1000000>;
			sink-pdos =
			<PDO_FIXED(5000, 1000, PDO_FIXED_USB_COMM)>;
			source-pdos =
			<PDO_FIXED(5000, 3000, PDO_FIXED_USB_COMM)>;
			
			altmodes {
				#address-cells = <1>;
				#size-cells = <0>;
				
				altmode@0 {
					reg = <0>;
					svid = <0xff01>;
					vdo = <0xffffffff>;
				};
			};
			
			ports {
				#address-cells = <1>;
				#size-cells = <0>;
				
				port@0 {
					reg = <0>;
					usbc0_orien_sw: endpoint {
						remote-endpoint = <&usbdp_phy0_orientation_switch>;
					};
				};
				
				port@1 {
					reg = <1>;
					dp_altmode_mux: endpoint {
						remote-endpoint = <&usbdp_phy0_dp_altmode_mux>;
					};
				};
			};
		};
	};
};

&i2s0_8ch {
	status = "okay";
	pinctrl-0 = <&i2s0_lrck
	&i2s0_sclk
	&i2s0_sdi0
	&i2s0_sdo0>;
};

&i2s1_8ch {
	status = "okay";
	pinctrl-0 = <&i2s1m0_lrck &i2s1m0_sclk &i2s1m0_sdi0 &i2s1m0_sdo0>;
	rockchip,bclk-fs = <32>;
};

&i2s5_8ch {
	status = "okay";
};

&iep {
	status = "okay";
};

&iep_mmu {
	status = "okay";
};

&jpegd {
	status = "okay";
};

&jpegd_mmu {
	status = "okay";
};

&jpege_ccu {
	status = "okay";
};

&jpege0 {
	status = "okay";
};

&jpege0_mmu {
	status = "okay";
};

&jpege1 {
	status = "okay";
};

&jpege1_mmu {
	status = "okay";
};

&jpege2 {
	status = "okay";
};

&jpege2_mmu {
	status = "okay";
};

&jpege3 {
	status = "okay";
};

&jpege3_mmu {
	status = "okay";
};

&mdio0 {
	rgmii_phy0: phy@1 {
		compatible = "ethernet-phy-ieee802.3-c22";
		reg = <0x1>;
	};
};

&mdio1 {
	rgmii_phy1: phy@1 {
		compatible = "ethernet-phy-ieee802.3-c22";
		reg = <0x1>;
	};
};

&mpp_srv {
	status = "okay";
};

&pcie2x1l0 {
	reset-gpios = <&gpio1 RK_PB4 GPIO_ACTIVE_HIGH>;
	rockchip,skip-scan-in-resume;
	status = "okay";
};

/* pcie3.0 x 4 slot */
&pcie30phy {
	status = "okay";
};

&pcie3x4 {
	reset-gpios = <&gpio4 RK_PB6 GPIO_ACTIVE_HIGH>;
	vpcie3v3-supply = <&vcc3v3_pcie30>;
	status = "okay";
};

&pinctrl {
	dp {
		dp1_hpd: dp1-hpd {
			rockchip,pins = <1 RK_PA4 RK_FUNC_GPIO &pcfg_pull_none>;
		};
	};
	
	leds {
		leds_gpio: leds-gpio {
			/* led_power */
			rockchip,pins = <1 11 RK_FUNC_GPIO &pcfg_pull_none>;
		};
	};
	
	hdmirx {
		hdmirx_det: hdmirx-det {
			rockchip,pins = <1 RK_PD5 RK_FUNC_GPIO &pcfg_pull_up>;
		};
	};
	
	headphone {
		hp_det: hp-det {
			rockchip,pins = <1 RK_PC4 RK_FUNC_GPIO &pcfg_pull_none>;
		};
	};
	
	hym8563 {
		hym8563_int: hym8563-int {
			rockchip,pins = <0 RK_PB0 RK_FUNC_GPIO &pcfg_pull_up>;
		};
	};
	
	lcd {
		lcd_rst_gpio: lcd-rst-gpio {
			rockchip,pins = <2 RK_PB4 RK_FUNC_GPIO &pcfg_pull_none>;
		};
	};
	
	touch {
		touch_gpio: touch-gpio {
			rockchip,pins =
			<0 RK_PD5 RK_FUNC_GPIO &pcfg_pull_up>,
			<0 RK_PC6 RK_FUNC_GPIO &pcfg_pull_none>;
		};
	};
	
	usb-typec {
		usbc0_int: usbc0-int {
			rockchip,pins = <0 RK_PD3 RK_FUNC_GPIO &pcfg_pull_up>;
		};
	};
	
	wireless-bluetooth {
		uart6_gpios: uart6-gpios {
			rockchip,pins = <1 RK_PA2 RK_FUNC_GPIO &pcfg_pull_none>;
		};
		
		bt_reset_gpio: bt-reset-gpio {
			rockchip,pins = <0 RK_PC6 RK_FUNC_GPIO &pcfg_pull_none>;
		};
		
		bt_wake_gpio: bt-wake-gpio {
			rockchip,pins = <0 RK_PC5 RK_FUNC_GPIO &pcfg_pull_none>;
		};
		
		bt_irq_gpio: bt-irq-gpio {
			rockchip,pins = <0 RK_PA0 RK_FUNC_GPIO &pcfg_pull_down>;
		};
	};
	
	wireless-wlan {
		wifi_host_wake_irq: wifi-host-wake-irq {
			rockchip,pins = <0 RK_PB2 RK_FUNC_GPIO &pcfg_pull_down>;
		};
		
		wifi_poweren_gpio: wifi-poweren-gpio {
			rockchip,pins = <0 RK_PC4 RK_FUNC_GPIO &pcfg_pull_up>;
		};
	};
};

&pwm15 {
	pinctrl-0 = <&pwm15m2_pins>;
	status = "okay";
};

&rga3_core0 {
	status = "okay";
};

&rga3_0_mmu {
	status = "okay";
};

&rga3_core1 {
	status = "okay";
};

&rga3_1_mmu {
	status = "okay";
};

&rga2 {
	status = "okay";
};

&rknpu {
	rknpu-supply = <&vdd_npu_s0>;
	mem-supply = <&vdd_npu_mem_s0>;
	status = "okay";
};

&rknpu_mmu {
	status = "okay";
};

&rkvdec_ccu {
	status = "okay";
};

&rkvdec0 {
	status = "okay";
};

&rkvdec0_mmu {
	status = "okay";
};

&rkvdec1 {
	status = "okay";
};

&rkvdec1_mmu {
	status = "okay";
};

&rkvenc_ccu {
	status = "okay";
};

&rkvenc0 {
	status = "okay";
};

&rkvenc0_mmu {
	status = "okay";
};

&rkvenc1 {
	status = "okay";
};

&rkvenc1_mmu {
	status = "okay";
};

&rockchip_suspend {
	rockchip,sleep-debug-en = <1>;
	rockchip,sleep-mode-config = <
	(0
	| RKPM_SLP_ARMOFF_DDRPD
	| RKPM_SLP_PMU_PMUALIVE_32K
	| RKPM_SLP_PMU_DIS_OSC
	| RKPM_SLP_32K_EXT
	| RKPM_SLP_PMU_DBG
	)
	>;
};

&saradc {
	status = "okay";
	vref-supply = <&vcc_1v8_s0>;
};

&sdhci {
	bus-width = <8>;
	no-sdio;
	no-sd;
	non-removable;
	max-frequency = <200000000>;
	mmc-hs400-1_8v;
	mmc-hs400-enhanced-strobe;
	status = "okay";
};

&sdmmc {
	max-frequency = <150000000>;
	no-sdio;
	no-mmc;
	bus-width = <4>;
	cap-mmc-highspeed;
	cap-sd-highspeed;
	disable-wp;
	sd-uhs-sdr104;
	vqmmc-supply = <&vccio_sd_s0>;
	status = "okay";
};

&soc_thermal {
	sustainable-power = <15000>; /* milliwatts */
	polling-delay = <1000>;
	polling-delay-passive = <2000>;

	trips {
		trip0: trip-point@0 {
			temperature = <55000>;
			hysteresis = <5000>;
			type = "active";
		};
		trip1: trip-point@1 {
			temperature = <60000>;
			hysteresis = <5000>;
			type = "active";
		};
		trip2: trip-point@2 {
			temperature = <65000>;
			hysteresis = <5000>;
			type = "active";
		};
		trip3: trip-point@3 {
			temperature = <70000>;
			hysteresis = <5000>;
			type = "active";
		};
		trip4: trip-point@4 {
			temperature = <75000>;
			hysteresis = <5000>;
			type = "active";
		};
		pcritical: trip-point@5 {
			temperature = <80000>;
			hysteresis = <1000>;
			type = "active";
		};
	};

	cooling-maps {
		map0 {
			trip = <&trip0>;
			cooling-device = <&fan 0 1>;
			contribution = <1024>;
		};
		map1 {
			trip = <&trip1>;
			cooling-device = <&fan 1 2>;
			contribution = <1024>;
		};
		map2 {
			trip = <&trip2>;
			cooling-device = <&fan 2 3>;
			contribution = <1024>;
		};
		map3 {
			trip = <&trip3>;
			cooling-device = <&fan 3 4>;
			contribution = <1024>;
		};
		map4 {
			trip = <&trip4>;
			cooling-device = <&fan 4 5>;
			contribution = <1024>;
		};
		map5 {
			trip = <&pcritical>;
			cooling-device = <&fan 5 6>;
			contribution = <1024>;
		};
	};
};

/* uart/232/485 */
&uart0{
	pinctrl-0 = <&uart0m2_xfer>;
	status = "okay";
};

&uart1{
	pinctrl-0 = <&uart1m1_xfer>;
	status = "okay";
};

&uart6 {
	pinctrl-names = "default";
	pinctrl-0 = <&uart6m1_xfer &uart6m1_ctsn>;
	status = "okay";
};

&u2phy0_otg {
	rockchip,typec-vbus-det;
	status = "okay";
};

&u2phy2_host {
	phy-supply = <&vcc5v0_host>;
	status = "okay";
};

&usbdp_phy0 {
	orientation-switch;
	status = "okay";
	svid = <0xff01>;
	sbu1-dc-gpios = <&gpio4 RK_PA6 GPIO_ACTIVE_HIGH>;
	sbu2-dc-gpios = <&gpio4 RK_PA7 GPIO_ACTIVE_HIGH>;
	
	port {
		#address-cells = <1>;
		#size-cells = <0>;
		usbdp_phy0_orientation_switch: endpoint@0 {
			reg = <0>;
			remote-endpoint = <&usbc0_orien_sw>;
		};
		
		usbdp_phy0_dp_altmode_mux: endpoint@1 {
			reg = <1>;
			remote-endpoint = <&dp_altmode_mux>;
		};
	};
};

&usbdrd_dwc3_0 {
	status = "okay";
	dr_mode = "otg";
	usb-role-switch;
	port {
		#address-cells = <1>;
		#size-cells = <0>;
		dwc3_0_role_switch: endpoint@0 {
			reg = <0>;
			remote-endpoint = <&usbc0_role_sw>;
		};
	};
};

&u2phy0 {
	status = "okay";
};

&u2phy2 {
	status = "okay";
};

&u2phy3_host {
	phy-supply = <&vcc5v0_host>;
	status = "okay";
};

&u2phy3 {
	status = "okay";
};

&usb_host0_ehci {
	status = "okay";
};

&usb_host0_ohci {
	status = "okay";
};

&usb_host1_ehci {
	status = "okay";
};

&usb_host1_ohci {
	status = "okay";
};

/*usb3.1 host2 controller for 5G module*/
&usbhost3_0 {
	status = "okay";
};

&usbhost_dwc3_0 {
	dr_mode = "host";
	status = "okay";
};

&usbdp_phy0_dp {
	status = "okay";
};

&usbdp_phy0_u3 {
	status = "okay";
};

&usbdrd3_0 {
	status = "okay";
};

&usbdp_phy1 {
	rockchip,dp-lane-mux = <2 3>;
	status = "okay";
};

&usbdp_phy1_u3 {
	status = "okay";
};

&usbdrd3_1 {
	status = "okay";
};

&usbdrd_dwc3_1 {
	status = "okay";
};

&vdd_log_s0 {
	regulator-always-on;
	regulator-boot-on;
	regulator-min-microvolt = <675000>;
	regulator-max-microvolt = <750000>;
	regulator-ramp-delay = <12500>;
	regulator-name = "vdd_log_s0";
	regulator-state-mem {
		regulator-on-in-suspend;
		regulator-suspend-microvolt = <750000>;
	};
};

/* vp0 & vp1 splice for 8K output */
&vp0 {
	rockchip,plane-mask = <(1 << ROCKCHIP_VOP2_CLUSTER0 | 1 << ROCKCHIP_VOP2_ESMART0)>;
	rockchip,primary-plane = <ROCKCHIP_VOP2_ESMART0>;
	assigned-clocks = <&cru ACLK_VOP>;
	assigned-clock-rates = <800000000>;
};

&vp1 {
	rockchip,plane-mask = <(1 << ROCKCHIP_VOP2_CLUSTER1 | 1 << ROCKCHIP_VOP2_ESMART1)>;
	rockchip,primary-plane = <ROCKCHIP_VOP2_ESMART1>;
};

&vp2 {
	rockchip,plane-mask = <(1 << ROCKCHIP_VOP2_CLUSTER2 | 1 << ROCKCHIP_VOP2_ESMART2)>;
	rockchip,primary-plane = <ROCKCHIP_VOP2_ESMART2>;
};

&vp3 {
	rockchip,plane-mask = <(1 << ROCKCHIP_VOP2_CLUSTER3 | 1 << ROCKCHIP_VOP2_ESMART3)>;
	rockchip,primary-plane = <ROCKCHIP_VOP2_ESMART3>;
};

&avdd_0v75_s0 {
	regulator-always-on;
	regulator-boot-on;
	regulator-min-microvolt = <750000>;
	regulator-max-microvolt = <750000>;
	regulator-name = "avdd_0v75_s0";
	regulator-state-mem {
		regulator-off-in-suspend;
	};
};

&tsadc {
	status = "okay";
};

&vdpu {
	status = "okay";
};

&vdpu_mmu {
	status = "okay";
};

&vop {
	status = "okay";
};

&vop_mmu {
	status = "okay";
};

&wdt {
	status = "okay";
};

&u2phy1_otg {
	phy-supply = <&vcc5v0_host>;
	status = "okay";
};

&u2phy1 {
	status = "okay";
};

&usbdp_phy1_dp {
	status = "okay";
};

&sata0 {
	status = "okay";
};

&spdif_tx2{
	status = "okay";
};

&avcc_1v8_s0{
	regulator-state-mem {
		regulator-on-in-suspend;
	};
};

&vcc_1v8_s0{
	regulator-state-mem {
		regulator-on-in-suspend;
		regulator-suspend-microvolt = <1800000>;
	};
};