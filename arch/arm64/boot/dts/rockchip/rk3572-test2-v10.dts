// SPDX-License-Identifier: (GPL-2.0+ OR MIT)
/*
 * Copyright (c) 2025 Rockchip Electronics Co., Ltd.
 */

/dts-v1/;

#include "rk3572-test2-v10.dtsi"
#include "rk3572-android.dtsi"

/ {
	model = "Rockchip RK3572 TEST2 V10 Board";
	compatible = "rockchip,rk3572-test2-v10", "rockchip,rk3572";
};
