// SPDX-License-Identifier: (GPL-2.0+ OR MIT)
/*
 * Copyright (c) 2024 Rockchip Electronics Co., Ltd.
 *
 */

/dts-v1/;

#include "rk3576.dtsi"
#include "rk3576-iotest.dtsi"
#include "rk3576-linux.dtsi"

/ {
	model = "Rockchip RK3576 IOTEST V10 Board";
	compatible = "rockchip,rk3576-iotest-v10", "rockchip,rk3576";
};
