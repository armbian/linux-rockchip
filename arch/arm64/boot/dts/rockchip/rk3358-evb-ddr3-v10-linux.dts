// SPDX-License-Identifier: (GPL-2.0+ OR MIT)
/*
 * Copyright (c) 2021 Rockchip Electronics Co., Ltd.
 *
 */

/dts-v1/;

#include "rk3358-evb-ddr3.dtsi"
#include "rk3358-linux.dtsi"

/ {
	model = "Rockchip linux RK3358 EVB DDR3 board";
	compatible = "rockchip,rk3358-evb-ddr3-v10-linux", "rockchip,px30", "rockchip,rk3358";

	/delete-node/ wireless-bluetooth;
};

&uart1 {
	status = "okay";
	pinctrl-names = "default";
	pinctrl-0 = <&uart1_xfer &uart1_cts &uart1_rts>;
	uart-has-rtscts;

	bluetooth {
		compatible = "brcm,bcm4345c5";
		clocks = <&rk809 1>;
		clock-names = "txco";

		device-wakeup-gpios = <&gpio0 RK_PA0 GPIO_ACTIVE_HIGH>;
		host-wakeup-gpios = <&gpio3 RK_PB3 GPIO_ACTIVE_HIGH>;
		shutdown-gpios = <&gpio0 RK_PA1 GPIO_ACTIVE_HIGH>;
		max-speed = <1500000>;
	};
};
