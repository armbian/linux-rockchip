// SPDX-License-Identifier: (GPL-2.0+ OR MIT)
/*
 * Copyright (c) 2024 Rockchip Electronics Co., Ltd.
 *
 */

/dts-v1/;

#include "rk3576-tablet.dtsi"
#include "rk3576-android.dtsi"
#include "rk3576-rk806-tablet-camera.dtsi"

/ {
	model = "Rockchip RK3576 TABLET V10 Board";
	compatible = "rockchip,rk3576-tablet-v10", "rockchip,rk3576";
};
