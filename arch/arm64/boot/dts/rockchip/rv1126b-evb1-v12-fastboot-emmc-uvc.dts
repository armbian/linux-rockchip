// SPDX-License-Identifier: (GPL-2.0+ OR MIT)
/*
 * Copyright (c) 2026 Rockchip Electronics Co., Ltd.
 */

#include "rv1126b-evb1-v12-fastboot-emmc.dts"

/ {
	model = "Rockchip RV1126B EVB1 V12 Arm64 Fastboot Board";
	compatible = "rockchip,rv1126b-evb1-v12-fastboot-uvc", "rockchip,rv1126b";
};

&usb_drd_dwc3 {
	tx-fifo-resize;
};
