// SPDX-License-Identifier: (GPL-2.0+ OR MIT)
/*
 * Copyright (c) 2023 FriendlyElec Computer Tech. Co., Ltd.
 * (http://www.friendlyelec.com)
 */

/dts-v1/;

#include "rk3588-nanopc-t6.dts"

/ {
	model = "FriendlyElec NanoPC-T6 LTS";
	compatible = "friendlyelec,nanopc-t6", "rockchip,rk3588";

	vcc5v0_host_20: vcc5v0-host-20 {
		compatible = "regulator-fixed";
		enable-active-high;
		gpio = <&gpio1 RK_PA4 GPIO_ACTIVE_HIGH>;
		pinctrl-names = "default";
		pinctrl-0 = <&vcc5v0_host20_en>;
		regulator-name = "vcc5v0_host_20";
		regulator-min-microvolt = <5000000>;
		regulator-max-microvolt = <5000000>;
		vin-supply = <&vcc5v0_usb>;
	};
};

&u2phy3_host {
	phy-supply = <&vcc5v0_host_20>;
};
