// SPDX-License-Identifier: (GPL-2.0+ OR MIT)
/*
 * Copyright (c) 2024 Rockchip Electronics Co., Ltd.
 *
 */

/dts-v1/;

#include "rk3576.dtsi"
#include "rk3576-evb1.dtsi"
#include "rk3576-android.dtsi"
#include "rk3576-evb1-v10-image-reverse-vehicle.dtsi"
#include "rk3576-evb1-v10-image-reverse-normal.dtsi"
