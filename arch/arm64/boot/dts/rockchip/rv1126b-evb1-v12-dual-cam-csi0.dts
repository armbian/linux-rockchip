// SPDX-License-Identifier: (GPL-2.0+ OR MIT)
/*
 * Copyright (c) 2026 Rockchip Electronics Co., Ltd.
 */

/dts-v1/;
#include "rv1126b-evb1-v11-dual-cam-csi0.dts"
#include "rv1126b-evb1-v12.dtsi"

/ {
	model = "Rockchip RV1126B EVB1 V12 DUAL CAM Board";
	compatible = "rockchip,rv1126b-evb1-v12-dual-cam-csi0", "rockchip,rv1126b";
};
