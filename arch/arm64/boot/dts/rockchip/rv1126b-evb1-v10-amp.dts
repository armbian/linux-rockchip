// SPDX-License-Identifier: (GPL-2.0+ OR MIT)
/*
 * Copyright (c) 2025 Rockchip Electronics Co., Ltd.
 */

/dts-v1/;
#include "rv1126b.dtsi"
#include "rv1126b-evb.dtsi"
#include "rv1126b-evb-cam-csi0.dtsi"
#include "rv1126b-evb1-v10.dtsi"
#include "rv1126b-amp.dtsi"

/ {
	model = "Rockchip RV1126B EVB1 V10 AMP Board with HPMCU";
	compatible = "rockchip,rv1126b-evb1-v10", "rockchip,rv1126b";
};
