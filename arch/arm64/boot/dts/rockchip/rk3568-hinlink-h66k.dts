// SPDX-License-Identifier: (GPL-2.0+ OR MIT)
/*
 * Copyright (c) 2020 Rockchip Electronics Co., Ltd.
 *
 */

/dts-v1/;

#include "rk3568-hinlink-h6xk.dtsi"

/ {
	model = "HINLINK H66K";
	compatible = "hinlink,h66k", "rockchip,rk3568";

	aliases {
		ethernet0 = &rtl8125_1;
		ethernet1 = &rtl8125_2;
	};
};

&vcc3v3_pcie {
	gpio = <&gpio0 RK_PC4 GPIO_ACTIVE_HIGH>;
};
