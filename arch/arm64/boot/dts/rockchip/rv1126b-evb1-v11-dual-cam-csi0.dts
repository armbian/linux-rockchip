// SPDX-License-Identifier: (GPL-2.0+ OR MIT)
/*
 * Copyright (c) 2025 Rockchip Electronics Co., Ltd.
 */

/dts-v1/;
#include "rv1126b.dtsi"
#include "rv1126b-evb.dtsi"
#include "rv1126b-evb-dual-cam-csi0.dtsi"
#include "rv1126b-evb1-v11.dtsi"

/ {
	model = "Rockchip RV1126B EVB1 V11 DUAL CAM Board";
	compatible = "rockchip,rv1126b-evb1-v11-dual-cam-csi0", "rockchip,rv1126b";
};
