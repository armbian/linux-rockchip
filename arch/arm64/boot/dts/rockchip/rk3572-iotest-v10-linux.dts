// SPDX-License-Identifier: (GPL-2.0+ OR MIT)
/*
 * Copyright (c) 2026 Rockchip Electronics Co., Ltd.
 */

/dts-v1/;

#include "rk3572-iotest-v10.dtsi"
#include "rk3572-linux.dtsi"

/ {
	model = "Rockchip RK3572 IOTEST V10 Board";
	compatible = "rockchip,rk3572-iotest-v10", "rockchip,rk3572";
};
