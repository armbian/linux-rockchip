// SPDX-License-Identifier: (GPL-2.0+ OR MIT)
/*
 * Copyright (c) 2025 Rockchip Electronics Co., Ltd.
 */

#include "rv1126b-evb1-v10.dts"
#include "rv1126b-evb1-v11.dtsi"

/ {
	model = "Rockchip RV1126B EVB1 V11 Board";
	compatible = "rockchip,rv1126b-evb1-v11", "rockchip,rv1126b";
};
