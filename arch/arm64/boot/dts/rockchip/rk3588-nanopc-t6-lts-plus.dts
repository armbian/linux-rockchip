// SPDX-License-Identifier: (GPL-2.0+ OR MIT)
/*
 * NanoPC-T6 LTS Plus is the Plus board (ES8389 codec) on the LTS module.
 * The previous contents of this file were only the Plus file name.
 */

/dts-v1/;

#include "rk3588-nanopc-t6-plus.dts"
