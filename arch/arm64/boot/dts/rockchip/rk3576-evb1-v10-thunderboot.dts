// SPDX-License-Identifier: (GPL-2.0+ OR MIT)
/*
 * Copyright (c) 2026 Rockchip Electronics Co., Ltd.
 *
 */
/dts-v1/;
#include "rk3576.dtsi"
#include "rk3576-evb1.dtsi"
#include "rk3576-evb1-cam-dcphy0.dtsi"
#include "rk3576-linux.dtsi"
#include "rk3576-thunderboot.dtsi"

/ {
	model = "Rockchip RK3576 EVB1 V10 ThunderBoot Board";
	compatible = "rockchip,rk3576-evb1-v10", "rockchip,rk3576";

	chosen {
		bootargs = "loglevel=0 initcall_debug=0 initcall_nr_threads=8 earlycon=uart8250,mmio32,0x2ad40000 console=ttyFIQ0 root=/dev/rd0 rootfstype=erofs rootflags=dax ro rootwait init=/sbin/init rcupdate.rcu_expedited=1 rcu_nocbs=all";
	};
};
