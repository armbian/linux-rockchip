// SPDX-License-Identifier: (GPL-2.0+ OR MIT)
/*
 * Copyright (c) 2022 Rockchip Electronics Co., Ltd.
 *
 */

#include "rk3562-evb2-ddr4-v10.dtsi"
#include "rk3562-linux.dtsi"
#include "rk3562-rk809.dtsi"
#include "rk3562-evb2-cam.dtsi"

&uart1 {
	status = "okay";
	pinctrl-names = "default";
	pinctrl-0 = <&uart1m0_xfer &uart1m0_ctsn &uart1m0_rtsn>;
	uart-has-rtscts;

	bluetooth {
		compatible = "brcm,bcm4345c5";
		clocks = <&rk809 1>;
		clock-names = "txco";

		device-wakeup-gpios = <&gpio0 RK_PC7 GPIO_ACTIVE_HIGH>;
		host-wakeup-gpios = <&gpio0 RK_PC6 GPIO_ACTIVE_HIGH>;
		shutdown-gpios = <&gpio0 RK_PC5 GPIO_ACTIVE_HIGH>;
		max-speed = <1500000>;
	};
};

/ {
	/delete-node/ wireless-bluetooth;
};
