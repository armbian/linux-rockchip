// SPDX-License-Identifier: (GPL-2.0+ OR MIT)
/*
 * Copyright (c) 2026 Rockchip Electronics Co., Ltd.
 */

/dts-v1/;

#include "rk3572-evb3-v10.dtsi"
#include "rk3572-linux.dtsi"
#include "rk3572-evb3-rk628-hdmi2csi.dtsi"
#include "rk3572-evb3-rgb2vga.dtsi"

/ {
	model = "Rockchip RK3572 EVB3 V10 Board";
	compatible = "rockchip,rk3572-evb3-v10", "rockchip,rk3572";
};
