// SPDX-License-Identifier: (GPL-2.0+ OR MIT)
/*
 * Copyright (c) 2022 Rockchip Electronics Co., Ltd.
 *
 */

#include "rk3562-toybrick.dtsi"
#include "rk3562-android.dtsi"
#include "rk3562-rk809.dtsi"
