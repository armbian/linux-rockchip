// SPDX-License-Identifier: (GPL-2.0+ OR MIT)
/*
 * Copyright (c) 2021 Rockchip Electronics Co., Ltd.
 *
 */

/dts-v1/;

#include "rk3588s-orangepi-5.dts"

/ {
	model = "Orange Pi 5B";
	compatible = "rockchip,rk3588s-orangepi-5", "rockchip,rk3588";
};

&sdhci {
	status = "okay";
};

&sfc {
	status = "disabled";
};
