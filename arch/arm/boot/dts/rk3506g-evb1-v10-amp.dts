// SPDX-License-Identifier: (GPL-2.0+ OR MIT)
/*
 * Copyright (c) 2024 Rockchip Electronics Co., Ltd.
 */

/dts-v1/;

#include "rk3506g-evb1-v10.dts"
#include "rk3506-amp.dtsi"

&reserved_memory {
	amp_reserved: amp@3e00000 {
		reg = <0x03e00000 0x100000>;
		no-map;
	};
};
