// SPDX-License-Identifier: (GPL-2.0+ OR MIT)
/*
 * Enable spidev on SPI0 with explicit RM_IO pinmux:
 * MOSI = RM_IO6, MISO = RM_IO7, CLK = RM_IO8, CS0 = RM_IO10
 * Retains compatibility with luckfox-pico-ultra hats
 */

/dts-v1/;
/plugin/;

/ {
	metadata {
		title = "Enable SPI0 spidev on luckfox-lyra-ultra-w";
		compatible = "rockchip,rk3506b-lyra-ultra";
		category = "spi";
		exclusive = "spi0", "RM_IO6", "RM_IO7", "RM_IO8", "RM_IO10";
		description = "Enable SPI0 spidev using RM_IO6(MOSI), RM_IO7(MISO), RM_IO8(CLK), RM_IO10(CS0).";
	};
};

&spi0 {
	status = "okay";
	num-cs = <1>;
	pinctrl-names = "default";
	pinctrl-0 = <&rm_io8_spi0_clk &rm_io7_spi0_miso &rm_io6_spi0_mosi &rm_io10_spi0_csn0>;

	spi@0 {
		compatible = "rockchip,spidev";
		reg = <0>;
		spi-max-frequency = <50000000>;
		status = "okay";
	};
};
