// SPDX-License-Identifier: (GPL-2.0+ OR MIT)
/*
 * Copyright (c) 2024 Rockchip Electronics Co., Ltd.
 */

/dts-v1/;

#include <dt-bindings/mfd/rockchip-flexbus.h>
#include "rk3506.dtsi"
#include "rk3506-evb1-v10.dtsi"

/ {
	model = "Rockchip RK3506G(QFN128) EVB1 V10 Board + RK EVB Ext RK3506 FlexBus Convert V10 Board + RK EVB EXT FLEXBUS ADC CIF V10 + RK EVB EXT FLEXBUS DAC FSPI V10";
	compatible = "rockchip,rk3506g-evb1-v10-flexbus-adc-dac", "rockchip,rk3506";
};

&flexbus {
	rockchip,flexbus0-opmode = <ROCKCHIP_FLEXBUS0_OPMODE_DAC>;
	rockchip,flexbus1-opmode = <ROCKCHIP_FLEXBUS1_OPMODE_ADC>;
	status = "okay";
};

&flexbus_adc {
	pinctrl-names = "default";
	/* 14bit ADC device */
	pinctrl-0 = <&ref_clk1_pins	/* ref_clk is only used for slave-mode */
		     &flexbus1_clk_pins
		     &flexbus1_d0_pins &flexbus1_d1_pins &flexbus1_d2_pins &flexbus1_d3_pins
		     &flexbus1_d4_pins &flexbus1_d5_pins &flexbus1_d6_pins &flexbus1_d7_pins
		     &flexbus1_d8_pins &flexbus1_d9_pins &flexbus1_d10_pins &flexbus1_d11_pins
		     &flexbus1_d12_pins &flexbus1_d13_pins>;
	status = "okay";
};

&flexbus_dac {
	pinctrl-names = "default";
	/* 12bit DAC device */
	pinctrl-0 = <&flexbus0_clk_pins
		     &flexbus0_d0_pins &flexbus0_d1_pins &flexbus0_d2_pins &flexbus0_d3_pins
		     &flexbus0_d4_pins &flexbus0_d5_pins &flexbus0_d6_pins &flexbus0_d7_pins
		     &flexbus0_d8_pins &flexbus0_d9_pins &flexbus0_d10_pins &flexbus0_d11_pins>;
	status = "okay";
};
