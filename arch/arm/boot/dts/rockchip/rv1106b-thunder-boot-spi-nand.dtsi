// SPDX-License-Identifier: (GPL-2.0+ OR MIT)
/*
 * Copyright (c) 2026 Rockchip Electronics Co., Ltd.
 */

#include "rv1106b-thunder-boot.dtsi"
/ {
	thunder_boot_spi_nand: thunder-boot-spi-nand@20d40000 {
		compatible = "rockchip,thunder-boot-sfc";
		reg = <0x20d40000 0x4000>;
		memory-region-src = <&ramdisk_c>;
		memory-region-dst = <&ramdisk_r>;
		status = "disabled";
	};
};
