// SPDX-License-Identifier: (GPL-2.0+ OR MIT)
/*
 * Copyright (c) 2026 Rockchip Electronics Co., Ltd.
 */

/dts-v1/;

#include "rv1103b-evb1-v10.dts"

/ {
	model = "Rockchip RV1103B EVB1 V10 Board";
	compatible = "rockchip,rv1103b-evb1-v10-spi-nor", "rockchip,rv1103b";

};

&fspi0 {
	status = "okay";

	flash@0 {
		compatible = "jedec,spi-nor";
		reg = <0>;
		spi-max-frequency = <75000000>;
		spi-rx-bus-width = <4>;
		spi-tx-bus-width = <1>;
	};
};
