## Documentation/devicetree/bindings/spi/rockchip-flexbus-fspi.yaml
```yaml
# SPDX-License-Identifier: (GPL-2.0-only OR BSD-2-Clause)
%YAML 1.2
---
$id: http://devicetree.org/schemas/spi/rockchip-flexbus-fspi.yaml#
$schema: http://devicetree.org/meta-schemas/core.yaml#

title: Rockchip Flexbus controller under SPI transmission protocol

maintainers:
  - Heiko Stuebner <heiko@sntech.de>
  - Jon Lin <jon.lin@rock-chips.com>

allOf:
  - $ref: spi-controller.yaml#

properties:
  compatible:
    const: rockchip,flexbus-fspi
    description:
      The rockchip flexbus controller is a standalone IP with version register,
      and the driver can handle all the feature difference inside the IP
      depending on the version register.

  fspi-cs-gpios:
    description:
      Specifies the gpio pins to be used for chipselects. The gpios will be
      referred to as reg = <index> in the SPI child nodes. If unspecified, a
      single SPI device without a chip select can be used.

  reset-gpios:
    description:
      Specifies the reset gpio pin to be used for resetting the devices.

patternProperties:
  "^flash@[0-3]$":
    type: object
    properties:
      reg:
        minimum: 0
        maximum: 3

required:
  - compatible

unevaluatedProperties: false

examples:
  - |
    #include <dt-bindings/gpio/gpio.h>
    #include <dt-bindings/pinctrl/rockchip.h>

    flexbus_fspi: spi {
        compatible = "rockchip,flexbus-fspi";
        fspi-cs-gpios = <&gpio4 RK_PB0 GPIO_ACTIVE_LOW>, <&gpio4 RK_PA5 GPIO_ACTIVE_LOW>;
        #address-cells = <1>;
        #size-cells = <0>;

        flash@0 {
            compatible = "jedec,spi-nor";
            reg = <0>;
            spi-max-frequency = <108000000>;
            spi-rx-bus-width = <1>;
            spi-tx-bus-width = <4>;
        };
    };

...
```

## Documentation/devicetree/bindings/spi/rockchip-sfc.yaml
```yaml
# SPDX-License-Identifier: (GPL-2.0-only OR BSD-2-Clause)
%YAML 1.2
---
$id: http://devicetree.org/schemas/spi/rockchip-sfc.yaml#
$schema: http://devicetree.org/meta-schemas/core.yaml#

title: Rockchip Serial Flash Controller (SFC)

maintainers:
  - Heiko Stuebner <heiko@sntech.de>
  - Chris Morgan <macromorgan@hotmail.com>

allOf:
  - $ref: spi-controller.yaml#

properties:
  compatible:
    enum:
      - rockchip,fspi
      - rockchip,rk3506-fspi
      - rockchip,rv1126b-fspi
      - rockchip,sfc

    description:
      The rockchip sfc controller is a standalone IP with version register,
      and the driver can handle all the feature difference inside the IP
      depending on the version register.
      The rockchip flexible spi controller is the next generation IP of sfc.

  reg:
    maxItems: 1

  interrupts:
    maxItems: 1

  clocks:
    items:
      - description: Bus Clock
      - description: Module Clock

  clock-names:
    items:
      - const: clk_sfc
      - const: hclk_sfc

  power-domains:
    maxItems: 1

  rockchip,sfc-no-dma:
    description: Disable DMA and utilize FIFO mode only
    type: boolean

  rockchip,sclk-x2-bypass:
    description:
      Turn off the internal 2 frequency division logic of the controller clock,
      and the interface clock is 1:1 with the controller working clock.
    type: boolean

  rockchip,max-dll:
    description:
      Setting maximum dll cell.

patternProperties:
  "^flash@[0-3]$":
    type: object
    additionalProperties: true

    properties:
      reg:
        minimum: 0
        maximum: 3

required:
  - compatible
  - reg
  - interrupts
  - clocks
  - clock-names

Optional properties:
  - sfc-cs-gpios: specifies the gpio pins to be used for chipselects.
    The gpios will be referred to as reg = <index> in the SPI child nodes.
    If unspecified, a single SPI device without a chip select can be used.
  - reset-gpios: specifies the reset gpio pin to be used for reseting the devices.

unevaluatedProperties: false

examples:
  - |
    #include <dt-bindings/clock/px30-cru.h>
    #include <dt-bindings/interrupt-controller/arm-gic.h>
    #include <dt-bindings/power/px30-power.h>

    sfc: spi@ff3a0000 {
        compatible = "rockchip,sfc";
        reg = <0xff3a0000 0x4000>;
        interrupts = <GIC_SPI 56 IRQ_TYPE_LEVEL_HIGH>;
        clocks = <&cru SCLK_SFC>, <&cru HCLK_SFC>;
        clock-names = "clk_sfc", "hclk_sfc";
        pinctrl-0 = <&sfc_clk &sfc_cs &sfc_bus2>;
        pinctrl-names = "default";
        power-domains = <&power PX30_PD_MMC_NAND>;
        sfc-cs-gpios = <&gpio4 RK_PB0 GPIO_ACTIVE_LOW>, <&gpio4 RK_PA5 GPIO_ACTIVE_LOW>;
        reset-gpios = <&gpio1 RK_PB0 GPIO_ACTIVE_LOW>;
        #address-cells = <1>;
        #size-cells = <0>;

        flash@0 {
            compatible = "jedec,spi-nor";
            reg = <0>;
            spi-max-frequency = <108000000>;
            spi-rx-bus-width = <2>;
            spi-tx-bus-width = <2>;
        };
    };

...
```

## Documentation/devicetree/bindings/usb/rockchip,pmic-tcpc.yaml
```yaml
# SPDX-License-Identifier: (GPL-2.0-only OR BSD-2-Clause)
%YAML 1.2
---
$id: http://devicetree.org/schemas/usb/rockchip,pmic-tcpc.yaml#
$schema: http://devicetree.org/meta-schemas/core.yaml#

title: Rockchip PMIC based USB Type-C and Power Delivery block

maintainers:
  - Frank Wang <frank.wang@rock-chips.com>

properties:
  compatible:
    enum:
      - rockchip,rk809c-tcpc
      - rockchip,rk817b2-tcpc

  reg:
    maxItems: 1

  interrupts:
    maxItems: 1

  io-channels:
    items:
      - description: ADC channel to measure the VSAFE0V voltage

  io-channel-names:
    items:
      - const: vsafe0v-detect

  port:
    $ref: /schemas/graph.yaml#/properties/port
    description: A port node to link the TCPC to a USB controller for the
                 purpose of supporting dual-role switch.

  connector:
    type: object
    $ref: /schemas/connector/usb-connector.yaml#
    description:
      Properties for USB-C connector that attached to the TCPC.

  rockchip,vsafe0v-det:
    $ref: /schemas/types.yaml#/definitions/flag
    description:
      When set, detect whether the VBUS voltage is below 800mV for TCPM.

required:
  - compatible
  - reg
  - interrupts
  - connector

additionalProperties: true

examples:
  - |
    #include <dt-bindings/gpio/gpio.h>
    #include <dt-bindings/interrupt-controller/irq.h>
    #include <dt-bindings/usb/pd.h>

    i2c {
        #address-cells = <1>;
        #size-cells = <0>;

        usbc: rk817b2-tcpc@21 {
            compatible = "rockchip,rk817b2-tcpc";
            reg = <0x21>;
            interrupt-parent = <&gpio0>;
            interrupts = <5 IRQ_TYPE_LEVEL_LOW>;
            pinctrl-names = "default";
            pinctrl-0 = <&usbc_int>;
            vbus-supply = <&vcc5v0_typec>;

            port {
                usbc_role_sw: endpoint {
                    remote-endpoint = <&usb_drd0_role_switch>;
                };
            };

            usb_con: connector {
                compatible = "usb-c-connector";
                label = "USB-C";
                data-role = "dual";
                power-role = "dual";
                try-power-role = "sink";
                pd-revision = /bits/ 8 <0x3 0x1 0x1 0x8>; /* PD Rev 3.1 Ver 1.8 */
                op-sink-microwatt = <1000000>;
                sink-pdos = <PDO_FIXED(5000, 1000, PDO_FIXED_DATA_SWAP |
                                                   PDO_FIXED_USB_COMM |
                                                   PDO_FIXED_EXTPOWER |
                                                   PDO_FIXED_DUAL_ROLE)>;
                source-pdos = <PDO_FIXED(5000, 1000, PDO_FIXED_DATA_SWAP |
                                                     PDO_FIXED_USB_COMM |
                                                     PDO_FIXED_EXTPOWER |
                                                     PDO_FIXED_DUAL_ROLE)>;
            };
        };
    };
...
```

## drivers/iio/imu/inv_icm42607/Kconfig
```kconfig
# SPDX-License-Identifier: GPL-2.0

config IIO_INV_ICM42607
	tristate "INV ICM42607 driver for 6-axis IMU MEMS sensors"
	depends on I2C || SPI
	select IIO_BUFFER
	select IIO_KFIFO_BUF
	select IIO_INV_ICM42607_I2C if (I2C)
	select IIO_INV_ICM42607_SPI if (SPI)
	help
	  Say yes here to build support for INV icm42607 sensor.

	  To compile this driver as a module, choose M here: the module
	  will be called inv_icm42607.

config IIO_INV_ICM42607_I2C
	tristate
	depends on IIO_INV_ICM42607
	depends on I2C
	select REGMAP_I2C

config IIO_INV_ICM42607_SPI
	tristate
	depends on IIO_INV_ICM42607
	depends on SPI
	select REGMAP_SPI
```

## drivers/media/platform/rockchip/vpss/Kconfig
```kconfig
# SPDX-License-Identifier: GPL-2.0
config VIDEO_ROCKCHIP_VPSS
	tristate "Rockchip Video Processing Sub System driver"
	depends on V4L_PLATFORM_DRIVERS
	depends on VIDEO_DEV
	depends on ARCH_ROCKCHIP || COMPILE_TEST
	depends on CPU_RK3576 || CPU_RV1126B || CPU_RK3572
	select VIDEO_V4L2_SUBDEV_API
	select VIDEOBUF2_CMA_SG
	default n
	help
	  Support for VPSS on the rockchip SoC.

config VIDEO_ROCKCHIP_VPSS_V10
	bool "vpss1.0 for rk3576"
	depends on VIDEO_ROCKCHIP_VPSS && CPU_RK3576
	default y if CPU_RK3576
	help
	 Support for rk3576

config VIDEO_ROCKCHIP_VPSS_V20
	bool "vpss2.0 for rv1126b"
	depends on VIDEO_ROCKCHIP_VPSS && CPU_RV1126B
	default y if CPU_RV1126B
	help
	 Support for rv1126b

config VIDEO_ROCKCHIP_VPSS_V21
	bool "vpss2.1 for rk3572"
	depends on VIDEO_ROCKCHIP_VPSS && CPU_RK3572
	default y if CPU_RK3572
	help
	 Support for rk3572
```

## drivers/net/can/rockchip/Kconfig
```kconfig
# SPDX-License-Identifier: GPL-2.0
config CAN_ROCKCHIP
	tristate "Rockchip CAN controller"
	depends on ARCH_ROCKCHIP
	help
	  Say Y here if you want to use CAN controller found on Rockchip SoCs.

	  To compile this driver as a module, choose M here: the module will
	  be called rockchip_can.

config CAN_RK3568
	tristate "RK3568 CAN controller"
	depends on ARCH_ROCKCHIP
	help
	  Say Y here if you want to use CAN controller found on RK3568 SoCs.

	  To compile this driver as a module, choose M here: the module will
	  be called rk3568_can.

config CAN_RK3562
	tristate "RK3562 CAN controller"
	depends on ARCH_ROCKCHIP
	help
	Say Y here if you want to use CAN controller found on RK3562 SoCs.

	To compile this driver as a module, choose M here: the module will
	be called rk3562_can.

config CAN_RK3576
	tristate "RK3576 CAN controller"
	depends on ARCH_ROCKCHIP
	help
	Say Y here if you want to use CAN controller found on RK3576 SoCs.

	To compile this driver as a module, choose M here: the module will
	be called rk3576_can.
```

## drivers/soc/rockchip/rknpu3/Kconfig
```kconfig
# SPDX-License-Identifier: GPL-2.0
menu "Rockchip RKNPU3"
	depends on ARCH_ROCKCHIP

config ROCKCHIP_RKNPU3
	tristate "Rockchip RKNPU3 Support"
	depends on OF
	select DMA_SHARED_BUFFER
	help
	  This driver provides support for Rockchip RKNPU3 (Neural Processing Unit).
	  RKNPU3 is a hardware accelerator for neural network inference on
	  Rockchip RK3572 and similar SoCs.

	  If you have a Rockchip SoC with NPU support and want to use the NPU
	  for AI acceleration, say Y or M here.

	  To compile this driver as a module, choose M here: the module
	  will be called rknpu3.

endmenu
```

## sound/soc/codecs/aw881xx/Kconfig
```kconfig
config SND_SOC_AW881XX
	tristate "SoC Audio for awinic AW881XX series Smart PA"
	depends on I2C
	help
	  This option enables support for AW881XX series Smart PA.
```
