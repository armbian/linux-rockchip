## Documentation/devicetree/bindings/clock/rockchip,rk3572-cru.yaml
```yaml
# SPDX-License-Identifier: GPL-2.0-only OR BSD-2-Clause
%YAML 1.2
---
$id: http://devicetree.org/schemas/clock/rockchip,rk3572-cru.yaml#
$schema: http://devicetree.org/meta-schemas/core.yaml#

title: ROCKCHIP RK3572 Family Clock Control Module Binding

maintainers:
  - Elaine Zhang <zhangqing@rock-chips.com>
  - Heiko Stuebner <heiko@sntech.de>

description: |
  The RK3572 clock controller generates the clock and also implements a
  reset controller for SoC peripherals.
  (examples: provide SCLK_UART2\PCLK_UART2 and SRST_P_UART2\SRST_S_UART2 for UART module)
  Each clock is assigned an identifier and client nodes can use this identifier
  to specify the clock which they consume. All available clocks are defined as
  preprocessor macros in the dt-bindings/clock/rockchip,rk3572-cru.h headers and can be
  used in device tree sources.

properties:
  compatible:
    enum:
      - rockchip,rk3572-cru

  reg:
    maxItems: 1

  "#clock-cells":
    const: 1

  "#reset-cells":
    const: 1

  clocks: true

  assigned-clocks:
    minItems: 1

  assigned-clock-parents:
    minItems: 1

  assigned-clock-rates:
    minItems: 1

required:
  - compatible
  - reg
  - "#clock-cells"
  - "#reset-cells"

additionalProperties: false

examples:
  # Clock Control Module node:
  - |
    cru: clock-controller@26090000 {
      compatible = "rockchip,rk3572-cru";
      reg = <0x26090000 0x60000>;
      #clock-cells = <1>;
      #reset-cells = <1>;
    };
```

## Documentation/devicetree/bindings/extcon/rockchip,extcon-usb.yaml
```yaml
# SPDX-License-Identifier: (GPL-2.0-only OR BSD-2-Clause)
%YAML 1.2
---
$id: http://devicetree.org/schemas/extcon/rockchip,extcon-usb.yaml#
$schema: http://devicetree.org/meta-schemas/core.yaml#

title: Rockchip USB Extcon device

maintainers:
  - Frank Wang <frank.wang@rock-chips.com>

description:
  This is a virtual device designed to forward Type-C cable state
  information from the TCPM to the USB Controller.

  This device supports up to two USB ports (extcon-usb-port0 and
  extcon-usb-port1). At least extcon-usb-port0 must be present.

properties:
  compatible:
    const: rockchip,extcon-usb

  orientation-switch:
    type: boolean
    description: Indicates the Type-C flip status of a given USB connector.

  usb-role-switch:
    type: boolean
    description: Indicates the USB data role of a given USB connector.

patternProperties:
  '^extcon-usb-port[0-1]$':
    type: object
    description: The extcon device forwards USB data role to a USB Controller.

    properties:
      rockchip,usbc-orientation:
        description: |
          Specify which Type-C side's USB data role to forward:
          - 1 indicates the normal side.
          - 2 indicates the reverse side;
          - If this property is absent, it represents both sides.
        $ref: /schemas/types.yaml#/definitions/uint32
        minimum: 1
        maximum: 2

      extcon:
        description: Phandle to the extcon device of USB2-PHY.
        $ref: /schemas/types.yaml#/definitions/phandle

    additionalProperties: false

required:
  - compatible
  - orientation-switch
  - usb-role-switch

additionalProperties: false

examples:
  - |
    extcon_usb: extcon-usb {
        compatible = "rockchip,extcon-usb";
        orientation-switch;
        usb-role-switch;

        extcon_usb_port0: extcon-usb-port0 {
            rockchip,usbc-orientation = <1>;
        };

        extcon_usb_port1: extcon-usb-port1 {
            rockchip,usbc-orientation = <2>;
        };
    };
```

## Documentation/devicetree/bindings/i3c/rockchip,i3c-master.yaml
```yaml
# SPDX-License-Identifier: (GPL-2.0-only OR BSD-2-Clause)
%YAML 1.2
---
$id: http://devicetree.org/schemas/i3c/rockchip,i3c-master.yaml#
$schema: http://devicetree.org/meta-schemas/core.yaml#

title: Rockchip I3C master block

maintainers:
  - David Wu <david.wu@rock-chips.com>

description: |
  The Rockchip I3C master controller provides an I3C bus interface
  compliant with the MIPI I3C specification.

allOf:
  - $ref: i3c.yaml#

properties:
  compatible:
    const: rockchip,i3c-master

  reg:
    maxItems: 1

  clocks:
    minItems: 2
    maxItems: 2

  clock-names:
    items:
      - const: hclk
      - const: i3c

  interrupts:
    maxItems: 1

  dmas:
    maxItems: 2

  dma-names:
    items:
      - const: rx
      - const: tx

  resets:
    maxItems: 2

  reset-names:
    items:
      - const: i3c
      - const: ahb

required:
  - compatible
  - reg
  - clocks
  - clock-names
  - interrupts

unevaluatedProperties: false

examples:
  - |
    #include <dt-bindings/clock/rockchip,rk3576-cru.h>
    #include <dt-bindings/reset/rockchip,rk3576-cru.h>
    #include <dt-bindings/interrupt-controller/arm-gic.h>

    i3c0: i3c@2abe0000 {
      compatible = "rockchip,i3c-master";
      reg = <0x2abe0000 0x1000>;
      interrupts = <GIC_SPI 98 IRQ_TYPE_LEVEL_HIGH>;
      #address-cells = <3>;
      #size-cells = <0>;
      clocks = <&cru HCLK_I3C0>, <&cru CLK_I3C0>;
      clock-names = "hclk", "i3c";
      dmas = <&dmac0 22>, <&dmac0 23>;
      dma-names = "rx", "tx";
      resets = <&cru SRST_I3C0>, <&cru SRST_H_I3C0>;
      reset-names = "i3c", "ahb";
    };
```

## Documentation/devicetree/bindings/media/i2c/galaxycore,gc02m0.yaml
```yaml
# SPDX-License-Identifier: (GPL-2.0-only OR BSD-2-Clause)
%YAML 1.2
---
$id: http://devicetree.org/schemas/media/i2c/galaxycore,gc02m0.yaml#
$schema: http://devicetree.org/meta-schemas/core.yaml#

title: GalaxyCore GC02M0 and GC02M1 camera sensors

maintainers:
  - JasonYANG170 <39414350+JasonYANG170@users.noreply.github.com>

description: |
  Two-megapixel sensors with a single MIPI CSI-2 data lane and a 24 MHz clock.
  Boards may share reset, with separate power-down lines for each sensor.

properties:
  compatible:
    enum:
      - galaxycore,gc02m0
      - galaxycore,gc02m1

  reg:
    maxItems: 1

  clocks:
    maxItems: 1

  clock-names:
    const: xvclk

  reset-gpios:
    maxItems: 1

  pwdn-gpios:
    maxItems: 1
    description: Power-down GPIO, with polarity matching the board wiring.

  avdd-supply:
    description: Analog power supply.

  dovdd-supply:
    description: Digital I/O power supply.

  dvdd-supply:
    description: Digital core power supply.

  power-domains:
    maxItems: 1

  rockchip,camera-module-index:
    $ref: /schemas/types.yaml#/definitions/uint32
    description: Camera module index.

  rockchip,camera-module-facing:
    $ref: /schemas/types.yaml#/definitions/string
    enum: [front, back]
    description: Camera module direction.

  rockchip,camera-module-name:
    $ref: /schemas/types.yaml#/definitions/string
    description: Camera module name.

  rockchip,camera-module-lens-name:
    $ref: /schemas/types.yaml#/definitions/string
    description: Camera lens name.

  port:
    $ref: /schemas/graph.yaml#/$defs/port-base
    additionalProperties: false
    properties:
      endpoint:
        $ref: /schemas/media/video-interfaces.yaml#
        unevaluatedProperties: false
        properties:
          data-lanes:
            items:
              - const: 1
        required:
          - data-lanes
    required:
      - endpoint

required:
  - compatible
  - reg
  - clocks
  - clock-names
  - rockchip,camera-module-index
  - rockchip,camera-module-facing
  - rockchip,camera-module-name
  - rockchip,camera-module-lens-name
  - port

additionalProperties: false

examples:
  - |
    i2c {
        #address-cells = <1>;
        #size-cells = <0>;

        camera@37 {
            compatible = "galaxycore,gc02m0";
            reg = <0x37>;
            clocks = <&camera_clk>;
            clock-names = "xvclk";
            rockchip,camera-module-index = <0>;
            rockchip,camera-module-facing = "back";
            rockchip,camera-module-name = "KYT-4877-V01";
            rockchip,camera-module-lens-name = "default";

            port {
                endpoint {
                    remote-endpoint = <&csi_in>;
                    data-lanes = <1>;
                };
            };
        };
    };
```
