## Documentation/devicetree/bindings/net/aicsemi-bluetooth.yaml
```yaml
# SPDX-License-Identifier: GPL-2.0
%YAML 1.2
---
$id: http://devicetree.org/schemas/net/aicsemi-bluetooth.yaml#
$schema: http://devicetree.org/meta-schemas/core.yaml#

title: AICsemi AIC8800 Bluetooth

maintainers:
  - Artem Butusov <art.sormy@gmail.com>

description:
  AIC8800 is a combo WiFi + Bluetooth chip. The WiFi side is attached over
  SDIO, the Bluetooth side over a serial port, where it speaks plain H4. The
  controller needs no firmware upload on this transport - the SDIO side brings
  the chip up - so the serial side is an ordinary H4 attachment.

properties:
  compatible:
    const: aicsemi,aic8800-bt

  max-speed: true

required:
  - compatible

additionalProperties: false

examples:
  - |
    serial {
        bluetooth {
            compatible = "aicsemi,aic8800-bt";
            max-speed = <1500000>;
        };
    };
```

## Documentation/devicetree/bindings/net/rockchip-bluetooth.yaml
```yaml
# SPDX-License-Identifier: (GPL-2.0 OR BSD-2-Clause)
%YAML 1.2
---
$id: http://devicetree.org/schemas/net/rockchip-bluetooth.yaml#
$schema: http://devicetree.org/meta-schemas/core.yaml#

title: Rockchip RK960/RK962 Bluetooth Controllers

maintainers:
  - Xiao Yao <xiaoyao@rock-chips.com>

description:
  Rockchip RK960 and RK962 are UART-attached Bluetooth controllers using the
  standard H4 transport together with Rockchip vendor commands for bootloader
  upload, firmware download and runtime configuration.

properties:
  compatible:
    enum:
      - rockchip,rk960-bt
      - rockchip,rk962-bt

  shutdown-gpios:
    maxItems: 1
    description: GPIO specifier for the BT_REG_ON / BT_NSHUTDOWN line used to
      power on the controller.

  reset-gpios:
    maxItems: 1
    description: Optional dedicated reset GPIO for the controller.

  max-speed:
    $ref: /schemas/types.yaml#/definitions/uint32
    description: The maximum baud rate the controller operates at.

  local-bd-address:
    $ref: /schemas/types.yaml#/definitions/uint8-array
    minItems: 6
    maxItems: 6
    description: see Documentation/devicetree/bindings/net/bluetooth.txt

  rockchip,init-speed:
    $ref: /schemas/types.yaml#/definitions/uint32
    description: Initial UART baud rate used before switching to max-speed.
      If omitted, the driver defaults to 115200.

  rockchip,enable-lpm:
    type: boolean
    description: Enable the controller low-power mode after firmware startup.

  rockchip,sco-data-path:
    $ref: /schemas/types.yaml#/definitions/uint8
    enum: [0, 1]
    description: Select SCO routing, 0 for Voice over HCI and 1 for hardware
      PCM.

  rockchip,sco-voice-setting:
    $ref: /schemas/types.yaml#/definitions/uint16
    description: Voice Setting value sent with HCI_Write_Voice_Setting. If
      omitted, the driver defaults to 0x0060.

required:
  - compatible

additionalProperties: false

examples:
  - |
    #include <dt-bindings/gpio/gpio.h>

    uart2 {
        uart-has-rtscts;

        bluetooth {
            compatible = "rockchip,rk960-bt";
            max-speed = <1500000>;
            reset-gpios = <&gpio0 0 GPIO_ACTIVE_HIGH>;
        };
    };
```

## Documentation/devicetree/bindings/phy/rockchip,px30-dsi-dphy.yaml
```yaml
# SPDX-License-Identifier: (GPL-2.0 OR BSD-2-Clause)
%YAML 1.2
---
$id: http://devicetree.org/schemas/phy/rockchip,px30-dsi-dphy.yaml#
$schema: http://devicetree.org/meta-schemas/core.yaml#

title: Rockchip MIPI DPHY with additional LVDS/TTL modes

maintainers:
  - Heiko Stuebner <heiko@sntech.de>

properties:
  "#phy-cells":
    const: 0

  compatible:
    enum:
      - rockchip,px30-dsi-dphy
      - rockchip,rk3128-dsi-dphy
      - rockchip,rk3368-dsi-dphy
      - rockchip,rk3568-dsi-dphy
      - rockchip,rv1126-dsi-dphy

  reg:
    maxItems: 1

  clocks:
    items:
      - description: PLL reference clock
      - description: Module clock

  clock-names:
    items:
      - const: ref
      - const: pclk

  power-domains:
    maxItems: 1
    description: phandle to the associated power domain

  resets:
    items:
      - description: exclusive PHY reset line

  reset-names:
    items:
      - const: apb

  inno,lanes:
    description: Number of MIPI DSI lanes used
    enum: [1, 2, 3, 4]

  inno,lvds-vcom:
    description: LVDS output common-mode voltage in millivolts
    enum: [850, 900, 950, 1000]

  inno,lvds-vod:
    description: LVDS output differential voltage in millivolts
    enum: [250, 300, 350, 400]

required:
  - "#phy-cells"
  - compatible
  - reg
  - clocks
  - clock-names
  - resets
  - reset-names

additionalProperties: false

examples:
  - |
    dsi_dphy: phy@ff2e0000 {
        compatible = "rockchip,px30-dsi-dphy";
        reg = <0xff2e0000 0x10000>;
        clocks = <&pmucru 13>, <&cru 12>;
        clock-names = "ref", "pclk";
        resets = <&cru 12>;
        reset-names = "apb";
        #phy-cells = <0>;
    };

...
```

## Documentation/devicetree/bindings/phy/rockchip,rk3588-hdptx-phy.yaml
```yaml
# SPDX-License-Identifier: (GPL-2.0-only OR BSD-2-Clause)
%YAML 1.2
---
$id: http://devicetree.org/schemas/phy/rockchip,rk3588-hdptx-phy.yaml#
$schema: http://devicetree.org/meta-schemas/core.yaml#

title: Rockchip SoC HDMI/eDP Transmitter Combo PHY

maintainers:
  - Cristian Ciocaltea <cristian.ciocaltea@collabora.com>

properties:
  compatible:
    enum:
      - rockchip,rk3588-hdptx-phy

  reg:
    maxItems: 1

  clocks:
    items:
      - description: Reference clock
      - description: APB clock

  clock-names:
    items:
      - const: ref
      - const: apb

  "#clock-cells":
    const: 0

  "#phy-cells":
    const: 0

  resets:
    items:
      - description: PHY reset line
      - description: APB reset line
      - description: INIT reset line
      - description: CMN reset line
      - description: LANE reset line
      - description: ROPLL reset line
      - description: LCPLL reset line

  reset-names:
    items:
      - const: phy
      - const: apb
      - const: init
      - const: cmn
      - const: lane
      - const: ropll
      - const: lcpll

  rockchip,grf:
    $ref: /schemas/types.yaml#/definitions/phandle
    description: Some PHY related data is accessed through GRF regs.

  rockchip,phy-table:
    $ref: /schemas/types.yaml#/definitions/uint8-array
    description:
      Optional TMDS and FRL lane tuning table. Each entry contains a link rate, 5 raw register
      values for lane 3, and 5 shared by lanes 0 through 2. Lane 3 is the TMDS clock lane or the
      fourth FRL data lane. Register order is 0303 swing, 0304 de-emphasis, 0305 pre-shoot, 0306
      drive current, and 0307 acceleration-driver control and polarity; override and polarity bits
      are ignored. Entries must be sorted by ascending rate. Rates up to 600 MHz select TMDS mode
      and higher rates select FRL mode; the first same-mode entry not below the requested rate is
      used. Each entry is packed as an 8-byte big-endian rate followed by 10 register bytes, so
      the total property length must be a multiple of 18 bytes. Define the rate with "/bits/ 64"
      and the register values with "/bits/ 8". If absent, the driver uses its default settings.

required:
  - compatible
  - reg
  - clocks
  - clock-names
  - "#phy-cells"
  - resets
  - reset-names
  - rockchip,grf

additionalProperties: false

examples:
  - |
    #include <dt-bindings/clock/rockchip,rk3588-cru.h>
    #include <dt-bindings/reset/rockchip,rk3588-cru.h>

    soc {
      #address-cells = <2>;
      #size-cells = <2>;

      phy@fed60000 {
        compatible = "rockchip,rk3588-hdptx-phy";
        reg = <0x0 0xfed60000 0x0 0x2000>;
        clocks = <&cru CLK_USB2PHY_HDPTXRXPHY_REF>, <&cru PCLK_HDPTX0>;
        clock-names = "ref", "apb";
        #phy-cells = <0>;
        resets = <&cru SRST_HDPTX0>, <&cru SRST_P_HDPTX0>,
                 <&cru SRST_HDPTX0_INIT>, <&cru SRST_HDPTX0_CMN>,
                 <&cru SRST_HDPTX0_LANE>, <&cru SRST_HDPTX0_ROPLL>,
                 <&cru SRST_HDPTX0_LCPLL>;
        reset-names = "phy", "apb", "init", "cmn", "lane", "ropll", "lcpll";
        rockchip,grf = <&hdptxphy_grf>;
        rockchip,phy-table =
          /bits/ 64 <165000000>,
          /bits/ 8 <0x2f 0x03 0x03 0x1d 0x08 0x2f 0x03 0x03 0x1d 0x08>,
          /bits/ 64 <340000000>,
          /bits/ 8 <0x2f 0x03 0x03 0x1d 0x08 0x2f 0x03 0x03 0x1d 0x08>,
          /bits/ 64 <600000000>,
          /bits/ 8 <0x2f 0x03 0x03 0x1d 0x08 0x2f 0x03 0x03 0x1d 0x08>,
          /bits/ 64 <4800000000>,
          /bits/ 8 <0x2f 0x14 0x4f 0xfc 0x08 0x2f 0x14 0x4f 0xfc 0x08>;
      };
    };
```

## Documentation/devicetree/bindings/pwm/pwm-rockchip.yaml
```yaml
# SPDX-License-Identifier: GPL-2.0
%YAML 1.2
---
$id: http://devicetree.org/schemas/pwm/pwm-rockchip.yaml#
$schema: http://devicetree.org/meta-schemas/core.yaml#

title: Rockchip PWM controller

maintainers:
  - Heiko Stuebner <heiko@sntech.de>

properties:
  compatible:
    oneOf:
      - const: rockchip,rk2928-pwm
      - const: rockchip,rk3288-pwm
      - const: rockchip,rk3328-pwm
      - const: rockchip,vop-pwm
      - items:
          - const: rockchip,rk3036-pwm
          - const: rockchip,rk2928-pwm
      - items:
          - enum:
              - rockchip,rk3128-pwm
              - rockchip,rk3368-pwm
              - rockchip,rk3399-pwm
              - rockchip,rv1108-pwm
          - const: rockchip,rk3288-pwm
      - items:
          - enum:
              - rockchip,px30-pwm
              - rockchip,rk3308-pwm
          - const: rockchip,rk3328-pwm
      - const: rockchip,rv1126-pwm
      - items:
          - enum:
              - rockchip,rk3528-pwm
              - rockchip,rk3562-pwm
              - rockchip,rk3568-pwm
              - rockchip,rk3588-pwm
              - rockchip,rv1106-pwm
          - const: rockchip,rv1126-pwm

  reg:
    maxItems: 1

  clocks:
    minItems: 1
    maxItems: 3

  clock-names:
    maxItems: 3

  rockchip,clk-src:
    $ref: /schemas/types.yaml#/definitions/string
    enum: [pwm, osc, rc]
    default: pwm
    description:
      Select the clock source of the PWM controller. The 'pwm' clock
      comes from the CRU, the 'osc' clock is typically the 24MHz
      oscillator, and the 'rc' clock is the internal RC oscillator
      which is only supported by PWM v4. If unspecified, the 'pwm'
      clock is used.

  "#pwm-cells":
    enum: [2, 3]
    description:
      Must be 2 (rk2928) or 3 (rk3288 and later).
      See pwm.yaml for a description of the cell format.

required:
  - compatible
  - reg

allOf:
  - $ref: pwm.yaml#

  - if:
      properties:
        compatible:
          contains:
            enum:
              - rockchip,rk3328-pwm
              - rockchip,rv1108-pwm

    then:
      properties:
        clocks:
          items:
            - description: Used to derive the functional clock for the device.
            - description: Used as the APB bus clock.

        clock-names:
          items:
            - const: pwm
            - const: pclk

      required:
        - clocks
        - clock-names

    else:
      if:
        properties:
          compatible:
            contains:
              const: rockchip,rv1126-pwm

      then:
        properties:
          clocks:
            minItems: 2
            items:
              - description: Used to derive the functional clock for the device.
              - description: Used as the APB bus clock.
              - description: Alternative clock source for the PWM controller,
                  typically the 24MHz oscillator clock.

          clock-names:
            minItems: 2
            items:
              - const: pwm
              - const: pclk
              - const: osc

        required:
          - clocks
          - clock-names

      else:
        properties:
          clocks:
            maxItems: 1
            description:
              Used both to derive the functional clock
              for the device and as the bus clock.

        required:
          - clocks

additionalProperties: false

examples:
  - |
    #include <dt-bindings/clock/rk3188-cru-common.h>
    pwm0: pwm@20030000 {
      compatible = "rockchip,rk2928-pwm";
      reg = <0x20030000 0x10>;
      clocks = <&cru PCLK_PWM01>;
      #pwm-cells = <2>;
    };
```

## Documentation/devicetree/bindings/spi/rockchip,fspi-nm.yaml
```yaml
# SPDX-License-Identifier: (GPL-2.0-only OR BSD-2-Clause)
%YAML 1.2
---
$id: http://devicetree.org/schemas/spi/rockchip,fspi-nm.yaml#
$schema: http://devicetree.org/meta-schemas/core.yaml#

title: Rockchip Flexible Serial Peripheral Interface Normal Mode (FSPI NM)

maintainers:
  - Heiko Stuebner <heiko@sntech.de>
  - Chris Morgan <macromorgan@hotmail.com>

allOf:
  - $ref: spi-controller.yaml#

properties:
  compatible:
    enum:
      - rockchip,fspi-nm

    description:
      The rockchip flexible serial peripheral interface(FSPI) is a standalone
      IP with version register, and the driver can handle all the feature
      difference inside the IP depending on the version register.

  reg:
    maxItems: 1

  interrupts:
    maxItems: 1

  clocks:
    items:
      - description: Bus Clock
      - description: Module Clock

  clock-names:
    items:
      - const: clk_sfc
      - const: hclk_sfc

  power-domains:
    maxItems: 1

  rockchip,fspi-no-dma:
    description: Disable DMA and utilize FIFO mode only
    type: boolean

  rockchip,sclk-x2-bypass:
    description:
      Turn off the internal 2 frequency division logic of the controller clock,
      and the interface clock is 1:1 with the controller working clock.
    type: boolean

  rockchip,max-dll:
    description:
      Setting maximum dll cell.
    $ref: /schemas/types.yaml#/definitions/uint32

required:
  - compatible
  - reg
  - interrupts
  - clocks
  - clock-names

unevaluatedProperties: false

examples:
  - |
    fspi: spi@ff3a0000 {
        compatible = "rockchip,fspi-nm";
        reg = <0xff3a0000 0x4000>;
        interrupts = <GIC_SPI 56 IRQ_TYPE_LEVEL_HIGH>;
        clocks = <&cru SCLK_SFC>, <&cru HCLK_SFC>;
        clock-names = "clk_sfc", "hclk_sfc";
        pinctrl-0 = <&fspim2_pins>;
        pinctrl-names = "default";
        power-domains = <&power PX30_PD_MMC_NAND>;
        #address-cells = <1>;
        #size-cells = <0>;

        spidev@0 {
            compatible = "rockchip,spidev";
            reg = <0>;
            spi-max-frequency = <80000000>;
            spi-rx-bus-width = <4>;
            spi-tx-bus-width = <4>;
        };
    };

...
```
