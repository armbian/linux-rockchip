## Documentation/devicetree/bindings/sound/rockchip,multicodecs.txt
```
ROCKCHIP multicodecs audio

Required properties:
- compatible: "rockchip,multicodecs-card"
- rockchip,cpu: The phandle of the Rockchip I2S/PDM controller that's
  connected to the CODEC
- rockchip,codec: The phandle of audio codecs

Optional properties:
- rockchip,card-name: User specified audio sound card name, one string property.
- rockchip,codec-hp-det : Detect the headphone via internal codec.
- rockchip,wait-card-locked : This is a variable length array, user specified
			      these sound cards need to be prepared and locked,
			      otherwise the local slave card can be probed.
- rockchip,audio-routing : sound card dapm routing.
- hp-det-gpio : headphone detect gpio.
- io-channels : headset mic/key detect adc channel.
- io-channel-names : headset mic/key adc channel name.
- spk-con-gpio : speaker enable/disabled gpio.
- hp-con-gpio : headphone enable/disabled gpio.
- keyup-threshold-microvolt: keyup-threshold-microvolt uV.
- poll-interval : headset adc key poller internal ms.
- play-pause-key : PLAYPAUSE key, can define the other key like vol+/vol- and so on.


Optional dai-link subnode properties:
- rockchip,format			: CPU/CODEC common audio format.
					  "i2s", "right_j", "left_j" , "dsp_a"
					  "dsp_b", "ac97", "pdm", "msb", "lsb".
- rockchip,frame-master			: Indicates dai-link frame master.
					  phandle to a cpu or codec subnode.
- rockchip,bitclock-master		: Indicates dai-link bit clock master.
					  phandle to a cpu or codec subnode.
- rockchip,bitclock-inversion		: bool property. Add this if the
					  dai-link uses bit clock inversion.
- rockchip,frame-inversion		: bool property. Add this if the
					  dai-link uses frame clock inversion.
- rockchip,mclk-fs			: Multiplication factor between stream
					  rate and codec mclk, applied only for
					  the dai-link.
- rockchip,mclk-fs-mapping		: u32 properties. Multiplication factor
					  between steam rate and codec mclk,
					  these values will overwrite the mclk-fs.
					  mclk-fs-mapping = <256 1024> means:
					  (mclk of first codec) = 256 * fs,
					  (mclk of second codec) = 1024 * fs.

Example:

sound {
	compatible = "rockchip,multicodecs-card";
	rockchip,mclk-fs = <256>;
	rockchip,cpu = <&i2s0_8ch>;
	rockchip,codec = <&codec>, <&vad>;
};

Example 2 :

es8388_sound: es8388-sound {
	status = "okay";
	compatible = "rockchip,multicodecs-card";
	rockchip,card-name = "rockchip-es8388";
	hp-det-gpio = <&gpio1 RK_PD5 GPIO_ACTIVE_LOW>;
	io-channels = <&saradc 3>;
	io-channel-names = "adc-detect";
	spk-con-gpio = <&gpio1 RK_PD3 GPIO_ACTIVE_HIGH>;
	hp-con-gpio = <&gpio1 RK_PD2 GPIO_ACTIVE_HIGH>;
	rockchip,format = "i2s";
	rockchip,mclk-fs = <256>;
	rockchip,cpu = <&i2s0_8ch>;
	rockchip,codec = <&es8388>;
	rockchip,audio-routing =
                        "Headphone", "LOUT1",
                        "Headphone", "ROUT1",
                        "Speaker", "LOUT2",
                        "Speaker", "ROUT2",
                        "Headphone", "Headphone Power",
                        "Headphone", "Headphone Power",
                        "Speaker", "Speaker Power",
                        "Speaker", "Speaker Power",
                        "LINPUT1", "Main Mic",
                        "LINPUT2", "Main Mic",
                        "RINPUT1", "Headset Mic",
                        "RINPUT2", "Headset Mic";
        pinctrl-names = "default";
        pinctrl-0 = <&hp_det>;
        keyup-threshold-microvolt = <1800000>;
        poll-interval = <100>;
        play-pause-key{
                label = "playpause";
                linux,code = <KEY_PLAYPAUSE>;
                press-threshold-microvolt = <2000>;
	};
};

Example 3 for rockchip,mclk-fs-mapping:

sai_dais: sai-dais {
	status = "okay";
	compatible = "rockchip,multi-dais";
	dais = <&sai1>, <&sai4>;
	capture,channel-mapping = <2 2>;
	playback,channel-mapping = <2 0>;
	bitclock-inversion = <0 0>;
	mclk-fs-mapping = <256 1024>;
};

es8388_sound: es8388-sound {
	status = "okay";
	compatible = "rockchip,multicodecs-card";
	rockchip,card-name = "rockchip-es8388";
	spk-con-gpio = <&gpio1 RK_PC6 GPIO_ACTIVE_HIGH>;
	rockchip,pre-power-on-delay-ms = <30>;
	rockchip,post-power-down-delay-ms = <40>;
	rockchip,format = "i2s";
	rockchip,cpu = <&sai_dais>;
	rockchip,codec = <&es8388>, <&audio_codec>;
	rockchip,mclk-fs = <256>;
	rockchip,mclk-fs-mapping = <256 1024>;
	rockchip,audio-routing =
		"Speaker", "LOUT1",
		"Speaker", "ROUT1",
		"Speaker", "Speaker Power",
		"Speaker", "Speaker Power",
		"LINPUT1", "Main Mic",
		"LINPUT2", "Main Mic",
		"RINPUT1", "Main Mic",
		"RINPUT2", "Main Mic";
	pinctrl-names = "default";
	pinctrl-0 = <&spk_ctrl>;
};
```

## Documentation/devicetree/bindings/sound/rockchip,multidais.txt
```
ROCKCHIP multi dais driver

Required properties:
- compatible: "rockchip,multi-dais"
  - "rockchip,rk3308-multi-dais"
- dais: The phandle of sub dais, such i2s, pdm etc.
- capture,channel-mapping: map channels, one for each in dais,
  capture,channel-mapping = <2 6> means:
  i2s 2ch + pdm 6ch --> total 8ch capture.
- playback,channel-mapping: map channels, one for each in dais.
  playback,channel-mapping = <4 4> means:
  i2s 4ch + pdm 4ch --> total 8ch playback.

Required properties for i2s 16ch:
- rockchip,grf: the phandle of the syscon node for GRF register.

Optional properties:
- frame-master: bool properties, frame master, one for each in dais.
- bitclock-master: bool properties, bit clock master, one for each in dais.
- bitclock-inversion: bool properties, bit clock inversion, one for each in dais.
- frame-inversion: bool properties, frame clock inversion, one for each in dais.
- mclk-fs-mapping: u32 properties, multiplication factor between stream
		   rate and codec mclk, one for each in dais.
		   mclk-fs-mapping = <256 1024> means:
		   (mclk of first dai) = 256 * fs,
		   (mclk of second dai) = 1024 * fs.

Example:

multi_dais: multi-dais {
	status = "okay";
	compatible = "rockchip,multi-dais";
	dais = <&i2s_8ch_2>, <&pdm_8ch>;
	capture,channel-mapping = <2 6>;
	playback,channel-mapping = <4 4>;
	bitclock-master = <1 0>;
	frame-master = <1 0>;
	bitclock-inversion = <0 0>;
	frame-inversion = <0 0>;
	rockchip,grf = <&grf>;
};

&i2s_8ch_2 {
	status = "okay";
	rockchip,no-dmaengine;
};

&pdm_8ch {
	status = "okay";
	rockchip,no-dmaengine;
};

vad-sound {
	status = "okay";
	compatible = "rockchip,multicodecs-card";
	rockchip,card-name = "rockchip,rk3308-vad";
	rockchip,cpu = <&multi_dais>;
	rockchip,codec = <&acodec>, <&vad>;
};

Example 2 for mclk-fs-mapping:

sai_dais: sai-dais {
	status = "okay";
	compatible = "rockchip,multi-dais";
	dais = <&sai1>, <&sai4>;
	capture,channel-mapping = <2 2>;
	playback,channel-mapping = <2 0>;
	bitclock-inversion = <0 0>;
	mclk-fs-mapping = <256 1024>;
};

es8388_sound: es8388-sound {
	status = "okay";
	compatible = "rockchip,multicodecs-card";
	rockchip,card-name = "rockchip-es8388";
	spk-con-gpio = <&gpio1 RK_PC6 GPIO_ACTIVE_HIGH>;
	rockchip,pre-power-on-delay-ms = <30>;
	rockchip,post-power-down-delay-ms = <40>;
	rockchip,format = "i2s";
	rockchip,cpu = <&sai_dais>;
	rockchip,codec = <&es8388>, <&audio_codec>;
	rockchip,mclk-fs = <256>;
	rockchip,mclk-fs-mapping = <256 1024>;
	rockchip,audio-routing =
		"Speaker", "LOUT1",
		"Speaker", "ROUT1",
		"Speaker", "Speaker Power",
		"Speaker", "Speaker Power",
		"LINPUT1", "Main Mic",
		"LINPUT2", "Main Mic",
		"RINPUT1", "Main Mic",
		"RINPUT2", "Main Mic";
	pinctrl-names = "default";
	pinctrl-0 = <&spk_ctrl>;
};
```

## Documentation/devicetree/bindings/spi/rockchip-flexbus-spi.yaml
```yaml
# SPDX-License-Identifier: (GPL-2.0-only OR BSD-2-Clause)
%YAML 1.2
---
$id: http://devicetree.org/schemas/spi/rockchip-flexbus-spi.yaml#
$schema: http://devicetree.org/meta-schemas/core.yaml#

title: Rockchip Flexbus controller under SPI transmission protocol

maintainers:
  - Jon Lin <jon.lin@rock-chips.com>

allOf:
  - $ref: spi-controller.yaml#

properties:
  compatible:
    const: rockchip,flexbus-spi
    description:
      The rockchip flexbus controller is a standalone IP with version register,
      and the driver can handle all the feature difference inside the IP
      depending on the version register.

  rockchip,dll-cells:
    description:
      Setting dll cells.

  rockchip,dfs:
    description:
      Setting data width.

  rockchip,poll-only:
    description: Add this property to set the wait idle method as CPU polling.
    type: boolean

required:
  - compatible

unevaluatedProperties: false

examples:
  - |
    flexbus_spi: spi@ff3a0000 {
        compatible = "rockchip,flexbus-spi";
        rockchip,dfs = <16>;
        #address-cells = <1>;
        #size-cells = <0>;

        spidev@0 {
            compatible = "rockchip,spidev";
            reg = <0>;
            spi-max-frequency = <50000000>;
        };
    };

...
```

## arch/arm/configs/rv1126b_defconfig
```kconfig
# CONFIG_LOCALVERSION_AUTO is not set
CONFIG_KERNEL_XZ=y
CONFIG_DEFAULT_HOSTNAME="localhost"
CONFIG_SYSVIPC=y
CONFIG_NO_HZ_IDLE=y
CONFIG_HIGH_RES_TIMERS=y
CONFIG_LOG_BUF_SHIFT=14
CONFIG_CC_OPTIMIZE_FOR_SIZE=y
CONFIG_LD_DEAD_CODE_DATA_ELIMINATION=y
# CONFIG_BUG is not set
# CONFIG_ELF_CORE is not set
# CONFIG_BASE_FULL is not set
# CONFIG_IO_URING is not set
CONFIG_EMBEDDED=y
CONFIG_ARCH_ROCKCHIP=y
# CONFIG_HARDEN_BRANCH_PREDICTOR is not set
# CONFIG_HARDEN_BRANCH_HISTORY is not set
# CONFIG_VDSO is not set
# CONFIG_CACHE_L2X0 is not set
# CONFIG_ARM_ERRATA_643719 is not set
CONFIG_SMP=y
CONFIG_SCHED_MC=y
CONFIG_VMSPLIT_3G_OPT=y
CONFIG_HOTPLUG_CPU=y
CONFIG_ARM_PSCI=y
CONFIG_THUMB2_KERNEL=y
CONFIG_HIGHMEM=y
# CONFIG_CPU_SW_DOMAIN_PAN is not set
CONFIG_ARCH_FORCE_MAX_ORDER=9
CONFIG_UACCESS_WITH_MEMCPY=y
# CONFIG_STACKPROTECTOR_PER_TASK is not set
CONFIG_CMDLINE="user_debug=31"
CONFIG_CMDLINE_EXTEND=y
CONFIG_CPU_FREQ=y
CONFIG_CPU_FREQ_DEFAULT_GOV_ONDEMAND=y
CONFIG_CPU_FREQ_GOV_USERSPACE=y
CONFIG_CPUFREQ_DT=y
CONFIG_ARM_ROCKCHIP_CPUFREQ=y
CONFIG_CPU_IDLE=y
CONFIG_ARM_CPUIDLE=y
CONFIG_ARM_PSCI_CPUIDLE=y
# CONFIG_ARM_PSCI_CPUIDLE_DOMAIN is not set
CONFIG_VFP=y
CONFIG_NEON=y
# CONFIG_SUSPEND is not set
CONFIG_JUMP_LABEL=y
# CONFIG_SECCOMP is not set
# CONFIG_STACKPROTECTOR_STRONG is not set
# CONFIG_STRICT_KERNEL_RWX is not set
CONFIG_MODULES=y
CONFIG_MODULE_UNLOAD=y
CONFIG_PARTITION_ADVANCED=y
# CONFIG_MSDOS_PARTITION is not set
CONFIG_CMDLINE_PARTITION=y
# CONFIG_MQ_IOSCHED_KYBER is not set
CONFIG_IOSCHED_BFQ=y
# CONFIG_SWAP is not set
CONFIG_KSM=y
CONFIG_DEFAULT_MMAP_MIN_ADDR=32768
CONFIG_CMA=y
CONFIG_CMA_INACTIVE=y
# CONFIG_VM_EVENT_COUNTERS is not set
CONFIG_LRU_GEN=y
CONFIG_LRU_GEN_ENABLED=y
CONFIG_NET=y
CONFIG_PACKET=y
CONFIG_UNIX=y
CONFIG_INET=y
CONFIG_INET_TABLE_PERTURB_ORDER=8
# CONFIG_INET_DIAG is not set
# CONFIG_IPV6 is not set
# CONFIG_WIRELESS is not set
CONFIG_DEVTMPFS=y
CONFIG_DEVTMPFS_MOUNT=y
# CONFIG_ALLOW_DEV_COREDUMP is not set
CONFIG_ROCKCHIP_SIP=y
CONFIG_MTD=y
CONFIG_MTD_CMDLINE_PARTS=y
# CONFIG_MTD_OF_PARTS is not set
CONFIG_NETDEVICES=y
# CONFIG_NET_CORE is not set
CONFIG_STMMAC_ETH=y
# CONFIG_DWMAC_GENERIC is not set
CONFIG_ROCKCHIP_FEPHY=y
# CONFIG_WLAN is not set
# CONFIG_INPUT is not set
# CONFIG_SERIO is not set
# CONFIG_VT is not set
# CONFIG_LEGACY_PTYS is not set
CONFIG_SERIAL_8250=y
# CONFIG_SERIAL_8250_DEPRECATED_OPTIONS is not set
# CONFIG_SERIAL_8250_16550A_VARIANTS is not set
CONFIG_SERIAL_8250_CONSOLE=y
CONFIG_SERIAL_8250_NR_UARTS=8
CONFIG_SERIAL_8250_RUNTIME_UARTS=8
CONFIG_SERIAL_8250_DW=y
CONFIG_HW_RANDOM=y
CONFIG_HW_RANDOM_ROCKCHIP=y
# CONFIG_RANDOM_TRUST_BOOTLOADER is not set
CONFIG_I2C=y
CONFIG_I2C_CHARDEV=y
CONFIG_I2C_RK3X=y
# CONFIG_PTP_1588_CLOCK is not set
CONFIG_GPIO_SYSFS=y
CONFIG_POWER_RESET=y
CONFIG_POWER_RESET_RESTART=y
CONFIG_SYSCON_REBOOT_MODE=y
CONFIG_POWER_SUPPLY=y
# CONFIG_HWMON is not set
CONFIG_THERMAL=y
CONFIG_THERMAL_WRITABLE_TRIPS=y
CONFIG_THERMAL_GOV_USER_SPACE=y
CONFIG_CPU_THERMAL=y
CONFIG_DEVFREQ_THERMAL=y
CONFIG_ROCKCHIP_THERMAL=y
CONFIG_WATCHDOG=y
CONFIG_DW_WATCHDOG=y
CONFIG_MFD_RK808=y
CONFIG_REGULATOR_FIXED_VOLTAGE=y
CONFIG_REGULATOR_GPIO=y
CONFIG_REGULATOR_PWM=y
CONFIG_REGULATOR_RK801=y
CONFIG_REGULATOR_RK808=y
CONFIG_MEDIA_SUPPORT=y
CONFIG_MEDIA_SUPPORT_FILTER=y
# CONFIG_MEDIA_SUBDRV_AUTOSELECT is not set
CONFIG_MEDIA_CAMERA_SUPPORT=y
CONFIG_MEDIA_PLATFORM_SUPPORT=y
CONFIG_V4L_PLATFORM_DRIVERS=y
CONFIG_VIDEO_ROCKCHIP_AIISP=m
CONFIG_VIDEO_ROCKCHIP_AVSP=m
CONFIG_VIDEO_ROCKCHIP_CIF=m
CONFIG_VIDEO_ROCKCHIP_ISP=m
CONFIG_VIDEO_ROCKCHIP_VPSS=m
CONFIG_VIDEOBUF2_CMA_SG=y
CONFIG_VIDEOBUF2_VMALLOC=y
CONFIG_VIDEO_RK_IRCUT=y
CONFIG_ROCKCHIP_MULTI_RGA=m
CONFIG_ROCKCHIP_MPP_OSAL=y
CONFIG_ROCKCHIP_DVBM=m
CONFIG_SOUND=y
CONFIG_SND=y
# CONFIG_SND_PCM_TIMER is not set
# CONFIG_SND_SUPPORT_OLD_API is not set
# CONFIG_SND_DRIVERS is not set
# CONFIG_SND_ARM is not set
CONFIG_SND_SOC=y
CONFIG_SND_SOC_ROCKCHIP=y
CONFIG_SND_SOC_ROCKCHIP_SAI=y
CONFIG_SND_SOC_RK3506=y
CONFIG_SND_SIMPLE_CARD=y
# CONFIG_USB_SUPPORT is not set
CONFIG_RTC_CLASS=y
CONFIG_RTC_DRV_RK808=y
CONFIG_RTC_DRV_ROCKCHIP=y
CONFIG_DMADEVICES=y
CONFIG_ROCKCHIP_DMA=y
CONFIG_DMABUF_PARTIAL=y
CONFIG_SYNC_FILE=y
CONFIG_DMABUF_HEAPS=y
CONFIG_DMABUF_HEAPS_SYSTEM=y
CONFIG_DMABUF_HEAPS_ROCKCHIP=y
CONFIG_DMABUF_HEAPS_ROCKCHIP_CMA_HEAP=y
CONFIG_DMABUF_HEAPS_ROCKCHIP_CMA_ALIGNMENT=0
CONFIG_DMABUF_RK_HEAPS_DEBUG=y
# CONFIG_VIRTIO_MENU is not set
# CONFIG_VHOST_MENU is not set
CONFIG_STAGING=y
CONFIG_COMMON_CLK_PROCFS=y
CONFIG_COMMON_CLK_RK808=y
CONFIG_ROCKCHIP_CLK_OUT=y
CONFIG_ROCKCHIP_CLK_PVTPLL=y
# CONFIG_ARM_ARCH_TIMER_EVTSTREAM is not set
CONFIG_ROCKCHIP_IOMMU=y
CONFIG_CPU_RV1126B=y
CONFIG_ROCKCHIP_AMP=y
CONFIG_ROCKCHIP_CPUINFO=y
CONFIG_ROCKCHIP_PM_DOMAINS=y
CONFIG_ROCKCHIP_SYSTEM_MONITOR=y
CONFIG_FIQ_DEBUGGER=y
CONFIG_FIQ_DEBUGGER_NO_SLEEP=y
CONFIG_FIQ_DEBUGGER_CONSOLE=y
CONFIG_FIQ_DEBUGGER_CONSOLE_DEFAULT_ENABLE=y
CONFIG_RK_CONSOLE_THREAD=y
CONFIG_ROCKCHIP_MINI_KERNEL=y
CONFIG_ROCKCHIP_NPOR_POWERGOOD=y
CONFIG_PM_DEVFREQ=y
CONFIG_DEVFREQ_GOV_SIMPLE_ONDEMAND=y
CONFIG_DEVFREQ_GOV_USERSPACE=y
CONFIG_IIO=y
CONFIG_ROCKCHIP_SARADC=y
CONFIG_PWM=y
CONFIG_PWM_ROCKCHIP=y
CONFIG_PHY_ROCKCHIP_CSI2_DPHY=m
CONFIG_PHY_ROCKCHIP_MIPI_RX=y
# CONFIG_NVMEM_SYSFS is not set
CONFIG_NVMEM_ROCKCHIP_OTP=y
CONFIG_ROCKCHIP_RKNPU=m
CONFIG_ROCKCHIP_RKNPU_PROC_FS=y
# CONFIG_FILE_LOCKING is not set
# CONFIG_DNOTIFY is not set
CONFIG_TMPFS=y
CONFIG_SQUASHFS=y
# CONFIG_SQUASHFS_ZLIB is not set
CONFIG_SQUASHFS_XZ=y
CONFIG_SQUASHFS_4K_DEVBLK_SIZE=y
# CONFIG_NETWORK_FILESYSTEMS is not set
CONFIG_NLS=y
# CONFIG_XZ_DEC_X86 is not set
# CONFIG_XZ_DEC_POWERPC is not set
# CONFIG_XZ_DEC_IA64 is not set
# CONFIG_XZ_DEC_SPARC is not set
CONFIG_DMA_CMA=y
CONFIG_CMA_SIZE_MBYTES=0
CONFIG_PRINTK_TIME=y
CONFIG_PRINTK_TIME_FROM_ARM_ARCH_TIMER=y
# CONFIG_DEBUG_MISC is not set
CONFIG_DEBUG_INFO_DWARF_TOOLCHAIN_DEFAULT=y
# CONFIG_SLUB_DEBUG is not set
# CONFIG_SCHED_DEBUG is not set
# CONFIG_RCU_TRACE is not set
# CONFIG_FTRACE is not set
# CONFIG_RUNTIME_TESTING_MENU is not set
```
