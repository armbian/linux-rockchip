## Documentation/devicetree/bindings/auxdisplay/vinka,vk2c21.yaml
```yaml
# SPDX-License-Identifier: (GPL-2.0-only OR BSD-2-Clause)
%YAML 1.2
---
$id: http://devicetree.org/schemas/auxdisplay/vinka,vk2c21.yaml#
$schema: http://devicetree.org/meta-schemas/core.yaml#

title: Vinka VK2C21 Segment LCD Controller

maintainers:
  - Ricardo Pardini <ricardo@pardini.net>

description: |
  The Vinka VK2C21 (and pin-compatible VK2C21A/VK2C21B) is a memory-mapping
  segment LCD controller that communicates over I2C.  It can drive up to
  128 segments (e.g. 32 SEG × 4 COM in 1/3 bias mode).

  Many low-cost SBCs wire this chip to GPIO pins without I2C pull-up
  resistors, making the standard i2c-gpio (open-drain) driver unusable.
  This driver therefore bit-bangs I2C in push-pull mode directly via GPIO,
  requiring no external pull-ups.

properties:
  compatible:
    const: vinka,vk2c21

  sda-gpios:
    description: GPIO line used for I2C SDA (data).
    maxItems: 1

  scl-gpios:
    description: GPIO line used for I2C SCL (clock).
    maxItems: 1

  clock-frequency:
    description: Desired I2C clock frequency in Hz.
    default: 100000
    minimum: 1000
    maximum: 400000

required:
  - compatible
  - sda-gpios
  - scl-gpios

additionalProperties: false

examples:
  - |
    #include <dt-bindings/gpio/gpio.h>
    #include <dt-bindings/pinctrl/rockchip.h>

    / {
        segment-lcd {
            compatible = "vinka,vk2c21";
            sda-gpios = <&gpio0 RK_PC4 GPIO_ACTIVE_HIGH>;
            scl-gpios = <&gpio0 RK_PC5 GPIO_ACTIVE_HIGH>;
            clock-frequency = <100000>;
        };
    };
```

## Documentation/devicetree/bindings/clock/rockchip,rk3506-cru.yaml
```yaml
# SPDX-License-Identifier: GPL-2.0-only OR BSD-2-Clause
%YAML 1.2
---
$id: http://devicetree.org/schemas/clock/rockchip,rk3506-cru.yaml#
$schema: http://devicetree.org/meta-schemas/core.yaml#

title: Rockchip rk3506 Family Clock and Reset Control Module

maintainers:
  - Finley Xiao <finley.xiao@rock-chips.com>
  - Heiko Stuebner <heiko@sntech.de>

description: |
  The RK3506 clock controller generates the clock and also implements a reset
  controller for SoC peripherals. For example it provides SCLK_UART2 and
  PCLK_UART2, as well as SRST_P_UART2 and SRST_UART2 for the second UART
  module.
  Each clock is assigned an identifier and client nodes can use this identifier
  to specify the clock which they consume. All available clock and reset IDs
  are defined as preprocessor macros in dt-binding headers.

properties:
  compatible:
    enum:
      - rockchip,rk3506-cru
      - rockchip,rk3506-grf-cru

  reg:
    maxItems: 1

  "#clock-cells":
    const: 1

  "#reset-cells":
    const: 1

  clocks:
    minItems: 2
    maxItems: 2

  clock-names:
    items:
      - const: xin24m
      - const: xin32k

  assigned-clocks: true

  assigned-clock-rates: true

  rockchip,grf:
    $ref: /schemas/types.yaml#/definitions/phandle
    description: >
      phandle to the syscon managing the "general register files". It is used
      for GRF muxes, if missing any muxes present in the GRF will not be
      available.

required:
  - compatible
  - reg
  - "#clock-cells"
  - "#reset-cells"

additionalProperties: false

examples:
  - |
    cru: clock-controller@ff9a0000 {
      compatible = "rockchip,rk3506-cru";
      reg = <0xff9a0000 0x20000>;
      #clock-cells = <1>;
      #reset-cells = <1>;
    };
```

## Documentation/devicetree/bindings/display/rockchip/mcu-panel.yaml
```yaml
# SPDX-License-Identifier: (GPL-2.0-only OR BSD-2-Clause)
%YAML 1.2
---
$id: http://devicetree.org/schemas/display/rockchip/mcu-panel.yaml#
$schema: http://devicetree.org/meta-schemas/core.yaml#

title: Rockchip MCU Panel

maintainers:
  - Damon Ding <damon.ding@rock-chips.com>

allOf:
  - $ref: panel-common.yaml#

properties:
  bus-format:
    description: pixel data format on the wire

  backlight: true

  enable-gpios:
    description: GPIO pin to enable the panel
  reset-gpios:
    description: GPIO pin to reset the panel
  te-gpios:
    description: GPIO pin for the soft TE mode

  prepare-delay-ms:
    description: |
      the time (in milliseconds) that it takes for the panel to
      become ready and start receiving video data
  enable-delay-ms:
    description: |
      the time (in milliseconds) that it takes for the panel to
      display the first valid frame after starting to receive
      video data
  disable-delay-ms:
    description: |
      the time (in milliseconds) that it takes for the panel to
      turn the display off (no content is visible)
  unprepare-delay-ms:
    description: |
      the time (in milliseconds) that it takes for the panel
      to power itself down completely
  reset-delay-ms:
    description: |
      the time (in milliseconds) that it takes for the panel to
      reset itself completely
  init-delay-ms:
    description: |
      the time (in milliseconds) that it takes for the panel to
      send init command sequence after reset deassert

  width-mm:
    description: width (in millimeters) of the panel's active display area
  height-mm:
    description: height (in millimeters) of the panel's active display area

  panel-init-sequence:
    description: |
      A byte stream formed by init commands.
        byte 0 - mcu data type
        byte 1 - wait number of specified ms after mcu command transmitted
        byte 2 - packet payload length
        byte 3 - and beyond: number byte of payload
  panel-exit-sequence:
    description: A byte stream formed by deinit commands.
  panel-frame-sequence:
    description: |
      A byte stream formed by interframe commands.

  display-timings:
    description:
      Some display panels support several resolutions with different timings.
      The display-timings bindings supports specifying several timings and
      optionally specifying which is the native mode.
    $ref: display-timings.yaml#

  port:
    $ref: /schemas/graph.yaml#/properties/port

additionalProperties: false

required:
  - bus-format
  - backlight
  - enable-gpios
  - reset-gpios
  - panel-init-sequence
  - panel-exit-sequence
  - display-timings
  - port

examples:
  - |
    #include <dt-bindings/display/media-bus-format.h>
    &rgb {
      mcu_panel: mcu-panel {
        bus-format = <MEDIA_BUS_FMT_RGB565_1X16>;
        backlight = <&backlight>;
        enable-gpios = <&gpio0 RK_PA1 GPIO_ACTIVE_LOW>;
        reset-gpios = <&gpio0 RK_PA7 GPIO_ACTIVE_LOW>;

        panel-init-sequence = [
          00   00  01  e0
          01   00  01  00
          01   00  01  07
          01   00  01  0f
          01   00  01  0d
          01   00  01  1b
          01   00  01  0a
          01   00  01  3c
          01   00  01  78
          01   00  01  4a
          01   00  01  07
          01   00  01  0e
          01   00  01  09
          01   00  01  1b
          01   00  01  1e
          01   00  01  0f
          00   00  01  e1
          01   00  01  00
          01   00  01  22
          01   00  01  24
          01   00  01  06
          01   00  01  12
          01   00  01  07
          01   00  01  36
          01   00  01  47
          01   00  01  47
          01   00  01  06
          01   00  01  0a
          01   00  01  07
          01   00  01  30
          01   00  01  37
          01   00  01  0f

          00   00  01  c0
          01   00  01  10
          01   00  01  10

          00   00  01  c1
          01   00  01  41

          00   00  01  c5
          01   00  01  00
          01   00  01  22
          01   00  01  80

          00   00  01  36
          01   00  01  48

          00   00  01  3a
          01   00  01  55

          00   00  01  b0
          01   00  01  00

          00   00  01  b1
          01   00  01  a0

          01   00  01  11
          00   00  01  b4
          01   00  01  02
          00   00  01  B6
          01   00  01  02

          01   00  01  02

          00   00  01  b7
          01   00  01  c6

          00   00  01  be
          01   00  01  00
          01   00  01  04

          00   00  01  e9
          01   00  01  00

          00   00  01  f7
          01   00  01  a9
          01   00  01  51
          01   00  01  2c
          01   00  01  82

          00   78  01  11
          00   32  01  29
          00   00  01  2c
        ];

        panel-exit-sequence = [
          00   0a  01  28
          00   78  01  10
        ];

        display-timings {
          native-mode = <&kd050fwfba002_timing>;

          kd050fwfba002_timing: timing0 {
            clock-frequency = <10453500>;
            hactive = <320>;
            vactive = <480>;
            hback-porch = <10>;
            hfront-porch = <5>;
            vback-porch = <10>;
            vfront-porch = <5>;
            hsync-len = <10>;
            vsync-len = <10>;
            hsync-active = <0>;
            vsync-active = <0>;
            de-active = <0>;
            pixelclk-active = <1>;
          };
        };

        port {
          panel_in_rgb: endpoint {
            remote-endpoint = <&rgb_out_panel>;
          };
        };
      };
    };
```

## Documentation/devicetree/bindings/display/rockchip/rockchip,analogix-dp.yaml
```yaml
# SPDX-License-Identifier: GPL-2.0
%YAML 1.2
---
$id: http://devicetree.org/schemas/display/rockchip/rockchip,analogix-dp.yaml#
$schema: http://devicetree.org/meta-schemas/core.yaml#

title: Rockchip specific extensions to the Analogix Display Port

maintainers:
  - Sandy Huang <hjc@rock-chips.com>
  - Heiko Stuebner <heiko@sntech.de>

properties:
  compatible:
    enum:
      - rockchip,rk3288-dp
      - rockchip,rk3399-edp
      - rockchip,rk3568-edp
      - rockchip,rk3576-edp
      - rockchip,rk3588-edp

  clocks:
    minItems: 2
    maxItems: 3

  clock-names:
    minItems: 2
    items:
      - const: dp
      - const: pclk
      - const: grf

  power-domains:
    maxItems: 1

  resets:
    minItems: 1
    maxItems: 2

  reset-names:
    minItems: 1
    items:
      - const: dp
      - const: apb

  rockchip,data-swap:
    description:
      Indicate whether to enable data swap function for split mode or dual
      channel mode. It can be helpful to deal with the reversed hardware
      design issue in left and right display interfaces.

  rockchip,disable-psr:
    description:
      Indicate whether to disable PSR function when the PSR
      capability of Sink device is detected.

  rockchip,dual-channel:
    description:
      Indicate whether to enable dual channel mode, which horizontally
      splits a single video port's output to drive one displays with
      identical interfaces and consistent display timing.
      |            | ---> | eDP0 | \    |                              |
      | Video Port |                --> |             Panel            |
      |            | ---> | eDP1 | /    |                              |

  rockchip,dual-connector-split:
    description:
      Indicate whether to enable dual connector split mode, which horizontally
      splits a single video port's output to drive two displays with different
      interfaces and consistent display timing.
      |            | ---> | eDP0  | ---> |              |               |
      | Video Port |                     | Panel0(Left) | Panel1(right) |
      |            | ---> | MIPI1 |      |              |               |
                              ----------------------------------^

  rockchip,grf:
    $ref: /schemas/types.yaml#/definitions/phandle
    description:
      This SoC makes use of GRF regs.

  rockchip,left-display:
    description:
      Assign the specific interface for the left display in dual connector
      split mode. It can be helpful to deal with the reversed hardware
      design issue in left and right display interfaces.

  rockchip,split-mode:
    description:
      Indicate whether to enable split mode, which horizontally splits
      a single video port's output to drive two displays with identical
      interfaces and consistent display timing.
      |            | ---> | eDP0 | ---> |              |               |
      | Video Port |                    | Panel0(Left) | Panel1(right) |
      |            | ---> | eDP1 |      |              |               |
                              ---------------------------------^

required:
  - compatible
  - clocks
  - clock-names
  - resets
  - reset-names
  - rockchip,grf

allOf:
  - $ref: /schemas/display/bridge/analogix,dp.yaml#

  - if:
      properties:
        compatible:
          contains:
            enum:
              - rockchip,rk3568-edp
              - rockchip,rk3576-edp
              - rockchip,rk3588-edp
    then:
      properties:
        resets:
          minItems: 2
        reset-names:
          minItems: 2

unevaluatedProperties: false

examples:
  - |
    #include <dt-bindings/clock/rk3288-cru.h>
    #include <dt-bindings/interrupt-controller/arm-gic.h>
    #include <dt-bindings/interrupt-controller/irq.h>
    dp@ff970000 {
      compatible = "rockchip,rk3288-dp";
      reg = <0xff970000 0x4000>;
      interrupts = <GIC_SPI 98 IRQ_TYPE_LEVEL_HIGH>;
      clocks = <&cru SCLK_EDP>, <&cru PCLK_EDP_CTRL>;
      clock-names = "dp", "pclk";
      phys = <&dp_phy>;
      phy-names = "dp";
      resets = <&cru 111>;
      reset-names = "dp";
      rockchip,grf = <&grf>;
      pinctrl-0 = <&edp_hpd>;
      pinctrl-names = "default";

      ports {
        #address-cells = <1>;
        #size-cells = <0>;

        edp_in: port@0 {
          reg = <0>;
          #address-cells = <1>;
          #size-cells = <0>;

          edp_in_vopb: endpoint@0 {
            reg = <0>;
            remote-endpoint = <&vopb_out_edp>;
          };
          edp_in_vopl: endpoint@1 {
            reg = <1>;
            remote-endpoint = <&vopl_out_edp>;
          };
        };

        edp_out: port@1 {
          reg = <1>;

          edp_out_panel: endpoint {
            remote-endpoint = <&panel_in_edp>;
          };
        };
      };
    };
```
