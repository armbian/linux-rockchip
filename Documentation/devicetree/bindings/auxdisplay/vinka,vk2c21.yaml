## Documentation/devicetree/bindings/display/rockchip/rockchip-eink-panel.txt
```
Rockchip EINK panel
================================

EINK panel timing:

       │                            │FBL+FSL
       │                            │
       │                            │
LBL+LSL│            LDL             │   LEL
  ─────┼────────────────────────────┼───────
       │                            │
       │                            │
       │         Active Area        │FDL
       │                            │
       │                            │
  ─────┼────────────────────────────┼───────
       │                            │
       │                            │FEL
       │                            │
       │                            │

┌─────────────────────────────────────────────┐
│                 Active Area                 │
│       ┌────────────────────────────┐        │
│       │                            │        │
│       │                            │        │
│       │         Visible Area       │height  │vir_height
│       │                            │        │
│       │                            │        │
│       └────────────────────────────┘        │
│                    vidth                    │
└─────────────────────────────────────────────┘
                   vir_width

----

Required properties:
- panel,width: visible width of panel in pixels
- panel,height: visible height of panel in pixels
- panel,vir_width: virtual width of panel pixels
- panel,vir_height: virtual height of panel pixels
- panel,sdck: frequency of sdclk in Hz
- panel,lsl: line start length
- panel,lbl: line back porch length
- panel,ldl: line data length
- panel,lel: line end porch length
- panel,gdck-sta: gdck-sta length
- panel,lgonl: lgonl length
- panel,fsl: frame start length
- panel,fbl: frame back porch length
- panel,fdl: frame data length
- panel,fel: frame end porch length
- panel,panel_16bit: 1 for 16bit panel, 0 for 8bit panel
- panel,panel_color: 1 for color panel, 0 for normal panel
- panel,mirror: line scan direction. 0 for from left to right,
		1 for from right to left.
- panel,rearrange: image data need special arrangement.
		   1 for special arrangement, 0 for no arrangement.
- panel,width-mm: physical width of panel in millimeters
- panel,height-mm: physical height of panel in millimeters

Optional properties:
- panel,sdoe_mode: SDOE signal mode setting.
		   Set to 1, SDOE is active during total horizon.
		   Set to 0, SDOE is active during total vertical.
		   If not set, the default value is 0.
- panel,sdce_width: width of SDCE signal.
		    If not set, the default value is same as "panel,ldl".
- panel,disable_logo: disable show logo. 1 for disable logo, 0 for enable logo.
		      If not set, the default value is 0.

Example:
&ebc_dev {
	/* ED103TC2 panel */
	panel,width = <1872>;
	panel,height = <1404>;
	panel,vir_width = <1872>;
	panel,vir_height = <1404>;
	panel,sdck = <34000000>;
	panel,lsl = <18>;
	panel,lbl = <17>;
	panel,ldl = <234>;
	panel,lel = <7>;
	panel,gdck-sta = <34>;
	panel,lgonl = <192>;
	panel,fsl = <1>;
	panel,fbl = <4>;
	panel,fdl = <1404>;
	panel,fel = <12>;
	panel,mirror = <1>;
	panel,panel_16bit = <1>;
	panel,panel_color = <0>;
	panel,width-mm = <157>;
	panel,height-mm = <210>;
};
```

## Documentation/devicetree/bindings/display/rockchip/rockchip-rgb.yaml
```yaml
# SPDX-License-Identifier: (GPL-2.0-only OR BSD-2-Clause)
%YAML 1.2
---
$id: http://devicetree.org/schemas/display/rockchip/rockchip-rgb.yaml#
$schema: http://devicetree.org/meta-schemas/core.yaml#

title: Rockchip RGB interface

maintainers:
  - Sandy Huang <hjc@rock-chips.com>
  - Damon Ding <damon.ding@rock-chips.com>

properties:
  compatible:
    enum:
      - rockchip,px30-rgb
      - rockchip,rk1808-rgb
      - rockchip,rk3066-rgb
      - rockchip,rk3128-rgb
      - rockchip,rk3288-rgb
      - rockchip,rk3308-rgb
      - rockchip,rk3368-rgb
      - rockchip,rk3506-rgb
      - rockchip,rk3562-rgb
      - rockchip,rk3568-rgb
      - rockchip,rk3588-rgb
      - rockchip,rv1106-rgb
      - rockchip,rv1108-rgb
      - rockchip,rv1126-rgb

  phys:
    description: phandle for the PHY device
  phy-names:
    description: should be "phy"
  pinctrl-names:
    description: the pin control state names; should contain "default"
  pinctrl-0:
    description: the default pinctrl state (active)
  pinctrl-1:
    description: the "sleep" pinctrl state
  rockchip,data-sync-bypass:
    description: bypass the vop data-sync logic from io

  ports:
    $ref: /schemas/graph.yaml#/properties/ports

    properties:
      port@0:
        $ref: /schemas/graph.yaml#/properties/port
        description:
          port for the VOP input

      port@1:
        $ref: /schemas/graph.yaml#/properties/port
        description:
          port for either a panel or bridge

  mcu-panel:
    $ref: mcu-panel.yaml#
    description:
      mcu panel configurations

required:
  - compatible
  - pinctrl-names
  - pinctrl-0
  - ports

additionalProperties: false

examples:
  - |
    rgb: rgb {
      compatible = "rockchip,rk3308-rgb";
      pinctrl-names = "default";
      pinctrl-0 = <&lcdc_ctl>;

      ports {
        #address-cells = <1>;
        #size-cells = <0>;

        port@0 {
          reg = <0>;
          #address-cells = <1>;
          #size-cells = <0>;

          rgb_in_vop: endpoint@0 {
            reg = <0>;
            remote-endpoint = <&vop_out_rgb>;
          };
        };
      };
    };
```

## Documentation/devicetree/bindings/display/rockchip/rockchip-vkms.yaml
```yaml
# SPDX-License-Identifier: (GPL-2.0-only OR BSD-2-Clause)
%YAML 1.2
---
$id: http://devicetree.org/schemas/display/rockchip/rockchip-vkms.yaml#
$schema: http://devicetree.org/meta-schemas/core.yaml#

title: Rockchip virtual KMS driver

description:
  Rockchip Virtual KMS Driver providing a complete software-emulated
  display pipeline for headless and virtualized environments,
  implementing virtual CRTCs, planes, encoders, and connectors.

maintainers:
  - Andy Yan <rock-chips@.com>

properties:
  compatible:
    enum:
      - rockchip,vkms

  rockchip,vkms-crtc-num:
    maxItems: 1
    description:
      The number of virtual ctrc devices.

  rockchip,vkms-conn-disconnected:
    minItems: 1
    maxItems: 8
    description:
      Add index to set specified virtual connector to disconnected.
      The index should be less than rockchip,vkms-crtc-num.

required:
  - compatible

additionalProperties: false

examples:
  - |
    vkms {
      compatible = "rockchip,vkms";
      rockchip,vkms-crtc-num = <6>;
      rockchip,vkms-conn-disconnected = <0 3 5>;
    };
```

## Documentation/devicetree/bindings/mailbox/rockchip-mailbox.txt
```
Rockchip mailbox

The Rockchip mailbox is used by the Rockchip CPU cores to communicate
requests to MCU processor.

Refer to ./mailbox.txt for generic information about mailbox device-tree
bindings.

Required properties:

 - compatible: should be one of the following.
   - "rockchip,rk3368-mbox" for rk3368
   - "rockchip,rk3576-mbox" for rk3576
 - reg: physical base address of the controller and length of memory mapped
	region.
 - interrupts: The interrupt number to the cpu. The interrupt specifier format
	depends on the interrupt controller.
 - #mbox-cells: Common mailbox binding property to identify the number
	of cells required for the mailbox specifier. Should be 1

Optional properties :

 - wakeup-source: Mailbox irq can be used as a wakeup source.
 - rockchip,txpoll-period-us: TX Done polling interval in microseconds,
	only support when CONFIG_MAILBOX_POLL_PERIOD_US is selected.
 - rockchip,txpoll-period-ms: TX Done polling interval in milliseconds.
 - rockchip,enable-cmd-trigger: Enable write cmd register to trigger interrupt.
	This is only support from rockchip,rk3576-mbox.
 - rockchip,txdone-ack: Enable if the mailbox client use ACK to check TX_DONE.
 - rockchip,txdone-irq: Enable if the controller can trigger TX_DONE interrupt.
 - rockchip,tx-direction-b2a: To specify the TX direction as B2A for local.

Example:
--------

/* RK3368 */
mbox: mbox@ff6b0000 {
	compatible = "rockchip,rk3368-mailbox";
	reg = <0x0 0xff6b0000 0x0 0x1000>,
	interrupts = <GIC_SPI 146 IRQ_TYPE_LEVEL_HIGH>,
		     <GIC_SPI 147 IRQ_TYPE_LEVEL_HIGH>,
		     <GIC_SPI 148 IRQ_TYPE_LEVEL_HIGH>,
		     <GIC_SPI 149 IRQ_TYPE_LEVEL_HIGH>;
	#mbox-cells = <1>;
};
```

## Documentation/devicetree/bindings/net/can/rk3562_can.txt
```
Rockchip CANFD controller Device Tree Bindings
---------------------------------------------------------

Required properties:
- compatible		: Should be:
			  - "rockchip,rk3562-can" for RK3562 CAN controllers 3.0
			  - "rockchip,rk3562-canfd" for RK3562 CANFD controllers 3.0
- reg			: Physical base address and size of the controller
			  registers map.
- interrupts		: Property with a value describing the interrupt
			  number.
- clock-names		: List of input clock names
			  - "can_clk", "pclk",
			  (See clock bindings for details).
- clocks		: Clock phandles (see clock bindings for details).
- resets : Must contain an entry for each entry in reset-names.
	   See ../reset/reset.txt for details.
- reset-names : List of input reset names
			  - "can", "can-apb".

Example:

For Dts file:
	can0: can0@ff600000 {
		compatible = "rockchip,rk3562-can";
		reg = <0x0 0xff600000 0x0 0x1000>;
		interrupts = <GIC_SPI 64 IRQ_TYPE_LEVEL_HIGH>;
		clocks = <&cru CLK_CAN0>, <&cru PCLK_CAN0>;
		clock-names = "baudclk", "apb_pclk";
		resets = <&cru SRST_CAN0>, <&cru SRST_P_CAN0>;
		reset-names = "can", "can-apb";
		status = "okay";
	};
```

## Documentation/devicetree/bindings/net/lte-em05-modem-platdata.txt
```
* LTE EM05 modem device tree bindings

Required properties:
- compatible : "lte-em05-modem-platdata"

Optional properties:
- em05,airplane-gpio : EM05 modem airplane mode enter/exit gpio
- em05,power-gpio : EM05 modem power enable/disable gpio
- em05,reset-gpio : EM05 modem reset gpio

Example:

	em05_modem: em05-modem {
		compatible="lte-em05-modem-platdata";
		em05,airplane-gpio = <&gpio1 RK_PA4 GPIO_ACTIVE_HIGH>;
		em05,power-gpio = <&gpio0 RK_PD6 GPIO_ACTIVE_HIGH>;
		em05,reset-gpio = <&gpio0 RK_PD5 GPIO_ACTIVE_HIGH>;
	}
```

## Documentation/devicetree/bindings/power/supply/cps5601x_charger.txt
```
Binding for cps5601x battery charger

Required properties:
- compatible: "cps,cps5601x" for cps5601x Charger Power Supply
- monitored-battery: phandle of battery characteristics devicetree node
- input-voltage-limit-microvolt: integer, input voltage level in uV, used to
				 decrease voltage level when the over current
				 of the input power source occurs.
- input-current-limit-microamp: integer, input current value in uA drained by the
				charger from the power source.Default: 500000 uA (500mA)

child nodes:
- vbus5v0_typec:
  Usage: optional
  Description: Regulator that is used to control the VBUS voltage direction for
               either USB host mode or for charging on the OTG port.

Example:

cps5601x: cps5601x@60 {
                compatible = "cps,cps5601x";
                reg = <0x60>;
                input-voltage-limit-microvolt = <4500000>;
                input-current-limit-microamp = <3000000>;
                monitored-battery = <&bat>;
                regulators {
                        vbus5v0_typec: vbus5v0-typec {
                                regulator-compatible = "otg-vbus";
                                regulator-name = "vbus5v0_typec";
                        };
                };
        };
```

## Documentation/devicetree/bindings/regulator/omnivision,onxq000.yaml
```yaml
# SPDX-License-Identifier: (GPL-2.0-only OR BSD-2-Clause)
%YAML 1.2
---
title: Omnivision onxq000 power switch

maintainers:
  - Jing Wu <jing.wu@rock-chips.com>

description:
  4 channels power switch

allOf:
  - $ref: regulator.yaml#

properties:
  $nodename:
    pattern: "^onxq000-regulator@[0-9a-f]"
  compatible:
    const: omnivision,onxq000

  reg:
    maxItems: 1

  vin-supply:
    description: Input supply phandle

  onxq000,control-by-gpio:
    description: set onxq driver to work in gpio mode

  ena-gpios:
    description: if onxq000,control-by-gpio defined, this property list the gpio that connected to INx of onxq000

required:
  - compatible
  - reg

examples:
  - |
    i2c {
        #address-cells = <1>;
        #size-cells = <0>;

        onxq000: onxq000-regulator@76 {
            status = "okay";
            reg = <0x76>;
            vin-supply = <&vcc12v_dcin>;
            compatible = "omnivision,onxq000";

            /* If onxq000 is controlled by GPIO, the properties below must be defined */
            onxq000,control-by-gpio;
            pinctrl-names = "default";
            pinctrl-0 = <&onxq000_gpio>;
            ena-gpios = <&gpio_in1>, <&gpio_in2>, <&gpio_in3>, <&gpio_in4>;

            regulators {
                onxq000_ch1: out1 {
                    regulator-name = "onxq000_ch1";
                };

                onxq000_ch2: out2 {
                    regulator-name = "onxq000_ch2";
                };

                onxq000_ch3: out3 {
                    regulator-name = "onxq000_ch3";
                };

                onxq000_ch4: out4 {
                    regulator-name = "onxq000_ch4";
                };
            };
        };
    };
```
