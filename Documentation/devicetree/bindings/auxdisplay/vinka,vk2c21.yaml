## drivers/gpu/drm/rockchip/Kconfig
```kconfig
# SPDX-License-Identifier: GPL-2.0-only
config DRM_ROCKCHIP
	tristate "DRM Support for Rockchip"
	depends on DRM
	select DRM_GEM_DMA_HELPER
	select DRM_KMS_HELPER
	select DRM_PANEL
	select VIDEOMODE_HELPERS
	select DRM_ANALOGIX_DP if ROCKCHIP_ANALOGIX_DP
	select DRM_DW_HDMI if ROCKCHIP_DW_HDMI
	select DRM_DW_MIPI_DSI if ROCKCHIP_DW_MIPI_DSI || ROCKCHIP_DW_MIPI_DSI2
	select GENERIC_PHY if ROCKCHIP_DW_MIPI_DSI || ROCKCHIP_DW_MIPI_DSI2
	select GENERIC_PHY_MIPI_DPHY if ROCKCHIP_DW_MIPI_DSI || ROCKCHIP_DW_MIPI_DSI2
	select SND_SOC_HDMI_CODEC if ROCKCHIP_CDN_DP && SND_SOC
	help
	  Choose this option if you have a Rockchip soc chipset.
	  This driver provides kernel mode setting and buffer
	  management to userspace. This driver does not provide
	  2D or 3D acceleration; acceleration is performed by other
	  IP found on the SoC.

if DRM_ROCKCHIP

config ROCKCHIP_DRM_DEBUG
	bool "Rockchip DRM debug"
	default y if !ROCKCHIP_MINI_KERNEL
	depends on DEBUG_FS
	help
	  This option add a debug node to dump buf from userspace
	  dump buffer store at: /data
	  debug node: /d/dri/0/ff900000.vop/vop_dump/dump
	  cat /d/dri/0/ff900000.vop/vop_dump/dump get more help
	  the upper ff900000.vop is different at different SOC platform.

config ROCKCHIP_DRM_DIRECT_SHOW
	bool "Rockchip DRM direct show"
	help
	  This is a quick display scheme api in kernel space.

config ROCKCHIP_DRM_SELF_TEST
	bool "Rockchip DRM self test case"
	depends on ROCKCHIP_DRM_DIRECT_SHOW
	help
	  This offer setf test demo to display image at kernel space.

config ROCKCHIP_VOP
	bool "Rockchip VOP driver"
	depends on CPU_RK3036 || CPU_RK30XX || CPU_RK312X || \
		   CPU_PX30   || CPU_RK3308 || CPU_RV1106 || \
		   CPU_RV1126 || CPU_RK3288 || CPU_RK3368 || \
		   CPU_RK3399 || CPU_RK322X || CPU_RK3328 || \
		   CPU_RK3576 || CPU_RK3506 || CPU_RV1126B
	default y if !ROCKCHIP_MINI_KERNEL
	help
	  This selects support for the VOP driver. You should enable it
	  on older SoCs.

config ROCKCHIP_VOP2
	bool "Rockchip VOP2 driver"
	depends on CPU_RK3528 || CPU_RK3562 || CPU_RK3568 || CPU_RK3588 || CPU_RK3576
	default y
	help
	  This selects support for the VOP2 driver. The VOP2 hardware is
	  first found on the RK3568.

config ROCKCHIP_ANALOGIX_DP
	bool "Rockchip specific extensions for Analogix DP driver"
	select DRM_DISPLAY_HELPER
	select DRM_DISPLAY_DP_HELPER
	help
	  This selects support for Rockchip SoC specific extensions
	  for the Analogix Core DP driver. If you want to enable DP
	  on RK3288 or RK3399 based SoC, you should select this option.

config ROCKCHIP_CDN_DP
	bool "Rockchip cdn DP"
	select DRM_DISPLAY_HELPER
	select DRM_DISPLAY_DP_HELPER
	help
	  This selects support for Rockchip SoC specific extensions
	  for the cdn DP driver. If you want to enable Dp on
	  RK3399 based SoC, you should select this
	  option.

config ROCKCHIP_DIMMING_PANEL
	bool "Rockchip dimming panel support"
	depends on SPI
	default n
	help
	  Choose this option to enable support for generic dimming panel
	  which supports to adjust the backlight brightness of different
	  zones.

config ROCKCHIP_DRM_TVE
	bool "Rockchip TVE support"
	depends on DRM_ROCKCHIP
	help
	  Choose this option to enable support for Rockchip TVE controllers.
	  say Y to enable its driver.

config ROCKCHIP_DW_HDMI
	bool "Rockchip specific extensions for Synopsys DW HDMI"
	select DRM_DISPLAY_HDCP_HELPER
	help
	  This selects support for Rockchip SoC specific extensions
	  for the Synopsys DesignWare HDMI driver. If you want to
	  enable HDMI on RK3288 or RK3399 based SoC, you should select
	  this option.

config ROCKCHIP_DW_MIPI_DSI
	bool "Rockchip specific extensions for Synopsys DW MIPI DSI"
	select GENERIC_PHY_MIPI_DPHY
	help
	  This selects support for Rockchip SoC specific extensions
	  for the Synopsys DesignWare dsi driver. If you want to
	  enable MIPI DSI on RK3288 or RK3399 based SoC, you should
	  select this option.

config ROCKCHIP_DW_MIPI_DSI2
	bool "Rockchip specific extensions for Synopsys DW MIPI DSI2"
	depends on CPU_RK3576 || CPU_RK3588
	default ROCKCHIP_DW_MIPI_DSI
	select GENERIC_PHY_MIPI_DPHY
	help
	  This selects support for Rockchip SoC specific extensions
	  for the Synopsys DesignWare dsi2 driver. If you want to
	  enable MIPI DSI2 on RK3576 or RK3588  based SoC, you should
	  select this option.

config ROCKCHIP_DW_DP
	bool "Rockchip specific extensions for Synopsys DW DPTX"
	select DRM_DISPLAY_HDCP_HELPER
	select DRM_DISPLAY_HDMI_HELPER
	help
	  Choose this option for Synopsys DesignWare Cores DisplayPort
	  transmit controller support on Rockchip SoC.

config ROCKCHIP_INNO_HDMI
	bool "Rockchip specific extensions for Innosilicon HDMI"
	help
	  This selects support for Rockchip SoC specific extensions
	  for the Innosilicon HDMI driver. If you want to enable
	  HDMI on RK3036 based SoC, you should select this option.

config ROCKCHIP_LVDS
	bool "Rockchip LVDS support"
	depends on PINCTRL && OF
	help
	  Choose this option to enable support for Rockchip LVDS controllers.
	  Rockchip rk3288 SoC has LVDS TX Controller can be used, and it
	  support LVDS, rgb, dual LVDS output mode. say Y to enable its
	  driver.

config ROCKCHIP_PANEL_NOTIFIER
	tristate "Rockchip panel notifier"
	depends on OF
	help
	  Say Y here if you want to enable support for the panel notifier. The
	  notifier is used to notify other devices (such as TP) to perform the
	  corresponding action when the panel is in different actions.

config ROCKCHIP_RGB
	bool "Rockchip RGB support"
	depends on PINCTRL
	help
	  Choose this option to enable support for Rockchip RGB output.
	  Some Rockchip CRTCs, like rv1108, can directly output parallel
	  and serial RGB format to panel or connect to a conversion chip.
	  say Y to enable its driver.

config ROCKCHIP_RK3066_HDMI
	bool "Rockchip specific extensions for RK3066 HDMI"
	help
	  This selects support for Rockchip SoC specific extensions
	  for the RK3066 HDMI driver. If you want to enable
	  HDMI on RK3066 based SoC, you should select this option.

config ROCKCHIP_VCONN
	bool "Rockchip Virtual connector driver for HDMI/DP/DSI"
	help
	  This selects support virtual HDMI/DP/DSI drived by
	  rockchip vop, This is used for some test.

config DRM_ROCKCHIP_VKMS
	bool "Rockchip virtual Kernel Mode-Setting driver"
	help
	  Say y here if you want use some module of rockchip drm, but
	  don't need a real vop driver(et: you just want rockchip drm
	  gem driver to allocate memory).

config ROCKCHIP_DW_HDCP2
	tristate "Synopsis Designware HDCP2 interface"
	help
	  Choose this option to enable support for the Synopsys
	  Designware HDCP2 Controller.

config ROCKCHIP_DP_MST_AUX_CLIENT
	tristate "dp mst aux client"
	select DRM_DISPLAY_DP_HELPER
	help
	  This selects support dp mst device that not support aux client.

source "drivers/gpu/drm/rockchip/rk618/Kconfig"

endif
```

## drivers/iio/imu/inv_icm42670/Kconfig
```kconfig
# SPDX-License-Identifier: GPL-2.0-or-later

config INV_ICM42670
	tristate
	select IIO_BUFFER

config INV_ICM42670_I2C
	tristate "InvenSense ICM-42670 I2C driver"
	depends on I2C
	select INV_ICM42670
	select REGMAP_I2C
	help
	  This driver supports the InvenSense ICM-426xx motion tracking
	  devices over I2C.

	  This driver can be built as a module. The module will be called
	  inv-icm42670-i2c.

config INV_ICM42670_SPI
	tristate "InvenSense ICM-42670 SPI driver"
	depends on SPI_MASTER
	select INV_ICM42670
	select REGMAP_SPI
	help
	  This driver supports the InvenSense ICM-426xx motion tracking
	  devices over SPI.

	  This driver can be built as a module. The module will be called
	  inv-icm42670-spi.
```

## drivers/iio/proximity/nds03/Kconfig
```kconfig
# SPDX-License-Identifier: GPL-2.0-or-later

config DTOF_NDS03
	tristate "NDS03 I2C DEVICE"
	depends on I2C && SYSFS
	help
	  Using I2C
```

## drivers/input/touchscreen/chipone_tddi/Kconfig
```kconfig
# SPDX-License-Identifier: GPL-2.0-or-later
#
# chipone Touchscreen driver configuration
#

config TOUCHSCREEN_CHIPONE_9551R
	tristate "chipone Touchscreen"
	depends on I2C
	select ROCKCHIP_PANEL_NOTIFIER
	default n
	help
	  Say Y here if you have chipone touch panel.
	  If unsure, say N.
```
